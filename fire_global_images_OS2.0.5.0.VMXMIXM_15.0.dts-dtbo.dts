/dts-v1/;

/ {

	fragment@0 {
		target = <0xffffffff>;

		__overlay__ {
			status = "okay";
			clock-frequency = <0x61a80>;

			nxp@28 {
				compatible = "qcom,nq-nci";
				reg = <0x28>;
				qcom,nq-irq = <0xffffffff 0x06 0x00>;
				interrupt-parent = <0xffffffff>;
				interrupts = <0x06 0x04 0x06 0x00>;
				qcom,nq-ven = <0xffffffff 0x13 0x00>;
				qcom,nq-firm = <0xffffffff 0x11 0x00>;
				qcom,nq-clkreq = <0xffffffff 0x0b 0x00>;
				interrupt-names = "nfc_irq";
				pinctrl-names = "default", "nfc_active", "nfc_suspend";
				pinctrl-0 = <0x01>;
				pinctrl-1 = <0x02 0x03 0x04 0x05>;
				pinctrl-2 = <0x06 0x07 0x08 0x09>;
			};
		};
	};

	fragment@1 {
		target = <0xffffffff>;

		__overlay__ {

			nfc_default {
				phandle = <0x01>;
			};

			nfc_int_active {
				phandle = <0x02>;

				pins_cmd_dat {
					pinmux = <0x600>;
					slew-rate = <0x00>;
					drive-strength = <0x02>;
					bias-pull-up;
				};
			};

			nfc_int_suspend {
				phandle = <0x06>;

				pins_cmd_dat {
					pinmux = <0x600>;
					slew-rate = <0x00>;
					drive-strength = <0x02>;
					bias-pull-up;
				};
			};

			nfc_enable_active {
				phandle = <0x03>;

				pins_cmd_dat {
					pinmux = <0x1300>;
					slew-rate = <0x01>;
					output-high;
					drive-strength = <0x02>;
					bias-pull-up = <0x67>;
				};
			};

			nfc_enable_suspend {
				phandle = <0x07>;

				pins_cmd_dat {
					pinmux = <0x1300>;
					slew-rate = <0x01>;
					drive-strength = <0x02>;
					bias-disable;
				};
			};

			nfc_firmwaredownload_active {
				phandle = <0x04>;

				pins_cmd_dat {
					pinmux = <0x1100>;
					slew-rate = <0x01>;
					drive-strength = <0x02>;
					bias-pull-up;
				};
			};

			nfc_firmwaredownload_suspend {
				phandle = <0x08>;

				pins_cmd_dat {
					pinmux = <0x1100>;
					slew-rate = <0x01>;
					drive-strength = <0x02>;
					bias-disable;
				};
			};

			nfc_clk_req_active {
				phandle = <0x05>;

				pins_cmd_dat {
					pinmux = <0xb01>;
					slew-rate = <0x00>;
					input-enable;
					drive-strength = <0x02>;
					bias-pull-up;
				};
			};

			nfc_clk_req_suspend {
				phandle = <0x09>;

				pins_cmd_dat {
					pinmux = <0xb01>;
					slew-rate = <0x00>;
					input-enable;
					drive-strength = <0x02>;
					bias-pull-down;
				};
			};
		};
	};

	fragment@2 {
		target = <0xffffffff>;

		__overlay__ {

			reserve-memory-scp_share {
				compatible = "mediatek,reserve-memory-scp_share";
				no-map;
				size = <0x00 0xd00000>;
				alignment = <0x00 0x1000000>;
				alloc-ranges = <0x00 0x40000000 0x00 0x50000000>;
			};
		};
	};

	fragment@3 {
		target = <0xffffffff>;

		__overlay__ {
			atag,videolfb-fb_base_l = "~`P";
			atag,videolfb-fb_base_h = <0x00>;
			atag,videolfb-islcmfound = <0x01>;
			atag,videolfb-islcm_inited = <0x00>;
			atag,videolfb-fps = <0x1770>;
			atag,videolfb-vramSize = <0x17e8000>;
			atag,videolfb-lcmname = "hx83112b_fhdp_dsi_cmd_auo_rt5081_drv";
		};
	};

	fragment@4 {
		target = <0xffffffff>;

		__overlay__ {
			compatible = "mediatek,i2c-leds-lm3697";

			backlight {
				led-mode = <0x06>;
				max-brightness = <0x7ff>;
				max-hw-brightness = <0x7ff>;
				min-brightness = <0x08>;
				min-hw-brightness = <0x08>;
				default-state = "on";
				pwms = <0xffffffff 0x00 0x99d9>;
				pwm-names = "lcd-backlight";
				pwm_config = <0x00 0x03 0x00 0x00 0x00>;
			};
		};
	};

	fragment@5 {
		target = <0xffffffff>;

		__overlay__ {
			microtrust,real-drv = <0x01>;
		};
	};

	fragment@6 {
		target = <0xffffffff>;

		__overlay__ {

			led@0 {
				compatible = "mediatek,red";
				led_mode = <0x00>;
				data = <0x01>;
				pwm_config = <0x00 0x00 0x00 0x00 0x00>;
				phandle = <0x54>;
			};

			led@1 {
				compatible = "mediatek,green";
				led_mode = <0x00>;
				data = <0x01>;
				pwm_config = <0x00 0x00 0x00 0x00 0x00>;
				phandle = <0x55>;
			};

			led@2 {
				compatible = "mediatek,blue";
				led_mode = <0x00>;
				data = <0x01>;
				pwm_config = <0x00 0x00 0x00 0x00 0x00>;
				phandle = <0x56>;
			};

			led@3 {
				compatible = "mediatek,jogball-backlight";
				led_mode = <0x00>;
				data = <0x01>;
				pwm_config = <0x00 0x00 0x00 0x00 0x00>;
				phandle = <0x57>;
			};

			led@4 {
				compatible = "mediatek,keyboard-backlight";
				led_mode = <0x00>;
				data = <0x01>;
				pwm_config = <0x00 0x00 0x00 0x00 0x00>;
				phandle = <0x58>;
			};

			led@5 {
				compatible = "mediatek,button-backlight";
				led_mode = <0x00>;
				data = <0x01>;
				pwm_config = <0x00 0x00 0x00 0x00 0x00>;
				phandle = <0x59>;
			};

			led@6 {
				compatible = "mediatek,lcd-backlight";
				led_mode = <0x06>;
				data = <0x01>;
				pwm_config = <0x00 0x03 0x00 0x00 0x00>;
				phandle = <0x5a>;
			};

			vibrator@0 {
				compatible = "mediatek,vibrator";
				vib_timer = <0x19>;
				vib_limit = <0x09>;
				vib_vol = <0x0b>;
				phandle = <0x5b>;
			};
		};
	};

	fragment@7 {
		target = <0xffffffff>;

		__overlay__ {
			clock-frequency = <0x61a80>;

			mtk-usb@60 {
				compatible = "mediatek,mtk-usb";
				reg = <0x60>;
				status = "okay";
			};
		};
	};

	fragment@8 {
		target = <0xffffffff>;

		__overlay__ {
			clock-frequency = <0x61a80>;

			usb_type_c_wusb3801@60 {
				compatible = "mediatek,usb_type_c_wusb3801";
				reg = <0x60>;
				mt-dual,supported_modes = <0x00>;
				wusb3801-tcpc,name = "type_c_port0";
				wusb3801-tcpc,role_def = <0x04>;
				wusb3801,rp_level = <0x00>;
				wusb3801,drp-toggle-time = <0x00>;
				wusb3801,irq-gpio = <0xffffffff 0x00 0x00>;
				wusb3801,irq-gpio_num = <0x00>;
				status = "okay";
				phandle = <0x5c>;
			};

			husb320@21 {
				compatible = "hynetek,husb320";
				reg = <0x21>;
				husb320,int-gpio = <0xffffffff 0x00 0x00>;
				husb320,int-gpio_num = <0x00>;
				husb320,init-mode = <0x1c>;
				husb320,host-current = <0x02>;
				husb320,drp-toggle-time = <0x01>;
				husb320,drp-duty-time = <0x00>;
				husb320,autosink-threshold = <0x01>;
				husb320,cc-debounce-time = <0x03>;
				status = "okay";
			};
		};
	};

	fragment@9 {
		target = <0xffffffff>;

		__overlay__ {
			accdet-mic-vol = <0x07>;
			headset-mode-setting = <0x500 0x500 0x01 0x1f0 0x800 0x800 0x20 0x44 0x00 0x00 0x0e 0x00 0x00 0x00 0x00>;
			accdet-plugout-debounce = <0x01>;
			accdet-mic-mode = <0x01>;
			headset-eint-level-pol = <0x08>;
			headset-three-key-threshold = <0x00 0x50 0xdc 0x190>;
			headset-three-key-threshold-CDD = <0x00 0x79 0xc0 0x258>;
			headset-four-key-threshold = <0x00 0x3a 0x79 0xc0 0x190>;
			status = "okay";
		};
	};

	fragment@10 {
		target = <0xffffffff>;

		__overlay__ {
			pinctrl-names = "default";
			pinctrl-0 = <0x0a>;
		};
	};

	fragment@11 {
		target = <0xffffffff>;

		__overlay__ {

			kpdgpiodefault {
				phandle = <0x0a>;

				pins_cmd_dat {
					pinmux = <0x5e01>;
					bias-pull-up = <0x66>;
					input-enable;
					input-schmitt-enable;
				};
			};
		};
	};

	fragment@12 {
		target = <0xffffffff>;

		__overlay__ {

			sleep_cb1 {
				phandle = <0x0c>;

				pins_cmd_dat {
					pinmux = <0x9e00>;
					drive-strength = <0x06>;
					input-enable;
					bias-disable;
				};
			};

			active_cb1 {
				phandle = <0x0b>;

				pins_cmd_dat {
					pinmux = <0x9e00>;
					drive-strength = <0x06>;
					bias-pull-up;
				};
			};

			sleep_cb2 {
				phandle = <0x0e>;

				pins_cmd_dat {
					pinmux = <0x9f00>;
					drive-strength = <0x06>;
					input-enable;
					bias-disable;
				};
			};

			active_cb2 {
				phandle = <0x0d>;

				pins_cmd_dat {
					pinmux = <0x9f00>;
					drive-strength = <0x06>;
					bias-pull-up;
				};
			};
		};
	};

	fragment@13 {
		target = <0xffffffff>;

		__overlay__ {
			clock-frequency = <0x61a80>;

			syv690@6a {
				compatible = "silergy,syv690";
				reg = <0x6a>;
				syv690,intr_gpio = <0xffffffff 0x66 0x00>;
				syv690,intr_gpio_num = <0x66>;
				charger_name = "primary_chg";
				silergy,syv690,current-sensor-mohm = <0x37>;
				silergy,syv690,usb-vreg = <0x1162>;
				silergy,syv690,usb-ichg = <0x60e>;
				silergy,syv690,usb-ilim = <0x5dc>;
				silergy,syv690,usb-vlim = <0x11f8>;
				silergy,syv690,vbatlow-volt = <0xdac>;
				silergy,syv690,termination-current = <0x100>;
				silergy,syv690,safety-max-charge-current = <0xbb8>;
				silergy,syv690,safety-max-charge-voltage = <0x1162>;
				silergy,syv690,boost-voltage = <0x13ec>;
				silergy,syv690,boost-current = <0x960>;
				usb_switch_cb1_gpio_num = <0x9e>;
				usb_switch_cb1_gpio = <0xffffffff 0x9e 0x00>;
				usb_switch_cb2_gpio_num = <0x9f>;
				usb_switch_cb2_gpio = <0xffffffff 0x9f 0x00>;
				otg_en_gpio_num = <0x97>;
				otg_en_gpio = <0xffffffff 0x97 0x00>;
				pinctrl-names = "active_cb1", "sleep_cb1", "active_cb2", "sleep_cb2";
				pinctrl-0 = <0x0b>;
				pinctrl-1 = <0x0c>;
				pinctrl-2 = <0x0d>;
				pinctrl-3 = <0x0e>;
				bootmode = <0xffffffff>;
				charge = <0x0f>;
				status = "okay";
				phandle = <0x0f>;
			};
		};
	};

	fragment@14 {
		target = <0xffffffff>;

		__overlay__ {

			consys_default {
				phandle = <0x10>;
			};

			gpslna@0 {
				phandle = <0x11>;

				pins_cmd_dat {
					pinmux = <0x5b00>;
					slew-rate = <0x00>;
					bias-disable;
					output-low;
				};
			};

			gpslna@1 {
				phandle = <0x12>;

				pins_cmd_dat {
					pinmux = <0x5b00>;
					slew-rate = <0x01>;
					output-high;
				};
			};

			gpslna@2 {
				phandle = <0x13>;

				pins_cmd_dat {
					pinmux = <0x5b00>;
					slew-rate = <0x01>;
					output-low;
				};
			};
		};
	};

	fragment@15 {
		target = <0xffffffff>;

		__overlay__ {
			pinctrl-names = "default", "gps_lna_state_init", "gps_lna_state_oh", "gps_lna_state_ol";
			pinctrl-0 = <0x10>;
			pinctrl-1 = <0x11>;
			pinctrl-2 = <0x12>;
			pinctrl-3 = <0x13>;
			status = "okay";
		};
	};

	fragment@16 {
		target = <0xffffffff>;

		__overlay__ {
			pinctrl-names = "irtx_gpio_led_default", "irtx_gpio_led_set";
			pinctrl-0 = <0x14>;
			pinctrl-1 = <0x15>;
			status = "okay";
		};
	};

	fragment@17 {
		target = <0xffffffff>;

		__overlay__ {

			irtx_gpio_led_def@gpio9 {
				phandle = <0x14>;

				pins_cmd_dat {
					pinmux = <0x900>;
					slew-rate = <0x01>;
					bias-disable;
					output-low;
					input-schmitt-enable = <0x00>;
				};
			};

			irtx_gpio_led_set@gpio9 {
				phandle = <0x15>;

				pins_cmd_dat {
					pinmux = <0x902>;
					slew-rate = <0x01>;
					output-high;
				};
			};
		};
	};

	fragment@18 {
		target = <0xffffffff>;

		__overlay__ {

			lcm_rst_out1_gpio {
				phandle = <0x16>;

				pins_cmd_dat {
					pinmux = <0x2d00>;
					slew-rate = <0x01>;
					output-high;
				};
			};

			lcm_rst_out0_gpio {
				phandle = <0x17>;

				pins_cmd_dat {
					pinmux = <0x2d00>;
					slew-rate = <0x01>;
					output-low;
				};
			};

			lcm_dsi_te {
				phandle = <0x18>;

				pins_cmd_dat {
					pinmux = <0x2c01>;
				};
			};

			6382_rst_out1_gpio {
				phandle = <0x19>;

				pins_cmd_dat {
					pinmux = <0xa500>;
					slew-rate = <0x01>;
					output-high;
				};
			};

			6382_rst_out0_gpio {
				phandle = <0x1a>;

				pins_cmd_dat {
					pinmux = <0xa500>;
					slew-rate = <0x01>;
					output-low;
				};
			};
		};
	};

	fragment@19 {
		target = <0xffffffff>;

		__overlay__ {
			pinctrl-names = "lcm_rst_out1_gpio", "lcm_rst_out0_gpio", "mode_te_te", "6382_rst_out1_gpio", "6382_rst_out0_gpio";
			pinctrl-0 = <0x16>;
			pinctrl-1 = <0x17>;
			pinctrl-2 = <0x18>;
			pinctrl-3 = <0x19>;
			pinctrl-4 = <0x1a>;
			status = "okay";
		};
	};

	fragment@20 {
		target = <0xffffffff>;

		__overlay__ {
			pinctrl-names = "lcm_rst_out1_gpio", "lcm_rst_out0_gpio", "mode_te_te", "6382_rst_out1_gpio", "6382_rst_out0_gpio";
			pinctrl-0 = <0x16>;
			pinctrl-1 = <0x17>;
			pinctrl-2 = <0x18>;
			pinctrl-3 = <0x19>;
			pinctrl-4 = <0x1a>;
			status = "okay";
		};
	};

	fragment@21 {
		target = <0xffffffff>;

		__overlay__ {
			status = "okay";
			#address-cells = <0x01>;
			#size-cells = <0x00>;
			bdg-gpios = <0xffffffff 0xa5 0x00>;

			panel1@0 {
				compatible = "tm,dsi_panel_m19a_36_02_0a_dsc_vdo";
				reg = <0x00>;
				reset-gpios = <0xffffffff 0x2d 0x00>;
				biasp-gpios = <0xffffffff 0xa6 0x00>;
				biasn-gpios = <0xffffffff 0xa9 0x00>;
				bdg-support = <0x01>;
				pinctrl-names = "default";

				port {

					endpoint {
						remote-endpoint = <0x1b>;
						phandle = <0x1c>;
					};
				};
			};

			panel2@1 {
				compatible = "csot,dsi_panel_m19a_42_03_0c_dsc_vdo";
				reg = <0x01>;
				reset-gpios = <0xffffffff 0x2d 0x00>;
				biasp-gpios = <0xffffffff 0xa6 0x00>;
				biasn-gpios = <0xffffffff 0xa9 0x00>;
				bdg-support = <0x01>;
				pinctrl-names = "default";

				port {

					endpoint {
						remote-endpoint = <0x1b>;
						phandle = <0x5d>;
					};
				};
			};

			panel3@2 {
				compatible = "csot,dsi_panel_m19a_42_03_0d_dsc_vdo";
				reg = <0x02>;
				reset-gpios = <0xffffffff 0x2d 0x00>;
				biasp-gpios = <0xffffffff 0xa6 0x00>;
				biasn-gpios = <0xffffffff 0xa9 0x00>;
				bdg-support = <0x01>;
				pinctrl-names = "default";

				port {

					endpoint {
						remote-endpoint = <0x1b>;
						phandle = <0x5e>;
					};
				};
			};

			panel4@3 {
				compatible = "csot,dsi_panel_m19a_42_03_0b_dsc_vdo";
				reg = <0x03>;
				reset-gpios = <0xffffffff 0x2d 0x00>;
				biasp-gpios = <0xffffffff 0xa6 0x00>;
				biasn-gpios = <0xffffffff 0xa9 0x00>;
				bdg-support = <0x01>;
				pinctrl-names = "default";

				port {

					endpoint {
						remote-endpoint = <0x1b>;
						phandle = <0x5f>;
					};
				};
			};

			ports {

				port {

					endpoint {
						remote-endpoint = <0x1c>;
						phandle = <0x1b>;
					};
				};
			};
		};
	};

	fragment@22 {
		target = <0xffffffff>;

		__overlay__ {
			status = "okay";
			#address-cells = <0x01>;
			#size-cells = <0x00>;
			pinctrl-names = "default";
			pinctrl-0 = <0x1d>;

			spislv@0 {
				compatible = "mediatek,spi_slave";
				reg = <0x00>;
				spi-max-frequency = <0x3473bc0>;
				spi-tx-bus-width = <0x01>;
				spi-rx-bus-width = <0x01>;
				low-speed-tick-delay = [04];
				low-speed-early-trans = [00];
				high-speed-tick-delay = [02];
				high-speed-early-trans = [00];
				slave-drive-strength = [03];
			};
		};
	};

	fragment@23 {
		target = <0xffffffff>;

		__overlay__ {

			spislv_mode_default {
				phandle = <0x1d>;

				pins_cmd_dat {
					pinmux = <0xd02 0xe02 0xf02 0x1002>;
					drive-strength = <0x03>;
				};
			};
		};
	};

	fragment@24 {
		target = <0xffffffff>;

		__overlay__ {

			bridge {
				compatible = "mediatek,disp,bdg_enabled";
				clk-xo-id = <0x02>;
				bdg_mm_clk = <0x10e>;
				bdg_rx_v12 = <0x6b8>;
				bdg_rxtx_ratio = <0xe1>;
				hs_dco_enable = <0x00>;
				lp_tx_l023_enable = <0x00>;
				g_mode_enable = <0x00>;
				phandle = <0x60>;
			};
		};
	};

	fragment@25 {
		target = <0xffffffff>;

		__overlay__ {

			lm3697@36 {
				compatible = "mediatek,ti,lm3697";
				reg = <0x36>;
				status = "okay";
				enable-gpios = <0xffffffff 0x61 0x00>;

				fault-monitor {
					compatible = "ti,lm3697-fault-monitor";
				};
			};

			ktd3136@37 {
				compatible = "mediatek,ktd,ktd3136";
				reg = <0x37>;
				status = "okay";
				enable-gpios = <0xffffffff 0x61 0x00>;
				ktd,using-lsb = <0x01>;
				ktd,pwm-frequency = <0x64>;
				ktd,bl-fscal-led = <0x98>;
				ktd,turn-on-ramp = <0x00>;
				ktd,turn-off-ramp = <0x00>;
				ktd,pwm-trans-dim = <0x00>;
				ktd,i2c-trans-dim = <0x00>;
				ktd,bl-channel = <0x02>;
				ktd,ovp-level = <0x20>;
				ktd,switching-frequency = <0x3e8>;
				ktd,inductor-current = <0x708>;
				ktd,linear_ramp = <0x01>;
				ktd,linear_backlight = <0x01>;
			};

			lcd_bias@3e {
				compatible = "mediatek,lcd_bias";
				reg = <0x3e>;
				status = "okay";
			};
		};
	};

	fragment@26 {
		target = <0xffffffff>;

		__overlay__ {

			mt6660@34 {
				compatible = "mediatek,mt6660";
				#sound-dai-cells = <0x00>;
				reg = <0x34>;
				status = "okay";
				phandle = <0x1e>;
			};
		};
	};

	fragment@27 {
		target = <0xffffffff>;

		__overlay__ {

			mediatek,speaker-codec {
				sound-dai = <0x1e>;
			};
		};
	};

	fragment@28 {
		target = <0xffffffff>;

		__overlay__ {
			status = "ok";
		};
	};

	fragment@29 {
		target = <0xffffffff>;

		__overlay__ {
			status = "ok";
		};
	};

	fragment@30 {
		target = <0xffffffff>;

		__overlay__ {

			MTEE {
				compatible = "mediatek,mtk_svp_on_mtee_support";
				phandle = <0x61>;
			};

			SecureVideoPath {
				compatible = "mediatek,mtk_sec_video_path_support";
				phandle = <0x62>;
			};
		};
	};

	fragment@31 {
		target = <0xffffffff>;

		__overlay__ {

			fpsensor_fpc_rst_low {
				phandle = <0x1f>;

				pins_cmd_dat {
					pinmux = <0xa000>;
					slew-rate = <0x01>;
					output-low;
				};
			};

			fpsensor_fpc_cs_low {
				phandle = <0x21>;

				pins_cmd_dat {
					pinmux = <0x2100>;
					slew-rate = <0x01>;
					output-low;
				};
			};

			fpsensor_fpc_rst_high {
				phandle = <0x20>;

				pins_cmd_dat {
					pinmux = <0xa000>;
					slew-rate = <0x01>;
					output-high;
				};
			};

			fpsensor_fpc_cs_high {
				phandle = <0x22>;

				pins_cmd_dat {
					pinmux = <0x2101>;
					slew-rate = <0x01>;
					bias-pull-up;
				};
			};
		};
	};

	fragment@32 {
		target = <0xffffffff>;

		__overlay__ {

			fpsensor_goodix_rst_low {
				phandle = <0x23>;

				pins_cmd_dat {
					pinmux = <0xa000>;
					slew-rate = <0x01>;
					output-low;
				};
			};

			fpsensor_goodix_rst_high {
				phandle = <0x24>;

				pins_cmd_dat {
					pinmux = <0xa000>;
					slew-rate = <0x01>;
					output-high;
				};
			};

			fpsensor_goodix_cs_low {
				phandle = <0x25>;

				pins_cmd_dat {
					pinmux = <0x2100>;
					slew-rate = <0x01>;
					output-low;
				};
			};

			fpsensor_goodix_cs_high {
				phandle = <0x26>;

				pins_cmd_dat {
					pinmux = <0x2101>;
					slew-rate = <0x01>;
					bias-pull-up;
				};
			};
		};
	};

	fragment@33 {
		target = <0xffffffff>;

		__overlay__ {

			fpc_spi@0 {
				compatible = "fpc,fpc_spi";
				reg = <0x00>;
				fpc,enable-wakeup;
				spi-max-frequency = <0x989680>;
				netlink-event = <0x1f>;
				fp_vldo28-supply = <0xffffffff>;
				pinctrl-names = "fpsensor_fpc_rst_low", "fpsensor_fpc_rst_high", "fpsensor_fpc_cs_low", "fpsensor_fpc_cs_high";
				pinctrl-0 = <0x1f>;
				pinctrl-1 = <0x20>;
				pinctrl-2 = <0x21>;
				pinctrl-3 = <0x22>;
				status = "okay";
			};
		};
	};

	fragment@34 {
		target = <0xffffffff>;

		__overlay__ {
			interrupt-parent = <0xffffffff>;
			interrupts = <0x07 0x01 0x07 0x00>;
			int-gpios = <0xffffffff 0x07 0x00>;
			fp_vldo28-supply = <0xffffffff>;
			pinctrl-names = "fpsensor_goodix_rst_low", "fpsensor_goodix_rst_high", "fpsensor_goodix_cs_low", "fpsensor_goodix_cs_high";
			pinctrl-0 = <0x23>;
			pinctrl-1 = <0x24>;
			pinctrl-2 = <0x25>;
			pinctrl-3 = <0x26>;
			status = "okay";
		};
	};

	fragment@35 {
		target = <0xffffffff>;

		__overlay__ {

			adc_channel@ {
				compatible = "mediatek,adc_channel";
				mediatek,temperature0 = <0x00>;
				mediatek,temperature1 = <0x01>;
				mediatek,adc_fdd_rf_params_dynamic_custom_ch = <0x02>;
				status = "okay";
			};
		};
	};

	fragment@36 {
		target = <0xffffffff>;

		__overlay__ {
			io-channels = <0xffffffff 0x02>;
		};
	};

	fragment@37 {
		target = <0xffffffff>;

		__overlay__ {
			mediatek,clkbuf-quantity = <0x07>;
			mediatek,clkbuf-config = <0x02 0x01 0x01 0x02 0x00 0x00 0x00>;
			mediatek,clkbuf-driving-current = <0x01 0x01 0x01 0x01 0x01 0x01 0x01>;
			status = "okay";
		};
	};

	fragment@38 {
		target = <0xffffffff>;

		__overlay__ {
			#address-cells = <0x01>;
			#size-cells = <0x00>;
			clock-frequency = <0x61a80>;
			mediatek,use-open-drain;

			camera_sub@2d {
				compatible = "mediatek,camera_sub";
				reg = <0x2d>;
				status = "okay";
				phandle = <0x63>;
			};

			camera_sub_eeprom@51 {
				compatible = "mediatek,camera_sub_eeprom";
				reg = <0x51>;
				status = "okay";
				phandle = <0x64>;
			};

			camera_sub_two@6c {
				compatible = "mediatek,camera_sub_two";
				reg = <0x6c>;
				status = "okay";
				phandle = <0x65>;
			};

			camera_sub_two_eeprom@52 {
				compatible = "mediatek,camera_sub_two_eeprom";
				reg = <0x52>;
				status = "okay";
				phandle = <0x66>;
			};
		};
	};

	fragment@39 {
		target = <0xffffffff>;

		__overlay__ {
			#address-cells = <0x01>;
			#size-cells = <0x00>;
			clock-frequency = <0x61a80>;
			mediatek,use-open-drain;
		};
	};

	fragment@40 {
		target = <0xffffffff>;

		__overlay__ {
			#address-cells = <0x01>;
			#size-cells = <0x00>;
			clock-frequency = <0xf4240>;
			mediatek,use-open-drain;

			camera_main@1a {
				compatible = "mediatek,camera_main";
				reg = <0x1a>;
				status = "okay";
				phandle = <0x67>;
			};

			camera_main_eeprom@51 {
				compatible = "mediatek,camera_main_eeprom";
				reg = <0x51>;
				status = "okay";
				phandle = <0x68>;
			};

			camera_main_af@0c {
				compatible = "mediatek,camera_main_af";
				reg = <0x0c>;
				status = "okay";
				phandle = <0x69>;
			};

			ccu_sensor_i2c_2_hw@11 {
				compatible = "mediatek,ccu_sensor_i2c_2_hw";
				reg = <0x11>;
				status = "okay";
				phandle = <0x6a>;
			};
		};
	};

	fragment@41 {
		target = <0xffffffff>;

		__overlay__ {
			#address-cells = <0x01>;
			#size-cells = <0x00>;
			clock-frequency = <0x61a80>;
			mediatek,use-open-drain;
		};
	};

	fragment@42 {
		target = <0xffffffff>;

		__overlay__ {
			#address-cells = <0x01>;
			#size-cells = <0x00>;
			clock-frequency = <0x61a80>;
			mediatek,use-open-drain;

			camera_main_two@34 {
				compatible = "mediatek,camera_main_two";
				reg = <0x34>;
				status = "okay";
				phandle = <0x6b>;
			};

			camera_main_two_eeprom@50 {
				compatible = "mediatek,camera_main_two_eeprom";
				reg = <0x50>;
				status = "okay";
				phandle = <0x6c>;
			};

			ccu_sensor_i2c_4_hw@12 {
				compatible = "mediatek,ccu_sensor_i2c_4_hw";
				reg = <0x12>;
				status = "okay";
				phandle = <0x6d>;
			};
		};
	};

	fragment@43 {
		target = <0xffffffff>;

		__overlay__ {
			#address-cells = <0x01>;
			#size-cells = <0x00>;
			clock-frequency = <0x61a80>;
			mediatek,use-open-drain;
		};
	};

	fragment@44 {
		target = <0xffffffff>;

		__overlay__ {
			#address-cells = <0x01>;
			#size-cells = <0x00>;
			clock-frequency = <0x61a80>;
			mediatek,use-open-drain;
		};
	};

	fragment@45 {
		target = <0xffffffff>;

		__overlay__ {
			#address-cells = <0x01>;
			#size-cells = <0x00>;
			clock-frequency = <0x61a80>;
			mediatek,use-open-drain;

			slave_charger@4b {
				compatible = "mediatek,slave_charger";
				reg = <0x4b>;
				status = "okay";
				phandle = <0x6e>;
			};
		};
	};

	fragment@46 {
		target = <0xffffffff>;

		__overlay__ {
			#address-cells = <0x01>;
			#size-cells = <0x00>;
			clock-frequency = <0x61a80>;
			mediatek,use-open-drain;
		};
	};

	fragment@47 {
		target = <0xffffffff>;

		__overlay__ {
			GPIO_FDD_BAND_SUPPORT_DETECT_3RD_PIN = <0xffffffff 0x14 0x00>;
			GPIO_FDD_BAND_SUPPORT_DETECT_4TH_PIN = <0xffffffff 0x18 0x00>;
			GPIO_FDD_BAND_SUPPORT_DETECT_2ND_PIN = <0xffffffff 0x24 0x00>;
			GPIO_FDD_BAND_SUPPORT_DETECT_1ST_PIN = <0xffffffff 0x25 0x00>;
			GPIO_SIM2_HOT_PLUG = <0xffffffff 0x2e 0x00>;
			GPIO_SIM1_HOT_PLUG = <0xffffffff 0x2f 0x00>;
			GPIO_SIM2_SIO = <0xffffffff 0x9b 0x00>;
			GPIO_SIM2_SRST = <0xffffffff 0x9c 0x00>;
			GPIO_SIM2_SCLK = <0xffffffff 0x9d 0x00>;
			GPIO_SIM1_SCLK = <0xffffffff 0xac 0x00>;
			GPIO_SIM1_SRST = <0xffffffff 0xad 0x00>;
			GPIO_SIM1_SIO = <0xffffffff 0xae 0x00>;
		};
	};

	fragment@48 {
		target = <0xffffffff>;

		__overlay__ {
			gpio_init_default = <0x00 0x00 0x00 0x00 0x01 0x01 0x01 0x01 0x00 0x00 0x00 0x01 0x01 0x01 0x02 0x00 0x00 0x00 0x01 0x01 0x01 0x03 0x00 0x00 0x00 0x01 0x00 0x01 0x04 0x00 0x00 0x00 0x01 0x00 0x00 0x05 0x00 0x00 0x00 0x01 0x01 0x00 0x06 0x00 0x00 0x00 0x01 0x00 0x00 0x07 0x00 0x00 0x00 0x01 0x00 0x00 0x08 0x00 0x01 0x00 0x00 0x00 0x00 0x09 0x02 0x00 0x00 0x01 0x00 0x00 0x0a 0x00 0x00 0x00 0x01 0x01 0x00 0x0b 0x01 0x00 0x00 0x01 0x00 0x00 0x0c 0x02 0x00 0x00 0x01 0x00 0x00 0x0d 0x02 0x00 0x00 0x01 0x00 0x00 0x0e 0x02 0x01 0x00 0x00 0x00 0x00 0x0f 0x02 0x01 0x00 0x00 0x00 0x00 0x10 0x02 0x01 0x00 0x00 0x00 0x00 0x11 0x00 0x01 0x00 0x01 0x00 0x01 0x12 0x00 0x00 0x00 0x01 0x00 0x01 0x13 0x00 0x01 0x00 0x01 0x00 0x01 0x14 0x00 0x00 0x00 0x01 0x00 0x01 0x15 0x00 0x01 0x00 0x00 0x00 0x00 0x16 0x00 0x01 0x00 0x00 0x00 0x00 0x17 0x00 0x01 0x00 0x00 0x00 0x00 0x18 0x00 0x00 0x00 0x01 0x00 0x00 0x19 0x02 0x01 0x00 0x00 0x00 0x00 0x1a 0x02 0x01 0x00 0x00 0x00 0x00 0x1b 0x02 0x01 0x00 0x00 0x00 0x00 0x1c 0x02 0x00 0x00 0x00 0x00 0x00 0x1d 0x00 0x01 0x00 0x00 0x00 0x00 0x1e 0x00 0x01 0x00 0x00 0x00 0x00 0x1f 0x00 0x00 0x00 0x01 0x00 0x00 0x20 0x01 0x01 0x00 0x00 0x00 0x00 0x21 0x00 0x01 0x00 0x00 0x00 0x00 0x22 0x01 0x00 0x00 0x01 0x00 0x00 0x23 0x01 0x00 0x00 0x01 0x00 0x00 0x24 0x00 0x00 0x00 0x01 0x00 0x00 0x25 0x00 0x00 0x00 0x01 0x00 0x00 0x26 0x00 0x00 0x00 0x01 0x00 0x00 0x27 0x00 0x00 0x00 0x01 0x00 0x01 0x28 0x00 0x00 0x00 0x01 0x00 0x00 0x29 0x00 0x00 0x00 0x01 0x01 0x01 0x2a 0x00 0x00 0x00 0x01 0x01 0x01 0x2b 0x01 0x01 0x00 0x00 0x00 0x00 0x2c 0x01 0x00 0x00 0x01 0x00 0x00 0x2d 0x00 0x01 0x00 0x00 0x00 0x00 0x2e 0x01 0x00 0x00 0x01 0x01 0x00 0x2f 0x01 0x00 0x00 0x01 0x01 0x00 0x30 0x01 0x00 0x00 0x01 0x01 0x01 0x31 0x01 0x00 0x00 0x01 0x01 0x01 0x32 0x01 0x00 0x00 0x01 0x01 0x01 0x33 0x01 0x00 0x00 0x01 0x01 0x01 0x34 0x00 0x00 0x00 0x00 0x00 0x00 0x35 0x01 0x00 0x00 0x01 0x00 0x00 0x36 0x01 0x00 0x00 0x01 0x00 0x00 0x37 0x01 0x00 0x00 0x01 0x00 0x00 0x38 0x01 0x00 0x00 0x01 0x00 0x00 0x39 0x01 0x00 0x00 0x01 0x00 0x00 0x3a 0x00 0x00 0x00 0x01 0x00 0x00 0x3b 0x01 0x00 0x00 0x01 0x00 0x00 0x3c 0x01 0x00 0x00 0x01 0x00 0x00 0x3d 0x01 0x00 0x00 0x01 0x00 0x00 0x3e 0x01 0x00 0x00 0x01 0x00 0x00 0x3f 0x01 0x00 0x00 0x01 0x00 0x00 0x40 0x01 0x00 0x00 0x01 0x00 0x00 0x41 0x01 0x00 0x00 0x01 0x00 0x00 0x42 0x01 0x00 0x00 0x01 0x00 0x00 0x43 0x01 0x00 0x00 0x01 0x00 0x00 0x44 0x01 0x00 0x00 0x01 0x00 0x00 0x45 0x01 0x00 0x00 0x01 0x00 0x00 0x46 0x01 0x00 0x00 0x01 0x00 0x00 0x47 0x01 0x00 0x00 0x01 0x00 0x00 0x48 0x01 0x00 0x00 0x01 0x00 0x00 0x49 0x01 0x00 0x00 0x01 0x00 0x00 0x4a 0x01 0x00 0x00 0x01 0x00 0x00 0x4b 0x01 0x00 0x00 0x01 0x00 0x00 0x4c 0x01 0x00 0x00 0x01 0x00 0x00 0x4d 0x01 0x00 0x00 0x01 0x00 0x00 0x4e 0x01 0x00 0x00 0x01 0x00 0x00 0x4f 0x00 0x00 0x00 0x01 0x00 0x00 0x50 0x00 0x00 0x00 0x00 0x00 0x00 0x51 0x02 0x00 0x00 0x01 0x01 0x01 0x52 0x01 0x00 0x00 0x01 0x01 0x01 0x53 0x01 0x00 0x00 0x01 0x01 0x01 0x54 0x02 0x00 0x00 0x01 0x01 0x01 0x55 0x02 0x00 0x00 0x01 0x00 0x00 0x56 0x02 0x01 0x00 0x00 0x00 0x00 0x57 0x02 0x01 0x00 0x00 0x00 0x00 0x58 0x02 0x01 0x00 0x00 0x00 0x00 0x59 0x01 0x00 0x00 0x01 0x01 0x01 0x5a 0x01 0x00 0x00 0x01 0x01 0x01 0x5b 0x00 0x01 0x00 0x01 0x00 0x00 0x5c 0x01 0x01 0x00 0x00 0x00 0x00 0x5d 0x01 0x00 0x00 0x01 0x01 0x00 0x5e 0x01 0x00 0x00 0x01 0x01 0x00 0x5f 0x01 0x00 0x00 0x01 0x01 0x00 0x60 0x01 0x01 0x00 0x00 0x00 0x00 0x61 0x00 0x01 0x00 0x00 0x00 0x00 0x62 0x00 0x01 0x00 0x00 0x00 0x00 0x63 0x01 0x01 0x00 0x00 0x00 0x00 0x64 0x01 0x01 0x00 0x00 0x00 0x00 0x65 0x00 0x01 0x00 0x00 0x00 0x00 0x66 0x00 0x00 0x00 0x01 0x00 0x00 0x67 0x01 0x00 0x00 0x01 0x01 0x01 0x68 0x01 0x00 0x00 0x01 0x01 0x01 0x69 0x01 0x00 0x00 0x01 0x01 0x01 0x6a 0x01 0x00 0x00 0x01 0x01 0x01 0x6b 0x00 0x01 0x00 0x00 0x00 0x00 0x6c 0x00 0x00 0x00 0x00 0x00 0x00 0x6d 0x00 0x01 0x00 0x00 0x00 0x00 0x6e 0x00 0x01 0x00 0x00 0x00 0x00 0x6f 0x01 0x01 0x00 0x00 0x00 0x00 0x70 0x00 0x00 0x00 0x00 0x00 0x00 0x71 0x00 0x00 0x00 0x01 0x00 0x00 0x72 0x00 0x00 0x00 0x01 0x00 0x00 0x73 0x00 0x00 0x00 0x01 0x00 0x00 0x74 0x00 0x00 0x00 0x01 0x00 0x00 0x75 0x00 0x00 0x00 0x01 0x00 0x00 0x76 0x00 0x00 0x00 0x01 0x00 0x00 0x77 0x00 0x00 0x00 0x01 0x00 0x00 0x78 0x00 0x00 0x00 0x01 0x00 0x00 0x79 0x00 0x00 0x00 0x01 0x00 0x00 0x86 0x01 0x00 0x00 0x01 0x00 0x01 0x87 0x01 0x01 0x00 0x00 0x00 0x00 0x88 0x01 0x01 0x00 0x00 0x00 0x00 0x89 0x01 0x01 0x00 0x00 0x00 0x00 0x8a 0x01 0x01 0x00 0x00 0x00 0x00 0x8b 0x01 0x01 0x00 0x00 0x00 0x00 0x8c 0x01 0x00 0x00 0x01 0x00 0x00 0x8d 0x01 0x00 0x00 0x01 0x00 0x00 0x8e 0x01 0x00 0x00 0x01 0x00 0x00 0x8f 0x01 0x00 0x00 0x01 0x00 0x00 0x90 0x01 0x00 0x00 0x01 0x00 0x00 0x91 0x01 0x01 0x00 0x00 0x00 0x00 0x92 0x01 0x01 0x00 0x00 0x00 0x00 0x93 0x01 0x01 0x00 0x00 0x00 0x00 0x94 0x01 0x01 0x00 0x00 0x00 0x00 0x95 0x01 0x01 0x00 0x00 0x00 0x00 0x96 0x04 0x00 0x00 0x01 0x01 0x00 0x97 0x00 0x01 0x00 0x00 0x00 0x00 0x98 0x05 0x00 0x00 0x01 0x01 0x00 0x99 0x05 0x01 0x00 0x00 0x00 0x00 0x9a 0x01 0x01 0x00 0x00 0x00 0x00 0x9b 0x01 0x00 0x00 0x01 0x01 0x00 0x9c 0x01 0x01 0x00 0x00 0x00 0x00 0x9d 0x01 0x01 0x00 0x00 0x00 0x00 0x9e 0x00 0x01 0x00 0x00 0x00 0x00 0x9f 0x00 0x01 0x00 0x00 0x00 0x00 0xa0 0x00 0x01 0x00 0x00 0x00 0x00 0xa1 0x01 0x00 0x00 0x01 0x01 0x01 0xa2 0x01 0x00 0x00 0x01 0x01 0x01 0xa3 0x01 0x00 0x00 0x01 0x01 0x01 0xa4 0x01 0x00 0x00 0x01 0x01 0x01 0xa5 0x00 0x01 0x00 0x00 0x00 0x00 0xa6 0x00 0x01 0x00 0x00 0x00 0x00 0xa7 0x01 0x00 0x00 0x01 0x00 0x00 0xa8 0x01 0x00 0x00 0x01 0x00 0x00 0xa9 0x00 0x01 0x00 0x00 0x00 0x00 0xaa 0x01 0x00 0x00 0x01 0x01 0x01 0xab 0x01 0x01 0x00 0x00 0x00 0x01 0xac 0x01 0x01 0x00 0x00 0x00 0x00 0xad 0x01 0x01 0x00 0x00 0x00 0x00 0xae 0x01 0x00 0x00 0x01 0x01 0x00 0xaf 0x03 0x00 0x00 0x01 0x01 0x01 0xb0 0x03 0x00 0x00 0x01 0x01 0x01 0xb2 0x00 0x01 0x00 0x00 0x00 0x00 0xb3 0x00 0x01 0x00 0x00 0x00 0x00 0xb4 0x00 0x00 0x00 0x01 0x00 0x00 0xb5 0x00 0x00 0x00 0x01 0x00 0x00 0xb6 0x00 0x00 0x00 0x01 0x00 0x00 0xb7 0x00 0x00 0x00 0x01 0x00 0x00 0xb8 0x00 0x00 0x00 0x01 0x00 0x00 0xb9 0x00 0x00 0x00 0x01 0x00 0x00 0xba 0x00 0x00 0x00 0x01 0x00 0x00>;
		};
	};

	fragment@49 {
		target = <0xffffffff>;

		__overlay__ {
			interrupt-parent = <0xffffffff>;
			interrupts = <0x02 0x08 0x02 0x00>;
			status = "okay";
		};
	};

	fragment@50 {
		target = <0xffffffff>;

		__overlay__ {
			interrupt-parent = <0xffffffff>;
			interrupts = <0x06 0x08 0x06 0x00>;
			status = "okay";
		};
	};

	fragment@51 {
		target = <0xffffffff>;

		__overlay__ {
			interrupt-parent = <0xffffffff>;
			interrupts = <0x09 0x01 0x09 0x02>;
			status = "okay";
		};
	};

	fragment@52 {
		target = <0xffffffff>;

		__overlay__ {
			interrupt-parent = <0xffffffff>;
			interrupts = <0x12 0x01 0x12 0x00>;
			status = "okay";
		};
	};

	fragment@53 {
		target = <0xffffffff>;

		__overlay__ {
			interrupt-parent = <0xffffffff>;
			interrupts = <0x14 0x02 0x14 0x00>;
			status = "okay";
		};
	};

	fragment@54 {
		target = <0xffffffff>;

		__overlay__ {
			interrupt-parent = <0xffffffff>;
			interrupts = <0x27 0x08 0x27 0x00>;
			status = "okay";
		};
	};

	fragment@55 {
		target = <0xffffffff>;

		__overlay__ {
			interrupt-parent = <0xffffffff>;
			interrupts = <0x29 0x02 0x29 0x00>;
			status = "okay";
		};
	};

	fragment@56 {
		target = <0xffffffff>;

		__overlay__ {
			interrupt-parent = <0xffffffff>;
			interrupts = <0x2a 0x02 0x2a 0x00>;
			status = "okay";
		};
	};

	fragment@57 {
		target = <0xffffffff>;

		__overlay__ {
			interrupt-parent = <0xffffffff>;
			interrupts = <0x2c 0x01 0x2c 0x01>;
			status = "okay";
		};
	};

	fragment@58 {
		target = <0xffffffff>;

		__overlay__ {
			interrupt-parent = <0xffffffff>;
			interrupts = <0x34 0x08 0x34 0x00>;
			deb-gpios = <0xffffffff 0x34 0x00>;
			debounce = <0x3e800>;
			status = "okay";
		};
	};

	fragment@59 {
		target = <0xffffffff>;

		__overlay__ {
			interrupt-parent = <0xffffffff>;
			interrupts = <0x90 0x04 0xb4 0x00>;
			status = "okay";
		};
	};

	fragment@60 {
		target = <0xffffffff>;

		__overlay__ {
			compatible = "mediatek,md1_sim1_hot_plug_eint-eint";
			interrupts = <0x00 0x08>;
			debounce = <0x00 0x2710>;
			dedicated = <0x00 0x00>;
			src_pin = <0x00 0x01>;
			sockettype = <0x00 0x00>;
			status = "okay";
		};
	};

	fragment@61 {
		target = <0xffffffff>;

		__overlay__ {
			regulator-name = "vcama1";
			regulator-default-on = <0x01>;
			status = "okay";
		};
	};

	fragment@62 {
		target = <0xffffffff>;

		__overlay__ {
			regulator-name = "vcama2";
			regulator-default-on = <0x01>;
			status = "okay";
		};
	};

	fragment@63 {
		target = <0xffffffff>;

		__overlay__ {
			regulator-name = "vcamd";
			regulator-default-on = <0x01>;
			status = "okay";
		};
	};

	fragment@64 {
		target = <0xffffffff>;

		__overlay__ {
			regulator-name = "vcamio";
			regulator-default-on = <0x01>;
			status = "okay";
		};
	};

	fragment@65 {
		target = <0xffffffff>;

		__overlay__ {
			regulator-name = "vldo28";
			regulator-default-on = <0x01>;
			status = "okay";
		};
	};

	fragment@66 {
		target = <0xffffffff>;

		__overlay__ {
			vcama-supply = <0xffffffff>;
			vcama_sub-supply = <0xffffffff>;
			vcama_main2-supply = <0xffffffff>;
			vcamd_main2-supply = <0xffffffff>;
			vcamio-supply = <0xffffffff>;
			vcamio_sub-supply = <0xffffffff>;
			vcamio_main2-supply = <0xffffffff>;
			vcamio_sub2-supply = <0xffffffff>;
			vcamaf-supply = <0xffffffff>;
			vcamaf_sub-supply = <0xffffffff>;
			vcamaf_main2-supply = <0xffffffff>;
			status = "okay";
		};
	};

	fragment@67 {
		target = <0xffffffff>;

		__overlay__ {
			vtouch-supply = <0xffffffff>;
			status = "okay";
		};
	};

	fragment@68 {
		target = <0xffffffff>;

		__overlay__ {
			mediatek,kpd-key-debounce = <0x400>;
			mediatek,kpd-sw-pwrkey = <0x74>;
			mediatek,kpd-hw-pwrkey = <0x08>;
			mediatek,kpd-sw-rstkey = <0x72>;
			mediatek,kpd-hw-rstkey = <0x11>;
			mediatek,kpd-use-extend-type = <0x00>;
			mediatek,kpd-hw-map-num = <0x48>;
			mediatek,kpd-hw-init-map = <0x00 0x73 0x00 0x00 0x00 0x00 0x00 0x00 0x00 0x00 0x00 0x00 0x00 0x00 0x00 0x00 0x00 0x00 0x00 0x00 0x00 0x00 0x00 0x00 0x00 0x00 0x00 0x00 0x00 0x00 0x00 0x00 0x00 0x00 0x00 0x00 0x00 0x00 0x00 0x00 0x00 0x00 0x00 0x00 0x00 0x00 0x00 0x00 0x00 0x00 0x00 0x00 0x00 0x00 0x00 0x00 0x00 0x00 0x00 0x00 0x00 0x00 0x00 0x00 0x00 0x00 0x00 0x00 0x00 0x00 0x00 0x00>;
			mediatek,kpd-pwrkey-eint-gpio = <0x00>;
			mediatek,kpd-pwkey-gpio-din = <0x00>;
			mediatek,kpd-hw-dl-key0 = <0x01>;
			mediatek,kpd-hw-dl-key1 = <0x11>;
			mediatek,kpd-hw-dl-key2 = <0x08>;
			mediatek,kpd-hw-recovery-key = <0x01>;
			mediatek,kpd-hw-factory-key = <0x11>;
			status = "okay";
		};
	};

	fragment@69 {
		target = <0xffffffff>;

		__overlay__ {
			tpd-resolution = <0x438 0x99c>;
			use-tpd-button = <0x00>;
			tpd-key-num = <0x0a>;
			tpd-key-local = <0x8b 0xac 0x9e 0x00>;
			tpd-key-dim-local = <0x3c 0x352 0x32 0x1e 0xb4 0x352 0x32 0x1e 0x12c 0x352 0x32 0x1e 0x1a4 0x352 0x32 0x1e>;
			tpd-max-touch-num = <0x0a>;
			tpd-filter-enable = <0x01>;
			tpd-filter-pixel-density = <0x7c>;
			tpd-filter-custom-prameters = <0x00 0x00 0x00 0x00 0x00 0x00 0x00 0x00 0x00 0x00 0x00 0x00>;
			tpd-filter-custom-speed = <0x00 0x00 0x00>;
			pinctrl-names = "default", "state_eint_as_int", "state_eint_output0", "state_eint_output1", "state_rst_output0", "state_rst_output1";
			pinctrl-0 = <0x27>;
			pinctrl-1 = <0x28>;
			pinctrl-2 = <0x29>;
			pinctrl-3 = <0x2a>;
			pinctrl-4 = <0x2b>;
			pinctrl-5 = <0x2c>;
			status = "okay";
		};
	};

	fragment@70 {
		target = <0xffffffff>;

		__overlay__ {

			eintdefault {
				phandle = <0x27>;
			};

			eint1touch {
				phandle = <0x28>;

				pins_cmd_dat {
					pinmux = <0x200>;
					slew-rate = <0x00>;
					bias-disable;
					input-enable;
				};
			};

			eintoutput0 {
				phandle = <0x29>;

				pins_cmd_dat {
					pinmux = <0x200>;
					slew-rate = <0x01>;
					output-low;
				};
			};

			eintoutput1 {
				phandle = <0x2a>;

				pins_cmd_dat {
					pinmux = <0x200>;
					slew-rate = <0x01>;
					output-high;
				};
			};

			rstoutput0 {
				phandle = <0x2b>;

				pins_cmd_dat {
					pinmux = <0x1600>;
					slew-rate = <0x01>;
					output-low;
				};
			};

			rstoutput1 {
				phandle = <0x2c>;

				pins_cmd_dat {
					pinmux = <0x1600>;
					slew-rate = <0x01>;
					output-high;
				};
			};
		};
	};

	fragment@71 {
		target = <0xffffffff>;

		__overlay__ {
			status = "ok";

			novatek@1 {
				compatible = "novatek,NVT-ts-spi", "focaltech,fts";
				reg = <0x00>;
				status = "ok";
				spi-max-frequency = <0x927c00>;
				novatek,reset-gpio = <0xffffffff 0x16 0x00>;
				novatek,irq-gpio = <0xffffffff 0x02 0x2001>;
				interrupt-parent = <0xffffffff>;
				interrupts = <0x01 0x02>;
				focaltech,reset-gpio = <0xffffffff 0x16 0x00>;
				focaltech,irq-gpio = <0xffffffff 0x02 0x2001>;
				focaltech,max-touch-number = <0x0a>;
				focaltech,display-coords = <0x00 0x00 0x2a30 0x6018>;
				novatek,swrst-n8-addr = <0x3f0fe>;
				novatek,mp-support-dt;

				novatek-mp-criteria-5955@0 {
					#address-cells = <0x01>;
					#size-cells = <0x00>;
					compatible = "novatek-mp-criteria-5955";
					IC_X_CFG_SIZE = <0x12>;
					IC_Y_CFG_SIZE = <0x24>;
					IC_KEY_CFG_SIZE = <0x04>;
					X_Channel = <0x12>;
					Y_Channel = <0x24>;
					AIN_X = <0x00 0x01 0x02 0x03 0x04 0x05 0x06 0x07 0x08 0x09 0x0a 0x0b 0x0c 0x0d 0x0e 0x0f 0x10 0x11>;
					AIN_Y = <0x00 0x01 0x02 0x03 0x04 0x05 0x06 0x07 0x08 0x09 0x0a 0x0b 0x0c 0x0d 0x0e 0x0f 0x10 0x11 0x12 0x13 0x14 0x15 0x16 0x17 0x18 0x19 0x1a 0x1b 0x1c 0x1d 0x1e 0x1f 0x20 0x21 0x22 0x23>;
					AIN_KEY = <0x00 0x01 0x02 0xff>;
					PS_Config_Lmt_Short_Rawdata_P = <0x36b8 0x36b8 0x36b8 0x36b8 0x36b8 0x36b8 0x36b8 0x36b8 0x36b8 0x36b8 0x36b8 0x36b8 0x36b8 0x36b8 0x36b8 0x36b8 0x36b8 0x36b8 0x36b8 0x36b8 0x36b8 0x36b8 0x36b8 0x36b8 0x36b8 0x36b8 0x36b8 0x36b8 0x36b8 0x36b8 0x36b8 0x36b8 0x36b8 0x36b8 0x36b8 0x36b8 0x36b8 0x36b8 0x36b8 0x36b8 0x36b8 0x36b8 0x36b8 0x36b8 0x36b8 0x36b8 0x36b8 0x36b8 0x36b8 0x36b8 0x36b8 0x36b8 0x36b8 0x36b8 0x36b8 0x36b8 0x36b8 0x36b8 0x36b8 0x36b8 0x36b8 0x36b8 0x36b8 0x36b8 0x36b8 0x36b8 0x36b8 0x36b8 0x36b8 0x36b8 0x36b8 0x36b8 0x36b8 0x36b8 0x36b8 0x36b8 0x36b8 0x36b8 0x36b8 0x36b8 0x36b8 0x36b8 0x36b8 0x36b8 0x36b8 0x36b8 0x36b8 0x36b8 0x36b8 0x36b8 0x36b8 0x36b8 0x36b8 0x36b8 0x36b8 0x36b8 0x36b8 0x36b8 0x36b8 0x36b8 0x36b8 0x36b8 0x36b8 0x36b8 0x36b8 0x36b8 0x36b8 0x36b8 0x36b8 0x36b8 0x36b8 0x36b8 0x36b8 0x36b8 0x36b8 0x36b8 0x36b8 0x36b8 0x36b8 0x36b8 0x36b8 0x36b8 0x36b8 0x36b8 0x36b8 0x36b8 0x36b8 0x36b8 0x36b8 0x36b8 0x36b8 0x36b8 0x36b8 0x36b8 0x36b8 0x36b8 0x36b8 0x36b8 0x36b8 0x36b8 0x36b8 0x36b8 0x36b8 0x36b8 0x36b8 0x36b8 0x36b8 0x36b8 0x36b8 0x36b8 0x36b8 0x36b8 0x36b8 0x36b8 0x36b8 0x36b8 0x36b8 0x36b8 0x36b8 0x36b8 0x36b8 0x36b8 0x36b8 0x36b8 0x36b8 0x36b8 0x36b8 0x36b8 0x36b8 0x36b8 0x36b8 0x36b8 0x36b8 0x36b8 0x36b8 0x36b8 0x36b8 0x36b8 0x36b8 0x36b8 0x36b8 0x36b8 0x36b8 0x36b8 0x36b8 0x36b8 0x36b8 0x36b8 0x36b8 0x36b8 0x36b8 0x36b8 0x36b8 0x36b8 0x36b8 0x36b8 0x36b8 0x36b8 0x36b8 0x36b8 0x36b8 0x36b8 0x36b8 0x36b8 0x36b8 0x36b8 0x36b8 0x36b8 0x36b8 0x36b8 0x36b8 0x36b8 0x36b8 0x36b8 0x36b8 0x36b8 0x36b8 0x36b8 0x36b8 0x36b8 0x36b8 0x36b8 0x36b8 0x36b8 0x36b8 0x36b8 0x36b8 0x36b8 0x36b8 0x36b8 0x36b8 0x36b8 0x36b8 0x36b8 0x36b8 0x36b8 0x36b8 0x36b8 0x36b8 0x36b8 0x36b8 0x36b8 0x36b8 0x36b8 0x36b8 0x36b8 0x36b8 0x36b8 0x36b8 0x36b8 0x36b8 0x36b8 0x36b8 0x36b8 0x36b8 0x36b8 0x36b8 0x36b8 0x36b8 0x36b8 0x36b8 0x36b8 0x36b8 0x36b8 0x36b8 0x36b8 0x36b8 0x36b8 0x36b8 0x36b8 0x36b8 0x36b8 0x36b8 0x36b8 0x36b8 0x36b8 0x36b8 0x36b8 0x36b8 0x36b8 0x36b8 0x36b8 0x36b8 0x36b8 0x36b8 0x36b8 0x36b8 0x36b8 0x36b8 0x36b8 0x36b8 0x36b8 0x36b8 0x36b8 0x36b8 0x36b8 0x36b8 0x36b8 0x36b8 0x36b8 0x36b8 0x36b8 0x36b8 0x36b8 0x36b8 0x36b8 0x36b8 0x36b8 0x36b8 0x36b8 0x36b8 0x36b8 0x36b8 0x36b8 0x36b8 0x36b8 0x36b8 0x36b8 0x36b8 0x36b8 0x36b8 0x36b8 0x36b8 0x36b8 0x36b8 0x36b8 0x36b8 0x36b8 0x36b8 0x36b8 0x36b8 0x36b8 0x36b8 0x36b8 0x36b8 0x36b8 0x36b8 0x36b8 0x36b8 0x36b8 0x36b8 0x36b8 0x36b8 0x36b8 0x36b8 0x36b8 0x36b8 0x36b8 0x36b8 0x36b8 0x36b8 0x36b8 0x36b8 0x36b8 0x36b8 0x36b8 0x36b8 0x36b8 0x36b8 0x36b8 0x36b8 0x36b8 0x36b8 0x36b8 0x36b8 0x36b8 0x36b8 0x36b8 0x36b8 0x36b8 0x36b8 0x36b8 0x36b8 0x36b8 0x36b8 0x36b8 0x36b8 0x36b8 0x36b8 0x36b8 0x36b8 0x36b8 0x36b8 0x36b8 0x36b8 0x36b8 0x36b8 0x36b8 0x36b8 0x36b8 0x36b8 0x36b8 0x36b8 0x36b8 0x36b8 0x36b8 0x36b8 0x36b8 0x36b8 0x36b8 0x36b8 0x36b8 0x36b8 0x36b8 0x36b8 0x36b8 0x36b8 0x36b8 0x36b8 0x36b8 0x36b8 0x36b8 0x36b8 0x36b8 0x36b8 0x36b8 0x36b8 0x36b8 0x36b8 0x36b8 0x36b8 0x36b8 0x36b8 0x36b8 0x36b8 0x36b8 0x36b8 0x36b8 0x36b8 0x36b8 0x36b8 0x36b8 0x36b8 0x36b8 0x36b8 0x36b8 0x36b8 0x36b8 0x36b8 0x36b8 0x36b8 0x36b8 0x36b8 0x36b8 0x36b8 0x36b8 0x36b8 0x36b8 0x36b8 0x36b8 0x36b8 0x36b8 0x36b8 0x36b8 0x36b8 0x36b8 0x36b8 0x36b8 0x36b8 0x36b8 0x36b8 0x36b8 0x36b8 0x36b8 0x36b8 0x36b8 0x36b8 0x36b8 0x36b8 0x36b8 0x36b8 0x36b8 0x36b8 0x36b8 0x36b8 0x36b8 0x36b8 0x36b8 0x36b8 0x36b8 0x36b8 0x36b8 0x36b8 0x36b8 0x36b8 0x36b8 0x36b8 0x36b8 0x36b8 0x36b8 0x36b8 0x36b8 0x36b8 0x36b8 0x36b8 0x36b8 0x36b8 0x36b8 0x36b8 0x36b8 0x36b8 0x36b8 0x36b8 0x36b8 0x36b8 0x36b8 0x36b8 0x36b8 0x36b8 0x36b8 0x36b8 0x36b8 0x36b8 0x36b8 0x36b8 0x36b8 0x36b8 0x36b8 0x36b8 0x36b8 0x36b8 0x36b8 0x36b8 0x36b8 0x36b8 0x36b8 0x36b8 0x36b8 0x36b8 0x36b8 0x36b8 0x36b8 0x36b8 0x36b8 0x36b8 0x36b8 0x36b8 0x36b8 0x36b8 0x36b8 0x36b8 0x36b8 0x36b8 0x36b8 0x36b8 0x36b8 0x36b8 0x36b8 0x36b8 0x36b8 0x36b8 0x36b8 0x36b8 0x36b8 0x36b8 0x36b8 0x36b8 0x36b8 0x36b8 0x36b8 0x36b8 0x36b8 0x36b8 0x36b8 0x36b8 0x36b8 0x36b8 0x36b8 0x36b8 0x36b8 0x36b8 0x36b8 0x36b8 0x36b8 0x36b8 0x36b8 0x36b8 0x36b8 0x36b8>;
					PS_Config_Lmt_Short_Rawdata_N = <0x2710 0x2710 0x2710 0x2710 0x2710 0x2710 0x2710 0x2710 0x2710 0x2710 0x2710 0x2710 0x2710 0x2710 0x2710 0x2710 0x2710 0x2710 0x2710 0x2710 0x2710 0x2710 0x2710 0x2710 0x2710 0x2710 0x2710 0x2710 0x2710 0x2710 0x2710 0x2710 0x2710 0x2710 0x2710 0x2710 0x2710 0x2710 0x2710 0x2710 0x2710 0x2710 0x2710 0x2710 0x2710 0x2710 0x2710 0x2710 0x2710 0x2710 0x2710 0x2710 0x2710 0x2710 0x2710 0x2710 0x2710 0x2710 0x2710 0x2710 0x2710 0x2710 0x2710 0x2710 0x2710 0x2710 0x2710 0x2710 0x2710 0x2710 0x2710 0x2710 0x2710 0x2710 0x2710 0x2710 0x2710 0x2710 0x2710 0x2710 0x2710 0x2710 0x2710 0x2710 0x2710 0x2710 0x2710 0x2710 0x2710 0x2710 0x2710 0x2710 0x2710 0x2710 0x2710 0x2710 0x2710 0x2710 0x2710 0x2710 0x2710 0x2710 0x2710 0x2710 0x2710 0x2710 0x2710 0x2710 0x2710 0x2710 0x2710 0x2710 0x2710 0x2710 0x2710 0x2710 0x2710 0x2710 0x2710 0x2710 0x2710 0x2710 0x2710 0x2710 0x2710 0x2710 0x2710 0x2710 0x2710 0x2710 0x2710 0x2710 0x2710 0x2710 0x2710 0x2710 0x2710 0x2710 0x2710 0x2710 0x2710 0x2710 0x2710 0x2710 0x2710 0x2710 0x2710 0x2710 0x2710 0x2710 0x2710 0x2710 0x2710 0x2710 0x2710 0x2710 0x2710 0x2710 0x2710 0x2710 0x2710 0x2710 0x2710 0x2710 0x2710 0x2710 0x2710 0x2710 0x2710 0x2710 0x2710 0x2710 0x2710 0x2710 0x2710 0x2710 0x2710 0x2710 0x2710 0x2710 0x2710 0x2710 0x2710 0x2710 0x2710 0x2710 0x2710 0x2710 0x2710 0x2710 0x2710 0x2710 0x2710 0x2710 0x2710 0x2710 0x2710 0x2710 0x2710 0x2710 0x2710 0x2710 0x2710 0x2710 0x2710 0x2710 0x2710 0x2710 0x2710 0x2710 0x2710 0x2710 0x2710 0x2710 0x2710 0x2710 0x2710 0x2710 0x2710 0x2710 0x2710 0x2710 0x2710 0x2710 0x2710 0x2710 0x2710 0x2710 0x2710 0x2710 0x2710 0x2710 0x2710 0x2710 0x2710 0x2710 0x2710 0x2710 0x2710 0x2710 0x2710 0x2710 0x2710 0x2710 0x2710 0x2710 0x2710 0x2710 0x2710 0x2710 0x2710 0x2710 0x2710 0x2710 0x2710 0x2710 0x2710 0x2710 0x2710 0x2710 0x2710 0x2710 0x2710 0x2710 0x2710 0x2710 0x2710 0x2710 0x2710 0x2710 0x2710 0x2710 0x2710 0x2710 0x2710 0x2710 0x2710 0x2710 0x2710 0x2710 0x2710 0x2710 0x2710 0x2710 0x2710 0x2710 0x2710 0x2710 0x2710 0x2710 0x2710 0x2710 0x2710 0x2710 0x2710 0x2710 0x2710 0x2710 0x2710 0x2710 0x2710 0x2710 0x2710 0x2710 0x2710 0x2710 0x2710 0x2710 0x2710 0x2710 0x2710 0x2710 0x2710 0x2710 0x2710 0x2710 0x2710 0x2710 0x2710 0x2710 0x2710 0x2710 0x2710 0x2710 0x2710 0x2710 0x2710 0x2710 0x2710 0x2710 0x2710 0x2710 0x2710 0x2710 0x2710 0x2710 0x2710 0x2710 0x2710 0x2710 0x2710 0x2710 0x2710 0x2710 0x2710 0x2710 0x2710 0x2710 0x2710 0x2710 0x2710 0x2710 0x2710 0x2710 0x2710 0x2710 0x2710 0x2710 0x2710 0x2710 0x2710 0x2710 0x2710 0x2710 0x2710 0x2710 0x2710 0x2710 0x2710 0x2710 0x2710 0x2710 0x2710 0x2710 0x2710 0x2710 0x2710 0x2710 0x2710 0x2710 0x2710 0x2710 0x2710 0x2710 0x2710 0x2710 0x2710 0x2710 0x2710 0x2710 0x2710 0x2710 0x2710 0x2710 0x2710 0x2710 0x2710 0x2710 0x2710 0x2710 0x2710 0x2710 0x2710 0x2710 0x2710 0x2710 0x2710 0x2710 0x2710 0x2710 0x2710 0x2710 0x2710 0x2710 0x2710 0x2710 0x2710 0x2710 0x2710 0x2710 0x2710 0x2710 0x2710 0x2710 0x2710 0x2710 0x2710 0x2710 0x2710 0x2710 0x2710 0x2710 0x2710 0x2710 0x2710 0x2710 0x2710 0x2710 0x2710 0x2710 0x2710 0x2710 0x2710 0x2710 0x2710 0x2710 0x2710 0x2710 0x2710 0x2710 0x2710 0x2710 0x2710 0x2710 0x2710 0x2710 0x2710 0x2710 0x2710 0x2710 0x2710 0x2710 0x2710 0x2710 0x2710 0x2710 0x2710 0x2710 0x2710 0x2710 0x2710 0x2710 0x2710 0x2710 0x2710 0x2710 0x2710 0x2710 0x2710 0x2710 0x2710 0x2710 0x2710 0x2710 0x2710 0x2710 0x2710 0x2710 0x2710 0x2710 0x2710 0x2710 0x2710 0x2710 0x2710 0x2710 0x2710 0x2710 0x2710 0x2710 0x2710 0x2710 0x2710 0x2710 0x2710 0x2710 0x2710 0x2710 0x2710 0x2710 0x2710 0x2710 0x2710 0x2710 0x2710 0x2710 0x2710 0x2710 0x2710 0x2710 0x2710 0x2710 0x2710 0x2710 0x2710 0x2710 0x2710 0x2710 0x2710 0x2710 0x2710 0x2710 0x2710 0x2710 0x2710 0x2710 0x2710 0x2710 0x2710 0x2710 0x2710 0x2710 0x2710 0x2710 0x2710 0x2710 0x2710 0x2710 0x2710 0x2710 0x2710 0x2710 0x2710 0x2710 0x2710 0x2710 0x2710 0x2710 0x2710 0x2710 0x2710 0x2710 0x2710 0x2710 0x2710 0x2710 0x2710 0x2710 0x2710 0x2710 0x2710 0x2710 0x2710 0x2710 0x2710 0x2710 0x2710 0x2710 0x2710>;
					PS_Config_Lmt_Open_Rawdata_P = <0x1400 0x1400 0x1400 0x1400 0x1400 0x1400 0x1400 0x1400 0x1400 0x1400 0x1400 0x1400 0x1400 0x1400 0x1400 0x1400 0x1400 0x1400 0x1400 0x1400 0x1400 0x1400 0x1400 0x1400 0x1400 0x1400 0x1400 0x1400 0x1400 0x1400 0x1400 0x1400 0x1400 0x1400 0x1400 0x1400 0x1400 0x1400 0x1400 0x1400 0x1400 0x1400 0x1400 0x1400 0x1400 0x1400 0x1400 0x1400 0x1400 0x1400 0x1400 0x1400 0x1400 0x1400 0x1400 0x1400 0x1400 0x1400 0x1400 0x1400 0x1400 0x1400 0x1400 0x1400 0x1400 0x1400 0x1400 0x1400 0x1400 0x1400 0x1400 0x1400 0x1400 0x1400 0x1400 0x1400 0x1400 0x1400 0x1400 0x1400 0x1400 0x1400 0x1400 0x1400 0x1400 0x1400 0x1400 0x1400 0x1400 0x1400 0x1400 0x1400 0x1400 0x1400 0x1400 0x1400 0x1400 0x1400 0x1400 0x1400 0x1400 0x1400 0x1400 0x1400 0x1400 0x1400 0x1400 0x1400 0x1400 0x1400 0x1400 0x1400 0x1400 0x1400 0x1400 0x1400 0x1400 0x1400 0x1400 0x1400 0x1400 0x1400 0x1400 0x1400 0x1400 0x1400 0x1400 0x1400 0x1400 0x1400 0x1400 0x1400 0x1400 0x1400 0x1400 0x1400 0x1400 0x1400 0x1400 0x1400 0x1400 0x1400 0x1400 0x1400 0x1400 0x1400 0x1400 0x1400 0x1400 0x1400 0x1400 0x1400 0x1400 0x1400 0x1400 0x1400 0x1400 0x1400 0x1400 0x1400 0x1400 0x1400 0x1400 0x1400 0x1400 0x1400 0x1400 0x1400 0x1400 0x1400 0x1400 0x1400 0x1400 0x1400 0x1400 0x1400 0x1400 0x1400 0x1400 0x1400 0x1400 0x1400 0x1400 0x1400 0x1400 0x1400 0x1400 0x1400 0x1400 0x1400 0x1400 0x1400 0x1400 0x1400 0x1400 0x1400 0x1400 0x1400 0x1400 0x1400 0x1400 0x1400 0x1400 0x1400 0x1400 0x1400 0x1400 0x1400 0x1400 0x1400 0x1400 0x1400 0x1400 0x1400 0x1400 0x1400 0x1400 0x1400 0x1400 0x1400 0x1400 0x1400 0x1400 0x1400 0x1400 0x1400 0x1400 0x1400 0x1400 0x1400 0x1400 0x1400 0x1400 0x1400 0x1400 0x1400 0x1400 0x1400 0x1400 0x1400 0x1400 0x1400 0x1400 0x1400 0x1400 0x1400 0x1400 0x1400 0x1400 0x1400 0x1400 0x1400 0x1400 0x1400 0x1400 0x1400 0x1400 0x1400 0x1400 0x1400 0x1400 0x1400 0x1400 0x1400 0x1400 0x1400 0x1400 0x1400 0x1400 0x1400 0x1400 0x1400 0x1400 0x1400 0x1400 0x1400 0x1400 0x1400 0x1400 0x1400 0x1400 0x1400 0x1400 0x1400 0x1400 0x1400 0x1400 0x1400 0x1400 0x1400 0x1400 0x1400 0x1400 0x1400 0x1400 0x1400 0x1400 0x1400 0x1400 0x1400 0x1400 0x1400 0x1400 0x1400 0x1400 0x1400 0x1400 0x1400 0x1400 0x1400 0x1400 0x1400 0x1400 0x1400 0x1400 0x1400 0x1400 0x1400 0x1400 0x1400 0x1400 0x1400 0x1400 0x1400 0x1400 0x1400 0x1400 0x1400 0x1400 0x1400 0x1400 0x1400 0x1400 0x1400 0x1400 0x1400 0x1400 0x1400 0x1400 0x1400 0x1400 0x1400 0x1400 0x1400 0x1400 0x1400 0x1400 0x1400 0x1400 0x1400 0x1400 0x1400 0x1400 0x1400 0x1400 0x1400 0x1400 0x1400 0x1400 0x1400 0x1400 0x1400 0x1400 0x1400 0x1400 0x1400 0x1400 0x1400 0x1400 0x1400 0x1400 0x1400 0x1400 0x1400 0x1400 0x1400 0x1400 0x1400 0x1400 0x1400 0x1400 0x1400 0x1400 0x1400 0x1400 0x1400 0x1400 0x1400 0x1400 0x1400 0x1400 0x1400 0x1400 0x1400 0x1400 0x1400 0x1400 0x1400 0x1400 0x1400 0x1400 0x1400 0x1400 0x1400 0x1400 0x1400 0x1400 0x1400 0x1400 0x1400 0x1400 0x1400 0x1400 0x1400 0x1400 0x1400 0x1400 0x1400 0x1400 0x1400 0x1400 0x1400 0x1400 0x1400 0x1400 0x1400 0x1400 0x1400 0x1400 0x1400 0x1400 0x1400 0x1400 0x1400 0x1400 0x1400 0x1400 0x1400 0x1400 0x1400 0x1400 0x1400 0x1400 0x1400 0x1400 0x1400 0x1400 0x1400 0x1400 0x1400 0x1400 0x1400 0x1400 0x1400 0x1400 0x1400 0x1400 0x1400 0x1400 0x1400 0x1400 0x1400 0x1400 0x1400 0x1400 0x1400 0x1400 0x1400 0x1400 0x1400 0x1400 0x1400 0x1400 0x1400 0x1400 0x1400 0x1400 0x1400 0x1400 0x1400 0x1400 0x1400 0x1400 0x1400 0x1400 0x1400 0x1400 0x1400 0x1400 0x1400 0x1400 0x1400 0x1400 0x1400 0x1400 0x1400 0x1400 0x1400 0x1400 0x1400 0x1400 0x1400 0x1400 0x1400 0x1400 0x1400 0x1400 0x1400 0x1400 0x1400 0x1400 0x1400 0x1400 0x1400 0x1400 0x1400 0x1400 0x1400 0x1400 0x1400 0x1400 0x1400 0x1400 0x1400 0x1400 0x1400 0x1400 0x1400 0x1400 0x1400 0x1400 0x1400 0x1400 0x1400 0x1400 0x1400 0x1400 0x1400 0x1400 0x1400 0x1400 0x1400 0x1400 0x1400 0x1400 0x1400 0x1400 0x1400 0x1400 0x1400 0x1400 0x1400 0x1400 0x1400 0x1400 0x1400 0x1400 0x1400 0x1400 0x1400 0x1400 0x1400 0x1400 0x1400 0x1400 0x1400 0x1400 0x1400 0x1400 0x1400 0x1400 0x1400 0x1400 0x1400 0x1400 0x1400 0x1400 0x1400 0x1400>;
					PS_Config_Lmt_Open_Rawdata_N = <0xfffffe01 0xfffffe01 0xfffffe01 0xfffffe01 0xfffffe01 0xfffffe01 0xfffffe01 0xfffffe01 0xfffffe01 0xfffffe01 0xfffffe01 0xfffffe01 0xfffffe01 0xfffffe01 0xfffffe01 0xfffffe01 0xfffffe01 0xfffffe01 0xfffffe01 0xfffffe01 0xfffffe01 0xfffffe01 0xfffffe01 0xfffffe01 0xfffffe01 0xfffffe01 0xfffffe01 0xfffffe01 0xfffffe01 0xfffffe01 0xfffffe01 0xfffffe01 0xfffffe01 0xfffffe01 0xfffffe01 0xfffffe01 0xfffffe01 0xfffffe01 0xfffffe01 0xfffffe01 0xfffffe01 0xfffffe01 0xfffffe01 0xfffffe01 0xfffffe01 0xfffffe01 0xfffffe01 0xfffffe01 0xfffffe01 0xfffffe01 0xfffffe01 0xfffffe01 0xfffffe01 0xfffffe01 0xfffffe01 0xfffffe01 0xfffffe01 0xfffffe01 0xfffffe01 0xfffffe01 0xfffffe01 0xfffffe01 0xfffffe01 0xfffffe01 0xfffffe01 0xfffffe01 0xfffffe01 0xfffffe01 0xfffffe01 0xfffffe01 0xfffffe01 0xfffffe01 0xfffffe01 0xfffffe01 0xfffffe01 0xfffffe01 0xfffffe01 0xfffffe01 0xfffffe01 0xfffffe01 0xfffffe01 0xfffffe01 0xfffffe01 0xfffffe01 0xfffffe01 0xfffffe01 0xfffffe01 0xfffffe01 0xfffffe01 0xfffffe01 0xfffffe01 0xfffffe01 0xfffffe01 0xfffffe01 0xfffffe01 0xfffffe01 0xfffffe01 0xfffffe01 0xfffffe01 0xfffffe01 0xfffffe01 0xfffffe01 0xfffffe01 0xfffffe01 0xfffffe01 0xfffffe01 0xfffffe01 0xfffffe01 0xfffffe01 0xfffffe01 0xfffffe01 0xfffffe01 0xfffffe01 0xfffffe01 0xfffffe01 0xfffffe01 0xfffffe01 0xfffffe01 0xfffffe01 0xfffffe01 0xfffffe01 0xfffffe01 0xfffffe01 0xfffffe01 0xfffffe01 0xfffffe01 0xfffffe01 0xfffffe01 0xfffffe01 0xfffffe01 0xfffffe01 0xfffffe01 0xfffffe01 0xfffffe01 0xfffffe01 0xfffffe01 0xfffffe01 0xfffffe01 0xfffffe01 0xfffffe01 0xfffffe01 0xfffffe01 0xfffffe01 0xfffffe01 0xfffffe01 0xfffffe01 0xfffffe01 0xfffffe01 0xfffffe01 0xfffffe01 0xfffffe01 0xfffffe01 0xfffffe01 0xfffffe01 0xfffffe01 0xfffffe01 0xfffffe01 0xfffffe01 0xfffffe01 0xfffffe01 0xfffffe01 0xfffffe01 0xfffffe01 0xfffffe01 0xfffffe01 0xfffffe01 0xfffffe01 0xfffffe01 0xfffffe01 0xfffffe01 0xfffffe01 0xfffffe01 0xfffffe01 0xfffffe01 0xfffffe01 0xfffffe01 0xfffffe01 0xfffffe01 0xfffffe01 0xfffffe01 0xfffffe01 0xfffffe01 0xfffffe01 0xfffffe01 0xfffffe01 0xfffffe01 0xfffffe01 0xfffffe01 0xfffffe01 0xfffffe01 0xfffffe01 0xfffffe01 0xfffffe01 0xfffffe01 0xfffffe01 0xfffffe01 0xfffffe01 0xfffffe01 0xfffffe01 0xfffffe01 0xfffffe01 0xfffffe01 0xfffffe01 0xfffffe01 0xfffffe01 0xfffffe01 0xfffffe01 0xfffffe01 0xfffffe01 0xfffffe01 0xfffffe01 0xfffffe01 0xfffffe01 0xfffffe01 0xfffffe01 0xfffffe01 0xfffffe01 0xfffffe01 0xfffffe01 0xfffffe01 0xfffffe01 0xfffffe01 0xfffffe01 0xfffffe01 0xfffffe01 0xfffffe01 0xfffffe01 0xfffffe01 0xfffffe01 0xfffffe01 0xfffffe01 0xfffffe01 0xfffffe01 0xfffffe01 0xfffffe01 0xfffffe01 0xfffffe01 0xfffffe01 0xfffffe01 0xfffffe01 0xfffffe01 0xfffffe01 0xfffffe01 0xfffffe01 0xfffffe01 0xfffffe01 0xfffffe01 0xfffffe01 0xfffffe01 0xfffffe01 0xfffffe01 0xfffffe01 0xfffffe01 0xfffffe01 0xfffffe01 0xfffffe01 0xfffffe01 0xfffffe01 0xfffffe01 0xfffffe01 0xfffffe01 0xfffffe01 0xfffffe01 0xfffffe01 0xfffffe01 0xfffffe01 0xfffffe01 0xfffffe01 0xfffffe01 0xfffffe01 0xfffffe01 0xfffffe01 0xfffffe01 0xfffffe01 0xfffffe01 0xfffffe01 0xfffffe01 0xfffffe01 0xfffffe01 0xfffffe01 0xfffffe01 0xfffffe01 0xfffffe01 0xfffffe01 0xfffffe01 0xfffffe01 0xfffffe01 0xfffffe01 0xfffffe01 0xfffffe01 0xfffffe01 0xfffffe01 0xfffffe01 0xfffffe01 0xfffffe01 0xfffffe01 0xfffffe01 0xfffffe01 0xfffffe01 0xfffffe01 0xfffffe01 0xfffffe01 0xfffffe01 0xfffffe01 0xfffffe01 0xfffffe01 0xfffffe01 0xfffffe01 0xfffffe01 0xfffffe01 0xfffffe01 0xfffffe01 0xfffffe01 0xfffffe01 0xfffffe01 0xfffffe01 0xfffffe01 0xfffffe01 0xfffffe01 0xfffffe01 0xfffffe01 0xfffffe01 0xfffffe01 0xfffffe01 0xfffffe01 0xfffffe01 0xfffffe01 0xfffffe01 0xfffffe01 0xfffffe01 0xfffffe01 0xfffffe01 0xfffffe01 0xfffffe01 0xfffffe01 0xfffffe01 0xfffffe01 0xfffffe01 0xfffffe01 0xfffffe01 0xfffffe01 0xfffffe01 0xfffffe01 0xfffffe01 0xfffffe01 0xfffffe01 0xfffffe01 0xfffffe01 0xfffffe01 0xfffffe01 0xfffffe01 0xfffffe01 0xfffffe01 0xfffffe01 0xfffffe01 0xfffffe01 0xfffffe01 0xfffffe01 0xfffffe01 0xfffffe01 0xfffffe01 0xfffffe01 0xfffffe01 0xfffffe01 0xfffffe01 0xfffffe01 0xfffffe01 0xfffffe01 0xfffffe01 0xfffffe01 0xfffffe01 0xfffffe01 0xfffffe01 0xfffffe01 0xfffffe01 0xfffffe01 0xfffffe01 0xfffffe01 0xfffffe01 0xfffffe01 0xfffffe01 0xfffffe01 0xfffffe01 0xfffffe01 0xfffffe01 0xfffffe01 0xfffffe01 0xfffffe01 0xfffffe01 0xfffffe01 0xfffffe01 0xfffffe01 0xfffffe01 0xfffffe01 0xfffffe01 0xfffffe01 0xfffffe01 0xfffffe01 0xfffffe01 0xfffffe01 0xfffffe01 0xfffffe01 0xfffffe01 0xfffffe01 0xfffffe01 0xfffffe01 0xfffffe01 0xfffffe01 0xfffffe01 0xfffffe01 0xfffffe01 0xfffffe01 0xfffffe01 0xfffffe01 0xfffffe01 0xfffffe01 0xfffffe01 0xfffffe01 0xfffffe01 0xfffffe01 0xfffffe01 0xfffffe01 0xfffffe01 0xfffffe01 0xfffffe01 0xfffffe01 0xfffffe01 0xfffffe01 0xfffffe01 0xfffffe01 0xfffffe01 0xfffffe01 0xfffffe01 0xfffffe01 0xfffffe01 0xfffffe01 0xfffffe01 0xfffffe01 0xfffffe01 0xfffffe01 0xfffffe01 0xfffffe01 0xfffffe01 0xfffffe01 0xfffffe01 0xfffffe01 0xfffffe01 0xfffffe01 0xfffffe01 0xfffffe01 0xfffffe01 0xfffffe01 0xfffffe01 0xfffffe01 0xfffffe01 0xfffffe01 0xfffffe01 0xfffffe01 0xfffffe01 0xfffffe01 0xfffffe01 0xfffffe01 0xfffffe01 0xfffffe01 0xfffffe01 0xfffffe01 0xfffffe01 0xfffffe01 0xfffffe01 0xfffffe01 0xfffffe01 0xfffffe01 0xfffffe01 0xfffffe01 0xfffffe01 0xfffffe01 0xfffffe01 0xfffffe01 0xfffffe01 0xfffffe01 0xfffffe01 0xfffffe01 0xfffffe01 0xfffffe01 0xfffffe01 0xfffffe01 0xfffffe01 0xfffffe01 0xfffffe01 0xfffffe01 0xfffffe01 0xfffffe01 0xfffffe01 0xfffffe01 0xfffffe01 0xfffffe01 0xfffffe01 0xfffffe01 0xfffffe01 0xfffffe01 0xfffffe01 0xfffffe01 0xfffffe01 0xfffffe01 0xfffffe01 0xfffffe01 0xfffffe01 0xfffffe01 0xfffffe01 0xfffffe01 0xfffffe01 0xfffffe01 0xfffffe01 0xfffffe01 0xfffffe01 0xfffffe01 0xfffffe01 0xfffffe01 0xfffffe01 0xfffffe01 0xfffffe01 0xfffffe01 0xfffffe01 0xfffffe01 0xfffffe01 0xfffffe01 0xfffffe01 0xfffffe01 0xfffffe01 0xfffffe01 0xfffffe01 0xfffffe01 0xfffffe01 0xfffffe01 0xfffffe01 0xfffffe01 0xfffffe01 0xfffffe01 0xfffffe01 0xfffffe01 0xfffffe01 0xfffffe01 0xfffffe01 0xfffffe01 0xfffffe01 0xfffffe01 0xfffffe01 0xfffffe01 0xfffffe01 0xfffffe01 0xfffffe01 0xfffffe01 0xfffffe01 0xfffffe01 0xfffffe01 0xfffffe01 0xfffffe01 0xfffffe01 0xfffffe01 0xfffffe01 0xfffffe01 0xfffffe01 0xfffffe01 0xfffffe01 0xfffffe01 0xfffffe01 0xfffffe01 0xfffffe01 0xfffffe01 0xfffffe01 0xfffffe01 0xfffffe01 0xfffffe01 0xfffffe01 0xfffffe01 0xfffffe01 0xfffffe01 0xfffffe01 0xfffffe01>;
					PS_Config_Lmt_FW_Rawdata_P = <0xf00 0xf00 0xf00 0xf00 0xf00 0xf00 0xf00 0xf00 0xf00 0xf00 0xf00 0xf00 0xf00 0xf00 0xf00 0xf00 0xf00 0xf00 0xf00 0xf00 0xf00 0xf00 0xf00 0xf00 0xf00 0xf00 0xf00 0xf00 0xf00 0xf00 0xf00 0xf00 0xf00 0xf00 0xf00 0xf00 0xf00 0xf00 0xf00 0xf00 0xf00 0xf00 0xf00 0xf00 0xf00 0xf00 0xf00 0xf00 0xf00 0xf00 0xf00 0xf00 0xf00 0xf00 0xf00 0xf00 0xf00 0xf00 0xf00 0xf00 0xf00 0xf00 0xf00 0xf00 0xf00 0xf00 0xf00 0xf00 0xf00 0xf00 0xf00 0xf00 0xf00 0xf00 0xf00 0xf00 0xf00 0xf00 0xf00 0xf00 0xf00 0xf00 0xf00 0xf00 0xf00 0xf00 0xf00 0xf00 0xf00 0xf00 0xf00 0xf00 0xf00 0xf00 0xf00 0xf00 0xf00 0xf00 0xf00 0xf00 0xf00 0xf00 0xf00 0xf00 0xf00 0xf00 0xf00 0xf00 0xf00 0xf00 0xf00 0xf00 0xf00 0xf00 0xf00 0xf00 0xf00 0xf00 0xf00 0xf00 0xf00 0xf00 0xf00 0xf00 0xf00 0xf00 0xf00 0xf00 0xf00 0xf00 0xf00 0xf00 0xf00 0xf00 0xf00 0xf00 0xf00 0xf00 0xf00 0xf00 0xf00 0xf00 0xf00 0xf00 0xf00 0xf00 0xf00 0xf00 0xf00 0xf00 0xf00 0xf00 0xf00 0xf00 0xf00 0xf00 0xf00 0xf00 0xf00 0xf00 0xf00 0xf00 0xf00 0xf00 0xf00 0xf00 0xf00 0xf00 0xf00 0xf00 0xf00 0xf00 0xf00 0xf00 0xf00 0xf00 0xf00 0xf00 0xf00 0xf00 0xf00 0xf00 0xf00 0xf00 0xf00 0xf00 0xf00 0xf00 0xf00 0xf00 0xf00 0xf00 0xf00 0xf00 0xf00 0xf00 0xf00 0xf00 0xf00 0xf00 0xf00 0xf00 0xf00 0xf00 0xf00 0xf00 0xf00 0xf00 0xf00 0xf00 0xf00 0xf00 0xf00 0xf00 0xf00 0xf00 0xf00 0xf00 0xf00 0xf00 0xf00 0xf00 0xf00 0xf00 0xf00 0xf00 0xf00 0xf00 0xf00 0xf00 0xf00 0xf00 0xf00 0xf00 0xf00 0xf00 0xf00 0xf00 0xf00 0xf00 0xf00 0xf00 0xf00 0xf00 0xf00 0xf00 0xf00 0xf00 0xf00 0xf00 0xf00 0xf00 0xf00 0xf00 0xf00 0xf00 0xf00 0xf00 0xf00 0xf00 0xf00 0xf00 0xf00 0xf00 0xf00 0xf00 0xf00 0xf00 0xf00 0xf00 0xf00 0xf00 0xf00 0xf00 0xf00 0xf00 0xf00 0xf00 0xf00 0xf00 0xf00 0xf00 0xf00 0xf00 0xf00 0xf00 0xf00 0xf00 0xf00 0xf00 0xf00 0xf00 0xf00 0xf00 0xf00 0xf00 0xf00 0xf00 0xf00 0xf00 0xf00 0xf00 0xf00 0xf00 0xf00 0xf00 0xf00 0xf00 0xf00 0xf00 0xf00 0xf00 0xf00 0xf00 0xf00 0xf00 0xf00 0xf00 0xf00 0xf00 0xf00 0xf00 0xf00 0xf00 0xf00 0xf00 0xf00 0xf00 0xf00 0xf00 0xf00 0xf00 0xf00 0xf00 0xf00 0xf00 0xf00 0xf00 0xf00 0xf00 0xf00 0xf00 0xf00 0xf00 0xf00 0xf00 0xf00 0xf00 0xf00 0xf00 0xf00 0xf00 0xf00 0xf00 0xf00 0xf00 0xf00 0xf00 0xf00 0xf00 0xf00 0xf00 0xf00 0xf00 0xf00 0xf00 0xf00 0xf00 0xf00 0xf00 0xf00 0xf00 0xf00 0xf00 0xf00 0xf00 0xf00 0xf00 0xf00 0xf00 0xf00 0xf00 0xf00 0xf00 0xf00 0xf00 0xf00 0xf00 0xf00 0xf00 0xf00 0xf00 0xf00 0xf00 0xf00 0xf00 0xf00 0xf00 0xf00 0xf00 0xf00 0xf00 0xf00 0xf00 0xf00 0xf00 0xf00 0xf00 0xf00 0xf00 0xf00 0xf00 0xf00 0xf00 0xf00 0xf00 0xf00 0xf00 0xf00 0xf00 0xf00 0xf00 0xf00 0xf00 0xf00 0xf00 0xf00 0xf00 0xf00 0xf00 0xf00 0xf00 0xf00 0xf00 0xf00 0xf00 0xf00 0xf00 0xf00 0xf00 0xf00 0xf00 0xf00 0xf00 0xf00 0xf00 0xf00 0xf00 0xf00 0xf00 0xf00 0xf00 0xf00 0xf00 0xf00 0xf00 0xf00 0xf00 0xf00 0xf00 0xf00 0xf00 0xf00 0xf00 0xf00 0xf00 0xf00 0xf00 0xf00 0xf00 0xf00 0xf00 0xf00 0xf00 0xf00 0xf00 0xf00 0xf00 0xf00 0xf00 0xf00 0xf00 0xf00 0xf00 0xf00 0xf00 0xf00 0xf00 0xf00 0xf00 0xf00 0xf00 0xf00 0xf00 0xf00 0xf00 0xf00 0xf00 0xf00 0xf00 0xf00 0xf00 0xf00 0xf00 0xf00 0xf00 0xf00 0xf00 0xf00 0xf00 0xf00 0xf00 0xf00 0xf00 0xf00 0xf00 0xf00 0xf00 0xf00 0xf00 0xf00 0xf00 0xf00 0xf00 0xf00 0xf00 0xf00 0xf00 0xf00 0xf00 0xf00 0xf00 0xf00 0xf00 0xf00 0xf00 0xf00 0xf00 0xf00 0xf00 0xf00 0xf00 0xf00 0xf00 0xf00 0xf00 0xf00 0xf00 0xf00 0xf00 0xf00 0xf00 0xf00 0xf00 0xf00 0xf00 0xf00 0xf00 0xf00 0xf00 0xf00 0xf00 0xf00 0xf00 0xf00 0xf00 0xf00 0xf00 0xf00 0xf00 0xf00 0xf00 0xf00 0xf00 0xf00 0xf00 0xf00 0xf00 0xf00>;
					PS_Config_Lmt_FW_Rawdata_N = <0xf0 0xf0 0xf0 0xf0 0xf0 0xf0 0xf0 0xf0 0xf0 0xf0 0xf0 0xf0 0xf0 0xf0 0xf0 0xf0 0xf0 0xf0 0xf0 0xf0 0xf0 0xf0 0xf0 0xf0 0xf0 0xf0 0xf0 0xf0 0xf0 0xf0 0xf0 0xf0 0xf0 0xf0 0xf0 0xf0 0xf0 0xf0 0xf0 0xf0 0xf0 0xf0 0xf0 0xf0 0xf0 0xf0 0xf0 0xf0 0xf0 0xf0 0xf0 0xf0 0xf0 0xf0 0xf0 0xf0 0xf0 0xf0 0xf0 0xf0 0xf0 0xf0 0xf0 0xf0 0xf0 0xf0 0xf0 0xf0 0xf0 0xf0 0xf0 0xf0 0xf0 0xf0 0xf0 0xf0 0xf0 0xf0 0xf0 0xf0 0xf0 0xf0 0xf0 0xf0 0xf0 0xf0 0xf0 0xf0 0xf0 0xf0 0xf0 0xf0 0xf0 0xf0 0xf0 0xf0 0xf0 0xf0 0xf0 0xf0 0xf0 0xf0 0xf0 0xf0 0xf0 0xf0 0xf0 0xf0 0xf0 0xf0 0xf0 0xf0 0xf0 0xf0 0xf0 0xf0 0xf0 0xf0 0xf0 0xf0 0xf0 0xf0 0xf0 0xf0 0xf0 0xf0 0xf0 0xf0 0xf0 0xf0 0xf0 0xf0 0xf0 0xf0 0xf0 0xf0 0xf0 0xf0 0xf0 0xf0 0xf0 0xf0 0xf0 0xf0 0xf0 0xf0 0xf0 0xf0 0xf0 0xf0 0xf0 0xf0 0xf0 0xf0 0xf0 0xf0 0xf0 0xf0 0xf0 0xf0 0xf0 0xf0 0xf0 0xf0 0xf0 0xf0 0xf0 0xf0 0xf0 0xf0 0xf0 0xf0 0xf0 0xf0 0xf0 0xf0 0xf0 0xf0 0xf0 0xf0 0xf0 0xf0 0xf0 0xf0 0xf0 0xf0 0xf0 0xf0 0xf0 0xf0 0xf0 0xf0 0xf0 0xf0 0xf0 0xf0 0xf0 0xf0 0xf0 0xf0 0xf0 0xf0 0xf0 0xf0 0xf0 0xf0 0xf0 0xf0 0xf0 0xf0 0xf0 0xf0 0xf0 0xf0 0xf0 0xf0 0xf0 0xf0 0xf0 0xf0 0xf0 0xf0 0xf0 0xf0 0xf0 0xf0 0xf0 0xf0 0xf0 0xf0 0xf0 0xf0 0xf0 0xf0 0xf0 0xf0 0xf0 0xf0 0xf0 0xf0 0xf0 0xf0 0xf0 0xf0 0xf0 0xf0 0xf0 0xf0 0xf0 0xf0 0xf0 0xf0 0xf0 0xf0 0xf0 0xf0 0xf0 0xf0 0xf0 0xf0 0xf0 0xf0 0xf0 0xf0 0xf0 0xf0 0xf0 0xf0 0xf0 0xf0 0xf0 0xf0 0xf0 0xf0 0xf0 0xf0 0xf0 0xf0 0xf0 0xf0 0xf0 0xf0 0xf0 0xf0 0xf0 0xf0 0xf0 0xf0 0xf0 0xf0 0xf0 0xf0 0xf0 0xf0 0xf0 0xf0 0xf0 0xf0 0xf0 0xf0 0xf0 0xf0 0xf0 0xf0 0xf0 0xf0 0xf0 0xf0 0xf0 0xf0 0xf0 0xf0 0xf0 0xf0 0xf0 0xf0 0xf0 0xf0 0xf0 0xf0 0xf0 0xf0 0xf0 0xf0 0xf0 0xf0 0xf0 0xf0 0xf0 0xf0 0xf0 0xf0 0xf0 0xf0 0xf0 0xf0 0xf0 0xf0 0xf0 0xf0 0xf0 0xf0 0xf0 0xf0 0xf0 0xf0 0xf0 0xf0 0xf0 0xf0 0xf0 0xf0 0xf0 0xf0 0xf0 0xf0 0xf0 0xf0 0xf0 0xf0 0xf0 0xf0 0xf0 0xf0 0xf0 0xf0 0xf0 0xf0 0xf0 0xf0 0xf0 0xf0 0xf0 0xf0 0xf0 0xf0 0xf0 0xf0 0xf0 0xf0 0xf0 0xf0 0xf0 0xf0 0xf0 0xf0 0xf0 0xf0 0xf0 0xf0 0xf0 0xf0 0xf0 0xf0 0xf0 0xf0 0xf0 0xf0 0xf0 0xf0 0xf0 0xf0 0xf0 0xf0 0xf0 0xf0 0xf0 0xf0 0xf0 0xf0 0xf0 0xf0 0xf0 0xf0 0xf0 0xf0 0xf0 0xf0 0xf0 0xf0 0xf0 0xf0 0xf0 0xf0 0xf0 0xf0 0xf0 0xf0 0xf0 0xf0 0xf0 0xf0 0xf0 0xf0 0xf0 0xf0 0xf0 0xf0 0xf0 0xf0 0xf0 0xf0 0xf0 0xf0 0xf0 0xf0 0xf0 0xf0 0xf0 0xf0 0xf0 0xf0 0xf0 0xf0 0xf0 0xf0 0xf0 0xf0 0xf0 0xf0 0xf0 0xf0 0xf0 0xf0 0xf0 0xf0 0xf0 0xf0 0xf0 0xf0 0xf0 0xf0 0xf0 0xf0 0xf0 0xf0 0xf0 0xf0 0xf0 0xf0 0xf0 0xf0 0xf0 0xf0 0xf0 0xf0 0xf0 0xf0 0xf0 0xf0 0xf0 0xf0 0xf0 0xf0 0xf0 0xf0 0xf0 0xf0 0xf0 0xf0 0xf0 0xf0 0xf0 0xf0 0xf0 0xf0 0xf0 0xf0 0xf0 0xf0 0xf0 0xf0 0xf0 0xf0 0xf0 0xf0 0xf0 0xf0 0xf0 0xf0 0xf0 0xf0 0xf0 0xf0 0xf0 0xf0 0xf0 0xf0 0xf0 0xf0 0xf0 0xf0 0xf0 0xf0 0xf0 0xf0 0xf0 0xf0 0xf0 0xf0 0xf0 0xf0 0xf0 0xf0 0xf0 0xf0 0xf0 0xf0 0xf0 0xf0 0xf0 0xf0 0xf0 0xf0 0xf0 0xf0 0xf0 0xf0 0xf0 0xf0 0xf0 0xf0 0xf0 0xf0 0xf0 0xf0 0xf0 0xf0 0xf0 0xf0 0xf0 0xf0 0xf0 0xf0 0xf0 0xf0 0xf0 0xf0 0xf0>;
					PS_Config_Lmt_FW_CC_P = <0x13a 0x13a 0x13a 0x13a 0x13a 0x13a 0x13a 0x13a 0x13a 0x13a 0x13a 0x13a 0x13a 0x13a 0x13a 0x13a 0x13a 0x13a 0x13a 0x13a 0x13a 0x13a 0x13a 0x13a 0x13a 0x13a 0x13a 0x13a 0x13a 0x13a 0x13a 0x13a 0x13a 0x13a 0x13a 0x13a 0x13a 0x13a 0x13a 0x13a 0x13a 0x13a 0x13a 0x13a 0x13a 0x13a 0x13a 0x13a 0x13a 0x13a 0x13a 0x13a 0x13a 0x13a 0x13a 0x13a 0x13a 0x13a 0x13a 0x13a 0x13a 0x13a 0x13a 0x13a 0x13a 0x13a 0x13a 0x13a 0x13a 0x13a 0x13a 0x13a 0x13a 0x13a 0x13a 0x13a 0x13a 0x13a 0x13a 0x13a 0x13a 0x13a 0x13a 0x13a 0x13a 0x13a 0x13a 0x13a 0x13a 0x13a 0x13a 0x13a 0x13a 0x13a 0x13a 0x13a 0x13a 0x13a 0x13a 0x13a 0x13a 0x13a 0x13a 0x13a 0x13a 0x13a 0x13a 0x13a 0x13a 0x13a 0x13a 0x13a 0x13a 0x13a 0x13a 0x13a 0x13a 0x13a 0x13a 0x13a 0x13a 0x13a 0x13a 0x13a 0x13a 0x13a 0x13a 0x13a 0x13a 0x13a 0x13a 0x13a 0x13a 0x13a 0x13a 0x13a 0x13a 0x13a 0x13a 0x13a 0x13a 0x13a 0x13a 0x13a 0x13a 0x13a 0x13a 0x13a 0x13a 0x13a 0x13a 0x13a 0x13a 0x13a 0x13a 0x13a 0x13a 0x13a 0x13a 0x13a 0x13a 0x13a 0x13a 0x13a 0x13a 0x13a 0x13a 0x13a 0x13a 0x13a 0x13a 0x13a 0x13a 0x13a 0x13a 0x13a 0x13a 0x13a 0x13a 0x13a 0x13a 0x13a 0x13a 0x13a 0x13a 0x13a 0x13a 0x13a 0x13a 0x13a 0x13a 0x13a 0x13a 0x13a 0x13a 0x13a 0x13a 0x13a 0x13a 0x13a 0x13a 0x13a 0x13a 0x13a 0x13a 0x13a 0x13a 0x13a 0x13a 0x13a 0x13a 0x13a 0x13a 0x13a 0x13a 0x13a 0x13a 0x13a 0x13a 0x13a 0x13a 0x13a 0x13a 0x13a 0x13a 0x13a 0x13a 0x13a 0x13a 0x13a 0x13a 0x13a 0x13a 0x13a 0x13a 0x13a 0x13a 0x13a 0x13a 0x13a 0x13a 0x13a 0x13a 0x13a 0x13a 0x13a 0x13a 0x13a 0x13a 0x13a 0x13a 0x13a 0x13a 0x13a 0x13a 0x13a 0x13a 0x13a 0x13a 0x13a 0x13a 0x13a 0x13a 0x13a 0x13a 0x13a 0x13a 0x13a 0x13a 0x13a 0x13a 0x13a 0x13a 0x13a 0x13a 0x13a 0x13a 0x13a 0x13a 0x13a 0x13a 0x13a 0x13a 0x13a 0x13a 0x13a 0x13a 0x13a 0x13a 0x13a 0x13a 0x13a 0x13a 0x13a 0x13a 0x13a 0x13a 0x13a 0x13a 0x13a 0x13a 0x13a 0x13a 0x13a 0x13a 0x13a 0x13a 0x13a 0x13a 0x13a 0x13a 0x13a 0x13a 0x13a 0x13a 0x13a 0x13a 0x13a 0x13a 0x13a 0x13a 0x13a 0x13a 0x13a 0x13a 0x13a 0x13a 0x13a 0x13a 0x13a 0x13a 0x13a 0x13a 0x13a 0x13a 0x13a 0x13a 0x13a 0x13a 0x13a 0x13a 0x13a 0x13a 0x13a 0x13a 0x13a 0x13a 0x13a 0x13a 0x13a 0x13a 0x13a 0x13a 0x13a 0x13a 0x13a 0x13a 0x13a 0x13a 0x13a 0x13a 0x13a 0x13a 0x13a 0x13a 0x13a 0x13a 0x13a 0x13a 0x13a 0x13a 0x13a 0x13a 0x13a 0x13a 0x13a 0x13a 0x13a 0x13a 0x13a 0x13a 0x13a 0x13a 0x13a 0x13a 0x13a 0x13a 0x13a 0x13a 0x13a 0x13a 0x13a 0x13a 0x13a 0x13a 0x13a 0x13a 0x13a 0x13a 0x13a 0x13a 0x13a 0x13a 0x13a 0x13a 0x13a 0x13a 0x13a 0x13a 0x13a 0x13a 0x13a 0x13a 0x13a 0x13a 0x13a 0x13a 0x13a 0x13a 0x13a 0x13a 0x13a 0x13a 0x13a 0x13a 0x13a 0x13a 0x13a 0x13a 0x13a 0x13a 0x13a 0x13a 0x13a 0x13a 0x13a 0x13a 0x13a 0x13a 0x13a 0x13a 0x13a 0x13a 0x13a 0x13a 0x13a 0x13a 0x13a 0x13a 0x13a 0x13a 0x13a 0x13a 0x13a 0x13a 0x13a 0x13a 0x13a 0x13a 0x13a 0x13a 0x13a 0x13a 0x13a 0x13a 0x13a 0x13a 0x13a 0x13a 0x13a 0x13a 0x13a 0x13a 0x13a 0x13a 0x13a 0x13a 0x13a 0x13a 0x13a 0x13a 0x13a 0x13a 0x13a 0x13a 0x13a 0x13a 0x13a 0x13a 0x13a 0x13a 0x13a 0x13a 0x13a 0x13a 0x13a 0x13a 0x13a 0x13a 0x13a 0x13a 0x13a 0x13a 0x13a 0x13a 0x13a 0x13a 0x13a 0x13a 0x13a 0x13a 0x13a 0x13a 0x13a 0x13a 0x13a 0x13a 0x13a 0x13a 0x13a 0x13a 0x13a 0x13a 0x13a 0x13a 0x13a 0x13a 0x13a 0x13a 0x13a 0x13a 0x13a 0x13a 0x13a 0x13a 0x13a 0x13a 0x13a 0x13a 0x13a 0x13a 0x13a 0x13a 0x13a 0x13a 0x13a 0x13a 0x13a 0x13a 0x13a 0x13a 0x13a 0x13a 0x13a 0x13a 0x13a 0x13a 0x13a 0x13a 0x13a 0x13a 0x13a 0x13a 0x13a 0x13a 0x13a 0x13a 0x13a 0x13a 0x13a 0x13a 0x13a 0x13a 0x13a 0x13a 0x13a 0x13a 0x13a 0x13a>;
					PS_Config_Lmt_FW_CC_N = <0x00 0x00 0x00 0x00 0x00 0x00 0x00 0x00 0x00 0x00 0x00 0x00 0x00 0x00 0x00 0x00 0x00 0x00 0x00 0x00 0x00 0x00 0x00 0x00 0x00 0x00 0x00 0x00 0x00 0x00 0x00 0x00 0x00 0x00 0x00 0x00 0x00 0x00 0x00 0x00 0x00 0x00 0x00 0x00 0x00 0x00 0x00 0x00 0x00 0x00 0x00 0x00 0x00 0x00 0x00 0x00 0x00 0x00 0x00 0x00 0x00 0x00 0x00 0x00 0x00 0x00 0x00 0x00 0x00 0x00 0x00 0x00 0x00 0x00 0x00 0x00 0x00 0x00 0x00 0x00 0x00 0x00 0x00 0x00 0x00 0x00 0x00 0x00 0x00 0x00 0x00 0x00 0x00 0x00 0x00 0x00 0x00 0x00 0x00 0x00 0x00 0x00 0x00 0x00 0x00 0x00 0x00 0x00 0x00 0x00 0x00 0x00 0x00 0x00 0x00 0x00 0x00 0x00 0x00 0x00 0x00 0x00 0x00 0x00 0x00 0x00 0x00 0x00 0x00 0x00 0x00 0x00 0x00 0x00 0x00 0x00 0x00 0x00 0x00 0x00 0x00 0x00 0x00 0x00 0x00 0x00 0x00 0x00 0x00 0x00 0x00 0x00 0x00 0x00 0x00 0x00 0x00 0x00 0x00 0x00 0x00 0x00 0x00 0x00 0x00 0x00 0x00 0x00 0x00 0x00 0x00 0x00 0x00 0x00 0x00 0x00 0x00 0x00 0x00 0x00 0x00 0x00 0x00 0x00 0x00 0x00 0x00 0x00 0x00 0x00 0x00 0x00 0x00 0x00 0x00 0x00 0x00 0x00 0x00 0x00 0x00 0x00 0x00 0x00 0x00 0x00 0x00 0x00 0x00 0x00 0x00 0x00 0x00 0x00 0x00 0x00 0x00 0x00 0x00 0x00 0x00 0x00 0x00 0x00 0x00 0x00 0x00 0x00 0x00 0x00 0x00 0x00 0x00 0x00 0x00 0x00 0x00 0x00 0x00 0x00 0x00 0x00 0x00 0x00 0x00 0x00 0x00 0x00 0x00 0x00 0x00 0x00 0x00 0x00 0x00 0x00 0x00 0x00 0x00 0x00 0x00 0x00 0x00 0x00 0x00 0x00 0x00 0x00 0x00 0x00 0x00 0x00 0x00 0x00 0x00 0x00 0x00 0x00 0x00 0x00 0x00 0x00 0x00 0x00 0x00 0x00 0x00 0x00 0x00 0x00 0x00 0x00 0x00 0x00 0x00 0x00 0x00 0x00 0x00 0x00 0x00 0x00 0x00 0x00 0x00 0x00 0x00 0x00 0x00 0x00 0x00 0x00 0x00 0x00 0x00 0x00 0x00 0x00 0x00 0x00 0x00 0x00 0x00 0x00 0x00 0x00 0x00 0x00 0x00 0x00 0x00 0x00 0x00 0x00 0x00 0x00 0x00 0x00 0x00 0x00 0x00 0x00 0x00 0x00 0x00 0x00 0x00 0x00 0x00 0x00 0x00 0x00 0x00 0x00 0x00 0x00 0x00 0x00 0x00 0x00 0x00 0x00 0x00 0x00 0x00 0x00 0x00 0x00 0x00 0x00 0x00 0x00 0x00 0x00 0x00 0x00 0x00 0x00 0x00 0x00 0x00 0x00 0x00 0x00 0x00 0x00 0x00 0x00 0x00 0x00 0x00 0x00 0x00 0x00 0x00 0x00 0x00 0x00 0x00 0x00 0x00 0x00 0x00 0x00 0x00 0x00 0x00 0x00 0x00 0x00 0x00 0x00 0x00 0x00 0x00 0x00 0x00 0x00 0x00 0x00 0x00 0x00 0x00 0x00 0x00 0x00 0x00 0x00 0x00 0x00 0x00 0x00 0x00 0x00 0x00 0x00 0x00 0x00 0x00 0x00 0x00 0x00 0x00 0x00 0x00 0x00 0x00 0x00 0x00 0x00 0x00 0x00 0x00 0x00 0x00 0x00 0x00 0x00 0x00 0x00 0x00 0x00 0x00 0x00 0x00 0x00 0x00 0x00 0x00 0x00 0x00 0x00 0x00 0x00 0x00 0x00 0x00 0x00 0x00 0x00 0x00 0x00 0x00 0x00 0x00 0x00 0x00 0x00 0x00 0x00 0x00 0x00 0x00 0x00 0x00 0x00 0x00 0x00 0x00 0x00 0x00 0x00 0x00 0x00 0x00 0x00 0x00 0x00 0x00 0x00 0x00 0x00 0x00 0x00 0x00 0x00 0x00 0x00 0x00 0x00 0x00 0x00 0x00 0x00 0x00 0x00 0x00 0x00 0x00 0x00 0x00 0x00 0x00 0x00 0x00 0x00 0x00 0x00 0x00 0x00 0x00 0x00 0x00 0x00 0x00 0x00 0x00 0x00 0x00 0x00 0x00 0x00 0x00 0x00 0x00 0x00 0x00 0x00 0x00 0x00 0x00 0x00 0x00 0x00 0x00 0x00 0x00 0x00 0x00 0x00 0x00 0x00 0x00 0x00 0x00 0x00 0x00 0x00 0x00>;
					PS_Config_Lmt_FW_Diff_P = <0x4b 0x4b 0x4b 0x4b 0x4b 0x4b 0x4b 0x4b 0x4b 0x4b 0x4b 0x4b 0x4b 0x4b 0x4b 0x4b 0x4b 0x4b 0x4b 0x4b 0x4b 0x4b 0x4b 0x4b 0x4b 0x4b 0x4b 0x4b 0x4b 0x4b 0x4b 0x4b 0x4b 0x4b 0x4b 0x4b 0x4b 0x4b 0x4b 0x4b 0x4b 0x4b 0x4b 0x4b 0x4b 0x4b 0x4b 0x4b 0x4b 0x4b 0x4b 0x4b 0x4b 0x4b 0x4b 0x4b 0x4b 0x4b 0x4b 0x4b 0x4b 0x4b 0x4b 0x4b 0x4b 0x4b 0x4b 0x4b 0x4b 0x4b 0x4b 0x4b 0x4b 0x4b 0x4b 0x4b 0x4b 0x4b 0x4b 0x4b 0x4b 0x4b 0x4b 0x4b 0x4b 0x4b 0x4b 0x4b 0x4b 0x4b 0x4b 0x4b 0x4b 0x4b 0x4b 0x4b 0x4b 0x4b 0x4b 0x4b 0x4b 0x4b 0x4b 0x4b 0x4b 0x4b 0x4b 0x4b 0x4b 0x4b 0x4b 0x4b 0x4b 0x4b 0x4b 0x4b 0x4b 0x4b 0x4b 0x4b 0x4b 0x4b 0x4b 0x4b 0x4b 0x4b 0x4b 0x4b 0x4b 0x4b 0x4b 0x4b 0x4b 0x4b 0x4b 0x4b 0x4b 0x4b 0x4b 0x4b 0x4b 0x4b 0x4b 0x4b 0x4b 0x4b 0x4b 0x4b 0x4b 0x4b 0x4b 0x4b 0x4b 0x4b 0x4b 0x4b 0x4b 0x4b 0x4b 0x4b 0x4b 0x4b 0x4b 0x4b 0x4b 0x4b 0x4b 0x4b 0x4b 0x4b 0x4b 0x4b 0x4b 0x4b 0x4b 0x4b 0x4b 0x4b 0x4b 0x4b 0x4b 0x4b 0x4b 0x4b 0x4b 0x4b 0x4b 0x4b 0x4b 0x4b 0x4b 0x4b 0x4b 0x4b 0x4b 0x4b 0x4b 0x4b 0x4b 0x4b 0x4b 0x4b 0x4b 0x4b 0x4b 0x4b 0x4b 0x4b 0x4b 0x4b 0x4b 0x4b 0x4b 0x4b 0x4b 0x4b 0x4b 0x4b 0x4b 0x4b 0x4b 0x4b 0x4b 0x4b 0x4b 0x4b 0x4b 0x4b 0x4b 0x4b 0x4b 0x4b 0x4b 0x4b 0x4b 0x4b 0x4b 0x4b 0x4b 0x4b 0x4b 0x4b 0x4b 0x4b 0x4b 0x4b 0x4b 0x4b 0x4b 0x4b 0x4b 0x4b 0x4b 0x4b 0x4b 0x4b 0x4b 0x4b 0x4b 0x4b 0x4b 0x4b 0x4b 0x4b 0x4b 0x4b 0x4b 0x4b 0x4b 0x4b 0x4b 0x4b 0x4b 0x4b 0x4b 0x4b 0x4b 0x4b 0x4b 0x4b 0x4b 0x4b 0x4b 0x4b 0x4b 0x4b 0x4b 0x4b 0x4b 0x4b 0x4b 0x4b 0x4b 0x4b 0x4b 0x4b 0x4b 0x4b 0x4b 0x4b 0x4b 0x4b 0x4b 0x4b 0x4b 0x4b 0x4b 0x4b 0x4b 0x4b 0x4b 0x4b 0x4b 0x4b 0x4b 0x4b 0x4b 0x4b 0x4b 0x4b 0x4b 0x4b 0x4b 0x4b 0x4b 0x4b 0x4b 0x4b 0x4b 0x4b 0x4b 0x4b 0x4b 0x4b 0x4b 0x4b 0x4b 0x4b 0x4b 0x4b 0x4b 0x4b 0x4b 0x4b 0x4b 0x4b 0x4b 0x4b 0x4b 0x4b 0x4b 0x4b 0x4b 0x4b 0x4b 0x4b 0x4b 0x4b 0x4b 0x4b 0x4b 0x4b 0x4b 0x4b 0x4b 0x4b 0x4b 0x4b 0x4b 0x4b 0x4b 0x4b 0x4b 0x4b 0x4b 0x4b 0x4b 0x4b 0x4b 0x4b 0x4b 0x4b 0x4b 0x4b 0x4b 0x4b 0x4b 0x4b 0x4b 0x4b 0x4b 0x4b 0x4b 0x4b 0x4b 0x4b 0x4b 0x4b 0x4b 0x4b 0x4b 0x4b 0x4b 0x4b 0x4b 0x4b 0x4b 0x4b 0x4b 0x4b 0x4b 0x4b 0x4b 0x4b 0x4b 0x4b 0x4b 0x4b 0x4b 0x4b 0x4b 0x4b 0x4b 0x4b 0x4b 0x4b 0x4b 0x4b 0x4b 0x4b 0x4b 0x4b 0x4b 0x4b 0x4b 0x4b 0x4b 0x4b 0x4b 0x4b 0x4b 0x4b 0x4b 0x4b 0x4b 0x4b 0x4b 0x4b 0x4b 0x4b 0x4b 0x4b 0x4b 0x4b 0x4b 0x4b 0x4b 0x4b 0x4b 0x4b 0x4b 0x4b 0x4b 0x4b 0x4b 0x4b 0x4b 0x4b 0x4b 0x4b 0x4b 0x4b 0x4b 0x4b 0x4b 0x4b 0x4b 0x4b 0x4b 0x4b 0x4b 0x4b 0x4b 0x4b 0x4b 0x4b 0x4b 0x4b 0x4b 0x4b 0x4b 0x4b 0x4b 0x4b 0x4b 0x4b 0x4b 0x4b 0x4b 0x4b 0x4b 0x4b 0x4b 0x4b 0x4b 0x4b 0x4b 0x4b 0x4b 0x4b 0x4b 0x4b 0x4b 0x4b 0x4b 0x4b 0x4b 0x4b 0x4b 0x4b 0x4b 0x4b 0x4b 0x4b 0x4b 0x4b 0x4b 0x4b 0x4b 0x4b 0x4b 0x4b 0x4b 0x4b 0x4b 0x4b 0x4b 0x4b 0x4b 0x4b 0x4b 0x4b 0x4b 0x4b 0x4b 0x4b 0x4b 0x4b 0x4b 0x4b 0x4b 0x4b 0x4b 0x4b 0x4b 0x4b 0x4b 0x4b 0x4b 0x4b 0x4b 0x4b 0x4b 0x4b 0x4b 0x4b 0x4b 0x4b 0x4b 0x4b 0x4b 0x4b 0x4b 0x4b 0x4b 0x4b 0x4b 0x4b 0x4b>;
					PS_Config_Lmt_FW_Diff_N = <0xffffffb5 0xffffffb5 0xffffffb5 0xffffffb5 0xffffffb5 0xffffffb5 0xffffffb5 0xffffffb5 0xffffffb5 0xffffffb5 0xffffffb5 0xffffffb5 0xffffffb5 0xffffffb5 0xffffffb5 0xffffffb5 0xffffffb5 0xffffffb5 0xffffffb5 0xffffffb5 0xffffffb5 0xffffffb5 0xffffffb5 0xffffffb5 0xffffffb5 0xffffffb5 0xffffffb5 0xffffffb5 0xffffffb5 0xffffffb5 0xffffffb5 0xffffffb5 0xffffffb5 0xffffffb5 0xffffffb5 0xffffffb5 0xffffffb5 0xffffffb5 0xffffffb5 0xffffffb5 0xffffffb5 0xffffffb5 0xffffffb5 0xffffffb5 0xffffffb5 0xffffffb5 0xffffffb5 0xffffffb5 0xffffffb5 0xffffffb5 0xffffffb5 0xffffffb5 0xffffffb5 0xffffffb5 0xffffffb5 0xffffffb5 0xffffffb5 0xffffffb5 0xffffffb5 0xffffffb5 0xffffffb5 0xffffffb5 0xffffffb5 0xffffffb5 0xffffffb5 0xffffffb5 0xffffffb5 0xffffffb5 0xffffffb5 0xffffffb5 0xffffffb5 0xffffffb5 0xffffffb5 0xffffffb5 0xffffffb5 0xffffffb5 0xffffffb5 0xffffffb5 0xffffffb5 0xffffffb5 0xffffffb5 0xffffffb5 0xffffffb5 0xffffffb5 0xffffffb5 0xffffffb5 0xffffffb5 0xffffffb5 0xffffffb5 0xffffffb5 0xffffffb5 0xffffffb5 0xffffffb5 0xffffffb5 0xffffffb5 0xffffffb5 0xffffffb5 0xffffffb5 0xffffffb5 0xffffffb5 0xffffffb5 0xffffffb5 0xffffffb5 0xffffffb5 0xffffffb5 0xffffffb5 0xffffffb5 0xffffffb5 0xffffffb5 0xffffffb5 0xffffffb5 0xffffffb5 0xffffffb5 0xffffffb5 0xffffffb5 0xffffffb5 0xffffffb5 0xffffffb5 0xffffffb5 0xffffffb5 0xffffffb5 0xffffffb5 0xffffffb5 0xffffffb5 0xffffffb5 0xffffffb5 0xffffffb5 0xffffffb5 0xffffffb5 0xffffffb5 0xffffffb5 0xffffffb5 0xffffffb5 0xffffffb5 0xffffffb5 0xffffffb5 0xffffffb5 0xffffffb5 0xffffffb5 0xffffffb5 0xffffffb5 0xffffffb5 0xffffffb5 0xffffffb5 0xffffffb5 0xffffffb5 0xffffffb5 0xffffffb5 0xffffffb5 0xffffffb5 0xffffffb5 0xffffffb5 0xffffffb5 0xffffffb5 0xffffffb5 0xffffffb5 0xffffffb5 0xffffffb5 0xffffffb5 0xffffffb5 0xffffffb5 0xffffffb5 0xffffffb5 0xffffffb5 0xffffffb5 0xffffffb5 0xffffffb5 0xffffffb5 0xffffffb5 0xffffffb5 0xffffffb5 0xffffffb5 0xffffffb5 0xffffffb5 0xffffffb5 0xffffffb5 0xffffffb5 0xffffffb5 0xffffffb5 0xffffffb5 0xffffffb5 0xffffffb5 0xffffffb5 0xffffffb5 0xffffffb5 0xffffffb5 0xffffffb5 0xffffffb5 0xffffffb5 0xffffffb5 0xffffffb5 0xffffffb5 0xffffffb5 0xffffffb5 0xffffffb5 0xffffffb5 0xffffffb5 0xffffffb5 0xffffffb5 0xffffffb5 0xffffffb5 0xffffffb5 0xffffffb5 0xffffffb5 0xffffffb5 0xffffffb5 0xffffffb5 0xffffffb5 0xffffffb5 0xffffffb5 0xffffffb5 0xffffffb5 0xffffffb5 0xffffffb5 0xffffffb5 0xffffffb5 0xffffffb5 0xffffffb5 0xffffffb5 0xffffffb5 0xffffffb5 0xffffffb5 0xffffffb5 0xffffffb5 0xffffffb5 0xffffffb5 0xffffffb5 0xffffffb5 0xffffffb5 0xffffffb5 0xffffffb5 0xffffffb5 0xffffffb5 0xffffffb5 0xffffffb5 0xffffffb5 0xffffffb5 0xffffffb5 0xffffffb5 0xffffffb5 0xffffffb5 0xffffffb5 0xffffffb5 0xffffffb5 0xffffffb5 0xffffffb5 0xffffffb5 0xffffffb5 0xffffffb5 0xffffffb5 0xffffffb5 0xffffffb5 0xffffffb5 0xffffffb5 0xffffffb5 0xffffffb5 0xffffffb5 0xffffffb5 0xffffffb5 0xffffffb5 0xffffffb5 0xffffffb5 0xffffffb5 0xffffffb5 0xffffffb5 0xffffffb5 0xffffffb5 0xffffffb5 0xffffffb5 0xffffffb5 0xffffffb5 0xffffffb5 0xffffffb5 0xffffffb5 0xffffffb5 0xffffffb5 0xffffffb5 0xffffffb5 0xffffffb5 0xffffffb5 0xffffffb5 0xffffffb5 0xffffffb5 0xffffffb5 0xffffffb5 0xffffffb5 0xffffffb5 0xffffffb5 0xffffffb5 0xffffffb5 0xffffffb5 0xffffffb5 0xffffffb5 0xffffffb5 0xffffffb5 0xffffffb5 0xffffffb5 0xffffffb5 0xffffffb5 0xffffffb5 0xffffffb5 0xffffffb5 0xffffffb5 0xffffffb5 0xffffffb5 0xffffffb5 0xffffffb5 0xffffffb5 0xffffffb5 0xffffffb5 0xffffffb5 0xffffffb5 0xffffffb5 0xffffffb5 0xffffffb5 0xffffffb5 0xffffffb5 0xffffffb5 0xffffffb5 0xffffffb5 0xffffffb5 0xffffffb5 0xffffffb5 0xffffffb5 0xffffffb5 0xffffffb5 0xffffffb5 0xffffffb5 0xffffffb5 0xffffffb5 0xffffffb5 0xffffffb5 0xffffffb5 0xffffffb5 0xffffffb5 0xffffffb5 0xffffffb5 0xffffffb5 0xffffffb5 0xffffffb5 0xffffffb5 0xffffffb5 0xffffffb5 0xffffffb5 0xffffffb5 0xffffffb5 0xffffffb5 0xffffffb5 0xffffffb5 0xffffffb5 0xffffffb5 0xffffffb5 0xffffffb5 0xffffffb5 0xffffffb5 0xffffffb5 0xffffffb5 0xffffffb5 0xffffffb5 0xffffffb5 0xffffffb5 0xffffffb5 0xffffffb5 0xffffffb5 0xffffffb5 0xffffffb5 0xffffffb5 0xffffffb5 0xffffffb5 0xffffffb5 0xffffffb5 0xffffffb5 0xffffffb5 0xffffffb5 0xffffffb5 0xffffffb5 0xffffffb5 0xffffffb5 0xffffffb5 0xffffffb5 0xffffffb5 0xffffffb5 0xffffffb5 0xffffffb5 0xffffffb5 0xffffffb5 0xffffffb5 0xffffffb5 0xffffffb5 0xffffffb5 0xffffffb5 0xffffffb5 0xffffffb5 0xffffffb5 0xffffffb5 0xffffffb5 0xffffffb5 0xffffffb5 0xffffffb5 0xffffffb5 0xffffffb5 0xffffffb5 0xffffffb5 0xffffffb5 0xffffffb5 0xffffffb5 0xffffffb5 0xffffffb5 0xffffffb5 0xffffffb5 0xffffffb5 0xffffffb5 0xffffffb5 0xffffffb5 0xffffffb5 0xffffffb5 0xffffffb5 0xffffffb5 0xffffffb5 0xffffffb5 0xffffffb5 0xffffffb5 0xffffffb5 0xffffffb5 0xffffffb5 0xffffffb5 0xffffffb5 0xffffffb5 0xffffffb5 0xffffffb5 0xffffffb5 0xffffffb5 0xffffffb5 0xffffffb5 0xffffffb5 0xffffffb5 0xffffffb5 0xffffffb5 0xffffffb5 0xffffffb5 0xffffffb5 0xffffffb5 0xffffffb5 0xffffffb5 0xffffffb5 0xffffffb5 0xffffffb5 0xffffffb5 0xffffffb5 0xffffffb5 0xffffffb5 0xffffffb5 0xffffffb5 0xffffffb5 0xffffffb5 0xffffffb5 0xffffffb5 0xffffffb5 0xffffffb5 0xffffffb5 0xffffffb5 0xffffffb5 0xffffffb5 0xffffffb5 0xffffffb5 0xffffffb5 0xffffffb5 0xffffffb5 0xffffffb5 0xffffffb5 0xffffffb5 0xffffffb5 0xffffffb5 0xffffffb5 0xffffffb5 0xffffffb5 0xffffffb5 0xffffffb5 0xffffffb5 0xffffffb5 0xffffffb5 0xffffffb5 0xffffffb5 0xffffffb5 0xffffffb5 0xffffffb5 0xffffffb5 0xffffffb5 0xffffffb5 0xffffffb5 0xffffffb5 0xffffffb5 0xffffffb5 0xffffffb5 0xffffffb5 0xffffffb5 0xffffffb5 0xffffffb5 0xffffffb5 0xffffffb5 0xffffffb5 0xffffffb5 0xffffffb5 0xffffffb5 0xffffffb5 0xffffffb5 0xffffffb5 0xffffffb5 0xffffffb5 0xffffffb5 0xffffffb5 0xffffffb5 0xffffffb5 0xffffffb5 0xffffffb5 0xffffffb5 0xffffffb5 0xffffffb5 0xffffffb5 0xffffffb5 0xffffffb5 0xffffffb5 0xffffffb5 0xffffffb5 0xffffffb5 0xffffffb5 0xffffffb5 0xffffffb5 0xffffffb5 0xffffffb5 0xffffffb5 0xffffffb5 0xffffffb5 0xffffffb5 0xffffffb5 0xffffffb5 0xffffffb5 0xffffffb5 0xffffffb5 0xffffffb5 0xffffffb5 0xffffffb5 0xffffffb5 0xffffffb5 0xffffffb5 0xffffffb5 0xffffffb5 0xffffffb5 0xffffffb5 0xffffffb5 0xffffffb5 0xffffffb5 0xffffffb5 0xffffffb5 0xffffffb5 0xffffffb5 0xffffffb5 0xffffffb5 0xffffffb5 0xffffffb5 0xffffffb5 0xffffffb5 0xffffffb5 0xffffffb5 0xffffffb5 0xffffffb5 0xffffffb5 0xffffffb5 0xffffffb5 0xffffffb5 0xffffffb5 0xffffffb5 0xffffffb5 0xffffffb5 0xffffffb5 0xffffffb5 0xffffffb5 0xffffffb5 0xffffffb5>;
					PS_Config_Diff_Test_Frame = <0x32>;
				};

				novatek-mp-criteria-5978@0 {
					#address-cells = <0x01>;
					#size-cells = <0x00>;
					compatible = "novatek-mp-criteria-5978";
					IC_X_CFG_SIZE = <0x10>;
					IC_Y_CFG_SIZE = <0x24>;
					IC_KEY_CFG_SIZE = <0x04>;
					X_Channel = <0x10>;
					Y_Channel = <0x24>;
					AIN_X = <0x00 0x01 0x02 0x03 0x04 0x05 0x06 0x07 0x08 0x09 0x0a 0x0b 0x0c 0x0d 0x0e 0x0f>;
					AIN_Y = <0x00 0x01 0x02 0x03 0x04 0x05 0x06 0x07 0x08 0x09 0x0a 0x0b 0x0c 0x0d 0x0e 0x0f 0x10 0x11 0x12 0x13 0x14 0x15 0x16 0x17 0x18 0x19 0x1a 0x1b 0x1c 0x1d 0x1e 0x1f 0x20 0x21 0x22 0x23>;
					AIN_KEY = <0x00 0x01 0x02 0xff>;
					PS_Config_Lmt_Short_Rawdata_P = <0x36b8 0x36b8 0x36b8 0x36b8 0x36b8 0x36b8 0x36b8 0x36b8 0x36b8 0x36b8 0x36b8 0x36b8 0x36b8 0x36b8 0x36b8 0x36b8 0x36b8 0x36b8 0x36b8 0x36b8 0x36b8 0x36b8 0x36b8 0x36b8 0x36b8 0x36b8 0x36b8 0x36b8 0x36b8 0x36b8 0x36b8 0x36b8 0x36b8 0x36b8 0x36b8 0x36b8 0x36b8 0x36b8 0x36b8 0x36b8 0x36b8 0x36b8 0x36b8 0x36b8 0x36b8 0x36b8 0x36b8 0x36b8 0x36b8 0x36b8 0x36b8 0x36b8 0x36b8 0x36b8 0x36b8 0x36b8 0x36b8 0x36b8 0x36b8 0x36b8 0x36b8 0x36b8 0x36b8 0x36b8 0x36b8 0x36b8 0x36b8 0x36b8 0x36b8 0x36b8 0x36b8 0x36b8 0x36b8 0x36b8 0x36b8 0x36b8 0x36b8 0x36b8 0x36b8 0x36b8 0x36b8 0x36b8 0x36b8 0x36b8 0x36b8 0x36b8 0x36b8 0x36b8 0x36b8 0x36b8 0x36b8 0x36b8 0x36b8 0x36b8 0x36b8 0x36b8 0x36b8 0x36b8 0x36b8 0x36b8 0x36b8 0x36b8 0x36b8 0x36b8 0x36b8 0x36b8 0x36b8 0x36b8 0x36b8 0x36b8 0x36b8 0x36b8 0x36b8 0x36b8 0x36b8 0x36b8 0x36b8 0x36b8 0x36b8 0x36b8 0x36b8 0x36b8 0x36b8 0x36b8 0x36b8 0x36b8 0x36b8 0x36b8 0x36b8 0x36b8 0x36b8 0x36b8 0x36b8 0x36b8 0x36b8 0x36b8 0x36b8 0x36b8 0x36b8 0x36b8 0x36b8 0x36b8 0x36b8 0x36b8 0x36b8 0x36b8 0x36b8 0x36b8 0x36b8 0x36b8 0x36b8 0x36b8 0x36b8 0x36b8 0x36b8 0x36b8 0x36b8 0x36b8 0x36b8 0x36b8 0x36b8 0x36b8 0x36b8 0x36b8 0x36b8 0x36b8 0x36b8 0x36b8 0x36b8 0x36b8 0x36b8 0x36b8 0x36b8 0x36b8 0x36b8 0x36b8 0x36b8 0x36b8 0x36b8 0x36b8 0x36b8 0x36b8 0x36b8 0x36b8 0x36b8 0x36b8 0x36b8 0x36b8 0x36b8 0x36b8 0x36b8 0x36b8 0x36b8 0x36b8 0x36b8 0x36b8 0x36b8 0x36b8 0x36b8 0x36b8 0x36b8 0x36b8 0x36b8 0x36b8 0x36b8 0x36b8 0x36b8 0x36b8 0x36b8 0x36b8 0x36b8 0x36b8 0x36b8 0x36b8 0x36b8 0x36b8 0x36b8 0x36b8 0x36b8 0x36b8 0x36b8 0x36b8 0x36b8 0x36b8 0x36b8 0x36b8 0x36b8 0x36b8 0x36b8 0x36b8 0x36b8 0x36b8 0x36b8 0x36b8 0x36b8 0x36b8 0x36b8 0x36b8 0x36b8 0x36b8 0x36b8 0x36b8 0x36b8 0x36b8 0x36b8 0x36b8 0x36b8 0x36b8 0x36b8 0x36b8 0x36b8 0x36b8 0x36b8 0x36b8 0x36b8 0x36b8 0x36b8 0x36b8 0x36b8 0x36b8 0x36b8 0x36b8 0x36b8 0x36b8 0x36b8 0x36b8 0x36b8 0x36b8 0x36b8 0x36b8 0x36b8 0x36b8 0x36b8 0x36b8 0x36b8 0x36b8 0x36b8 0x36b8 0x36b8 0x36b8 0x36b8 0x36b8 0x36b8 0x36b8 0x36b8 0x36b8 0x36b8 0x36b8 0x36b8 0x36b8 0x36b8 0x36b8 0x36b8 0x36b8 0x36b8 0x36b8 0x36b8 0x36b8 0x36b8 0x36b8 0x36b8 0x36b8 0x36b8 0x36b8 0x36b8 0x36b8 0x36b8 0x36b8 0x36b8 0x36b8 0x36b8 0x36b8 0x36b8 0x36b8 0x36b8 0x36b8 0x36b8 0x36b8 0x36b8 0x36b8 0x36b8 0x36b8 0x36b8 0x36b8 0x36b8 0x36b8 0x36b8 0x36b8 0x36b8 0x36b8 0x36b8 0x36b8 0x36b8 0x36b8 0x36b8 0x36b8 0x36b8 0x36b8 0x36b8 0x36b8 0x36b8 0x36b8 0x36b8 0x36b8 0x36b8 0x36b8 0x36b8 0x36b8 0x36b8 0x36b8 0x36b8 0x36b8 0x36b8 0x36b8 0x36b8 0x36b8 0x36b8 0x36b8 0x36b8 0x36b8 0x36b8 0x36b8 0x36b8 0x36b8 0x36b8 0x36b8 0x36b8 0x36b8 0x36b8 0x36b8 0x36b8 0x36b8 0x36b8 0x36b8 0x36b8 0x36b8 0x36b8 0x36b8 0x36b8 0x36b8 0x36b8 0x36b8 0x36b8 0x36b8 0x36b8 0x36b8 0x36b8 0x36b8 0x36b8 0x36b8 0x36b8 0x36b8 0x36b8 0x36b8 0x36b8 0x36b8 0x36b8 0x36b8 0x36b8 0x36b8 0x36b8 0x36b8 0x36b8 0x36b8 0x36b8 0x36b8 0x36b8 0x36b8 0x36b8 0x36b8 0x36b8 0x36b8 0x36b8 0x36b8 0x36b8 0x36b8 0x36b8 0x36b8 0x36b8 0x36b8 0x36b8 0x36b8 0x36b8 0x36b8 0x36b8 0x36b8 0x36b8 0x36b8 0x36b8 0x36b8 0x36b8 0x36b8 0x36b8 0x36b8 0x36b8 0x36b8 0x36b8 0x36b8 0x36b8 0x36b8 0x36b8 0x36b8 0x36b8 0x36b8 0x36b8 0x36b8 0x36b8 0x36b8 0x36b8 0x36b8 0x36b8 0x36b8 0x36b8 0x36b8 0x36b8 0x36b8 0x36b8 0x36b8 0x36b8 0x36b8 0x36b8 0x36b8 0x36b8 0x36b8 0x36b8 0x36b8 0x36b8 0x36b8 0x36b8 0x36b8 0x36b8 0x36b8 0x36b8 0x36b8 0x36b8 0x36b8 0x36b8 0x36b8 0x36b8 0x36b8 0x36b8 0x36b8 0x36b8 0x36b8 0x36b8 0x36b8 0x36b8 0x36b8 0x36b8 0x36b8 0x36b8 0x36b8 0x36b8 0x36b8 0x36b8 0x36b8 0x36b8 0x36b8 0x36b8 0x36b8 0x36b8 0x36b8 0x36b8 0x36b8 0x36b8 0x36b8 0x36b8 0x36b8 0x36b8 0x36b8 0x36b8 0x36b8 0x36b8 0x36b8 0x36b8 0x36b8 0x36b8 0x36b8 0x36b8 0x36b8 0x36b8 0x36b8 0x36b8 0x36b8 0x36b8 0x36b8 0x36b8 0x36b8 0x36b8 0x36b8 0x36b8 0x36b8 0x36b8 0x36b8 0x36b8 0x36b8 0x36b8 0x36b8 0x36b8 0x36b8 0x36b8 0x36b8 0x36b8 0x36b8 0x36b8 0x36b8 0x36b8 0x36b8 0x36b8 0x36b8 0x36b8 0x36b8 0x36b8 0x36b8 0x36b8 0x36b8 0x36b8 0x36b8 0x36b8 0x36b8 0x36b8 0x36b8 0x36b8 0x36b8 0x36b8 0x36b8 0x36b8 0x36b8 0x36b8 0x36b8 0x36b8 0x36b8 0x36b8 0x36b8 0x36b8 0x36b8 0x36b8 0x36b8 0x36b8>;
					PS_Config_Lmt_Short_Rawdata_N = <0x2774 0x2774 0x2774 0x2774 0x2774 0x2774 0x2774 0x2774 0x2774 0x2774 0x2774 0x2774 0x2774 0x2774 0x2774 0x2774 0x2774 0x2774 0x2774 0x2774 0x2774 0x2774 0x2774 0x2774 0x2774 0x2774 0x2774 0x2774 0x2774 0x2774 0x2774 0x2774 0x2774 0x2774 0x2774 0x2774 0x2774 0x2774 0x2774 0x2774 0x2774 0x2774 0x2774 0x2774 0x2774 0x2774 0x2774 0x2774 0x2774 0x2774 0x2774 0x2774 0x2774 0x2774 0x2774 0x2774 0x2774 0x2774 0x2774 0x2774 0x2774 0x2774 0x2774 0x2774 0x2774 0x2774 0x2774 0x2774 0x2774 0x2774 0x2774 0x2774 0x2774 0x2774 0x2774 0x2774 0x2774 0x2774 0x2774 0x2774 0x2774 0x2774 0x2774 0x2774 0x2774 0x2774 0x2774 0x2774 0x2774 0x2774 0x2774 0x2774 0x2774 0x2774 0x2774 0x2774 0x2774 0x2774 0x2774 0x2774 0x2774 0x2774 0x2774 0x2774 0x2774 0x2774 0x2774 0x2774 0x2774 0x2774 0x2774 0x2774 0x2774 0x2774 0x2774 0x2774 0x2774 0x2774 0x2774 0x2774 0x2774 0x2774 0x2774 0x2774 0x2774 0x2774 0x2774 0x2774 0x2774 0x2774 0x2774 0x2774 0x2774 0x2774 0x2774 0x2774 0x2774 0x2774 0x2774 0x2774 0x2774 0x2774 0x2774 0x2774 0x2774 0x2774 0x2774 0x2774 0x2774 0x2774 0x2774 0x2774 0x2774 0x2774 0x2774 0x2774 0x2774 0x2774 0x2774 0x2774 0x2774 0x2774 0x2774 0x2774 0x2774 0x2774 0x2774 0x2774 0x2774 0x2774 0x2774 0x2774 0x2774 0x2774 0x2774 0x2774 0x2774 0x2774 0x2774 0x2774 0x2774 0x2774 0x2774 0x2774 0x2774 0x2774 0x2774 0x2774 0x2774 0x2774 0x2774 0x2774 0x2774 0x2774 0x2774 0x2774 0x2774 0x2774 0x2774 0x2774 0x2774 0x2774 0x2774 0x2774 0x2774 0x2774 0x2774 0x2774 0x2774 0x2774 0x2774 0x2774 0x2774 0x2774 0x2774 0x2774 0x2774 0x2774 0x2774 0x2774 0x2774 0x2774 0x2774 0x2774 0x2774 0x2774 0x2774 0x2774 0x2774 0x2774 0x2774 0x2774 0x2774 0x2774 0x2774 0x2774 0x2774 0x2774 0x2774 0x2774 0x2774 0x2774 0x2774 0x2774 0x2774 0x2774 0x2774 0x2774 0x2774 0x2774 0x2774 0x2774 0x2774 0x2774 0x2774 0x2774 0x2774 0x2774 0x2774 0x2774 0x2774 0x2774 0x2774 0x2774 0x2774 0x2774 0x2774 0x2774 0x2774 0x2774 0x2774 0x2774 0x2774 0x2774 0x2774 0x2774 0x2774 0x2774 0x2774 0x2774 0x2774 0x2774 0x2774 0x2774 0x2774 0x2774 0x2774 0x2774 0x2774 0x2774 0x2774 0x2774 0x2774 0x2774 0x2774 0x2774 0x2774 0x2774 0x2774 0x2774 0x2774 0x2774 0x2774 0x2774 0x2774 0x2774 0x2774 0x2774 0x2774 0x2774 0x2774 0x2774 0x2774 0x2774 0x2774 0x2774 0x2774 0x2774 0x2774 0x2774 0x2774 0x2774 0x2774 0x2774 0x2774 0x2774 0x2774 0x2774 0x2774 0x2774 0x2774 0x2774 0x2774 0x2774 0x2774 0x2774 0x2774 0x2774 0x2774 0x2774 0x2774 0x2774 0x2774 0x2774 0x2774 0x2774 0x2774 0x2774 0x2774 0x2774 0x2774 0x2774 0x2774 0x2774 0x2774 0x2774 0x2774 0x2774 0x2774 0x2774 0x2774 0x2774 0x2774 0x2774 0x2774 0x2774 0x2774 0x2774 0x2774 0x2774 0x2774 0x2774 0x2774 0x2774 0x2774 0x2774 0x2774 0x2774 0x2774 0x2774 0x2774 0x2774 0x2774 0x2774 0x2774 0x2774 0x2774 0x2774 0x2774 0x2774 0x2774 0x2774 0x2774 0x2774 0x2774 0x2774 0x2774 0x2774 0x2774 0x2774 0x2774 0x2774 0x2774 0x2774 0x2774 0x2774 0x2774 0x2774 0x2774 0x2774 0x2774 0x2774 0x2774 0x2774 0x2774 0x2774 0x2774 0x2774 0x2774 0x2774 0x2774 0x2774 0x2774 0x2774 0x2774 0x2774 0x2774 0x2774 0x2774 0x2774 0x2774 0x2774 0x2774 0x2774 0x2774 0x2774 0x2774 0x2774 0x2774 0x2774 0x2774 0x2774 0x2774 0x2774 0x2774 0x2774 0x2774 0x2774 0x2774 0x2774 0x2774 0x2774 0x2774 0x2774 0x2774 0x2774 0x2774 0x2774 0x2774 0x2774 0x2774 0x2774 0x2774 0x2774 0x2774 0x2774 0x2774 0x2774 0x2774 0x2774 0x2774 0x2774 0x2774 0x2774 0x2774 0x2774 0x2774 0x2774 0x2774 0x2774 0x2774 0x2774 0x2774 0x2774 0x2774 0x2774 0x2774 0x2774 0x2774 0x2774 0x2774 0x2774 0x2774 0x2774 0x2774 0x2774 0x2774 0x2774 0x2774 0x2774 0x2774 0x2774 0x2774 0x2774 0x2774 0x2774 0x2774 0x2774 0x2774 0x2774 0x2774 0x2774 0x2774 0x2774 0x2774 0x2774 0x2774 0x2774 0x2774 0x2774 0x2774 0x2774 0x2774 0x2774 0x2774 0x2774 0x2774 0x2774 0x2774 0x2774 0x2774 0x2774 0x2774 0x2774 0x2774 0x2774 0x2774 0x2774 0x2774 0x2774 0x2774 0x2774 0x2774 0x2774 0x2774 0x2774 0x2774 0x2774 0x2774 0x2774 0x2774 0x2774 0x2774 0x2774 0x2774 0x2774 0x2774 0x2774 0x2774 0x2774 0x2774 0x2774 0x2774 0x2774 0x2774 0x2774 0x2774 0x2774 0x2774 0x2774 0x2774 0x2774 0x2774 0x2774 0x2774 0x2774 0x2710 0x2710 0x2710>;
					PS_Config_Lmt_Open_Rawdata_P = <0xb11 0xb3d 0xba3 0xbd5 0xbf4 0xbfa 0xc2f 0xb6f 0xb68 0xbd9 0xbe2 0xbc2 0xbd1 0xb8e 0xb54 0xb22 0xb54 0xb65 0xbd2 0xbfa 0xc25 0xc2c 0xc5c 0xbf7 0xbd1 0xc01 0xc06 0xbe0 0xbee 0xbab 0xb76 0xb5d 0xb56 0xb80 0xbed 0xc1b 0xc49 0xc48 0xc7f 0xc50 0xc2f 0xc2c 0xc36 0xc11 0xc21 0xbce 0xba1 0xb80 0xb99 0xba7 0xc16 0xc41 0xc6b 0xc64 0xc98 0xc65 0xc49 0xc33 0xc42 0xc1d 0xc30 0xbe3 0xbb4 0xb9d 0xbb9 0xbd1 0xc39 0xc6c 0xc9d 0xc95 0xcc2 0xc8f 0xc83 0xc63 0xc68 0xc44 0xc4e 0xbf8 0xbcb 0xbb2 0xbec 0xbe6 0xc61 0xc99 0xcd0 0xcc9 0xcec 0xcb9 0xca9 0xc6c 0xc8b 0xc67 0xc75 0xc1b 0xbf1 0xbdf 0xbe6 0xc05 0xc6c 0xc9d 0xcdf 0xcd7 0xcfe 0xcc3 0xcbe 0xc9b 0xca2 0xc75 0xc7d 0xc29 0xbf4 0xbea 0xbf4 0xc1b 0xc72 0xcaa 0xcf6 0xcec 0xd16 0xcd4 0xcdf 0xcb8 0xca9 0xc86 0xc8d 0xc37 0xc06 0xc05 0xc24 0xc53 0xcb9 0xcdc 0xd30 0xd21 0xd53 0xd0c 0xd2b 0xcf6 0xcfe 0xcc7 0xcc2 0xc68 0xc3b 0xc2d 0xc29 0xc52 0xcbb 0xcde 0xd36 0xd1a 0xd51 0xd02 0xd58 0xd21 0xd24 0xcec 0xce2 0xc87 0xc55 0xc59 0xc5a 0xc92 0xcf6 0xcff 0xd71 0xd5a 0xd8d 0xd43 0xd6b 0xd39 0xd3c 0xcec 0xcf0 0xc96 0xc61 0xc67 0xc75 0xcb0 0xd0c 0xd36 0xd89 0xd71 0xda3 0xd4f 0xd87 0xd58 0xd58 0xd27 0xd08 0xcab 0xc78 0xc86 0xc8d 0xccd 0xd33 0xd58 0xda5 0xd98 0xdc9 0xd66 0xd9e 0xd6d 0xd75 0xd39 0xd06 0xcb9 0xc86 0xc8b 0xca0 0xce5 0xd4e 0xd6d 0xdca 0xdb0 0xde9 0xd79 0xdbc 0xd87 0xd91 0xd5a 0xd2e 0xccd 0xc9d 0xcb1 0xcbc 0xd0d 0xd6f 0xd90 0xded 0xdc9 0xe08 0xd8e 0xde5 0xdac 0xdad 0xd79 0xd51 0xcdb 0xcb7 0xcc0 0xcd0 0xd24 0xd83 0xda2 0xe04 0xdbf 0xe1d 0xda0 0xe0e 0xdd6 0xdde 0xda7 0xd76 0xce9 0xcda 0xcec 0xce2 0xd40 0xd97 0xdbb 0xe21 0xe04 0xe43 0xdbf 0xe15 0xdde 0xde2 0xdae 0xd7d 0xd08 0xccc 0xcea 0xcf8 0xd58 0xda9 0xdcc 0xe38 0xe23 0xe54 0xddf 0xe3d 0xe09 0xe0e 0xdd6 0xd9f 0xd2e 0xccc 0xcf4 0xd3a 0xcd3 0xd29 0xd30 0xd48 0xd33 0xd71 0xd67 0xd14 0xd67 0xd60 0xd2b 0xd3a 0xd09 0xd17 0xcc6 0xd80 0xd02 0xd4c 0xd53 0xd6d 0xd59 0xd91 0xd82 0xd3d 0xd83 0xd87 0xd53 0xd61 0xd2e 0xd39 0xce8 0xd7d 0xd20 0xd5c 0xd5f 0xd79 0xd64 0xda2 0xd6f 0xd5a 0xd97 0xda2 0xd71 0xd7d 0xd4e 0xd55 0xcd3 0xd99 0xd40 0xd7c 0xd75 0xd94 0xd7c 0xdb8 0xd94 0xd5c 0xd98 0xda6 0xd76 0xd82 0xd53 0xd53 0xcff 0xd8d 0xd4c 0xd87 0xd84 0xda6 0xd89 0xdc2 0xd9f 0xd89 0xdc6 0xdca 0xda6 0xdae 0xd78 0xd7b 0xd1d 0xda9 0xd6b 0xda2 0xda0 0xdbc 0xd9f 0xdd7 0xdb3 0xda2 0xdd4 0xddf 0xdbb 0xdc6 0xd8e 0xd8e 0xd39 0xd9b 0xd6d 0xda6 0xda7 0xdca 0xdb5 0xdec 0xdcf 0xdae 0xddb 0xddf 0xdbb 0xdc8 0xd98 0xd92 0xd3c 0xdc6 0xd9b 0xdcf 0xdd0 0xdf4 0xddf 0xe0c 0xded 0xdc2 0xde5 0xded 0xdcd 0xddb 0xda3 0xd9c 0xd44 0xdae 0xd94 0xdc9 0xdc9 0xdeb 0xdcd 0xe00 0xdda 0xdb8 0xdd7 0xde6 0xdc1 0xdcf 0xd95 0xd94 0xd32 0xdd7 0xdbc 0xdf3 0xdf2 0xe15 0xdfa 0xe2b 0xe05 0xdda 0xdf2 0xdfe 0xddb 0xde5 0xdb3 0xdb1 0xd59 0xdc3 0xdbe 0xdef 0xdf7 0xe12 0xdf7 0xe28 0xdfa 0xde2 0xdfb 0xe02 0xde6 0xdf4 0xdc2 0xdbe 0xd5f 0xdc9 0xdc1 0xdf3 0xdfe 0xe16 0xdf6 0xe2f 0xe00 0xdf7 0xe0e 0xe16 0xdf9 0xe04 0xdd1 0xdc9 0xd79 0xdc6 0xdd0 0xe07 0xe0b 0xe24 0xe07 0xe3a 0xe02 0xdfd 0xe12 0xe20 0xdfb 0xe05 0xdd7 0xdc1 0xd6f 0xdcc 0xdd8 0xe12 0xe13 0xe2a 0xe0f 0xe39 0xe02 0xe07 0xe16 0xe1d 0xdfe 0xe0b 0xdde 0xdc8 0xd83 0xddb 0xdec 0xe32 0xe31 0xe47 0xe2b 0xe5b 0xe20 0xe10 0xe1d 0xe28 0xe0b 0xe16 0xde8 0xdd0 0xd82 0xdf9 0xe0b 0xe59 0xe5b 0xe6e 0xe55 0xe8a 0xe4a 0xe52 0xe63 0xe64 0xe44 0xe4b 0xe1a 0xdfa 0xdb4 0xdeb 0xe2c 0xe7c 0xe80 0xe95 0xe80 0xeb1 0xe70 0xe5b 0xe6d 0xe6a 0xe4d 0xe54 0xe21 0xdf6 0xd8d 0xc45 0xd1a 0xdbc 0xe8e 0xea3 0xe89 0xeba 0xe78 0xe94 0xeaa 0xea6 0xe87 0xe90 0xdb5 0xce5 0xc4b 0x1400 0x1400 0x1400>;
					PS_Config_Lmt_Open_Rawdata_N = <0x4be 0x4d1 0x4fc 0x512 0x51f 0x522 0x538 0x4e6 0x4e3 0x514 0x517 0x50a 0x510 0x4f3 0x4db 0x4c5 0x4db 0x4e2 0x511 0x522 0x534 0x537 0x54c 0x520 0x510 0x525 0x527 0x517 0x51d 0x500 0x4e9 0x4de 0x4db 0x4ed 0x51c 0x530 0x544 0x543 0x55b 0x547 0x538 0x537 0x53b 0x52c 0x532 0x50f 0x4fc 0x4ed 0x4f8 0x4fe 0x52e 0x540 0x552 0x54f 0x565 0x550 0x544 0x53a 0x541 0x531 0x539 0x518 0x504 0x4fa 0x506 0x510 0x53d 0x553 0x568 0x564 0x577 0x562 0x55c 0x54f 0x551 0x541 0x546 0x521 0x50e 0x503 0x51c 0x519 0x54e 0x566 0x57d 0x57a 0x589 0x574 0x56d 0x553 0x560 0x550 0x556 0x530 0x51e 0x516 0x519 0x526 0x553 0x568 0x584 0x580 0x591 0x578 0x576 0x567 0x56a 0x556 0x55a 0x536 0x51f 0x51b 0x51f 0x530 0x555 0x56d 0x58e 0x589 0x59b 0x57f 0x584 0x573 0x56d 0x55e 0x561 0x53c 0x527 0x526 0x534 0x548 0x574 0x583 0x5a7 0x5a0 0x5b6 0x597 0x5a4 0x58e 0x591 0x57a 0x577 0x551 0x53e 0x538 0x536 0x547 0x574 0x583 0x5a9 0x59d 0x5b5 0x593 0x5b8 0x5a0 0x5a1 0x589 0x585 0x55e 0x549 0x54a 0x54b 0x563 0x58e 0x592 0x5c2 0x5b9 0x5ce 0x5af 0x5c0 0x5aa 0x5ac 0x589 0x58b 0x565 0x54e 0x550 0x556 0x570 0x597 0x5a9 0x5cd 0x5c2 0x5d8 0x5b4 0x5cc 0x5b8 0x5b8 0x5a3 0x595 0x56e 0x558 0x55e 0x561 0x57c 0x5a8 0x5b8 0x5d9 0x5d3 0x5e8 0x5be 0x5d6 0x5c1 0x5c4 0x5aa 0x595 0x574 0x55e 0x560 0x569 0x586 0x5b3 0x5c1 0x5e9 0x5dd 0x5f6 0x5c6 0x5e3 0x5cc 0x5d0 0x5b9 0x5a6 0x57c 0x568 0x570 0x575 0x598 0x5c2 0x5d0 0x5f8 0x5e8 0x603 0x5cf 0x5f4 0x5dc 0x5dc 0x5c6 0x5b5 0x582 0x573 0x577 0x57d 0x5a1 0x5ca 0x5d7 0x601 0x5e4 0x60c 0x5d7 0x606 0x5ee 0x5f1 0x5da 0x5c5 0x588 0x582 0x589 0x585 0x5ad 0x5d3 0x5e2 0x60e 0x601 0x61c 0x5e4 0x609 0x5f1 0x5f3 0x5dd 0x5c8 0x595 0x57c 0x589 0x58f 0x5b8 0x5da 0x5e9 0x618 0x60f 0x624 0x5f2 0x61a 0x604 0x606 0x5ee 0x5d6 0x5a6 0x57c 0x58d 0x5ab 0x57f 0x5a4 0x5a7 0x5b1 0x5a8 0x5c2 0x5be 0x59b 0x5be 0x5bb 0x5a4 0x5ab 0x596 0x59c 0x579 0x5c9 0x593 0x5b3 0x5b6 0x5c1 0x5b8 0x5d0 0x5ca 0x5ac 0x5ca 0x5cc 0x5b6 0x5bc 0x5a6 0x5aa 0x588 0x5c8 0x5a0 0x5b9 0x5bb 0x5c6 0x5bd 0x5d7 0x5c2 0x5b9 0x5d3 0x5d7 0x5c2 0x5c8 0x5b3 0x5b6 0x57f 0x5d4 0x5ad 0x5c7 0x5c4 0x5d1 0x5c7 0x5e1 0x5d1 0x5b9 0x5d3 0x5d9 0x5c5 0x5ca 0x5b6 0x5b6 0x592 0x5ce 0x5b3 0x5cc 0x5cb 0x5d9 0x5cd 0x5e5 0x5d6 0x5cd 0x5e7 0x5e9 0x5d9 0x5dd 0x5c5 0x5c7 0x59e 0x5da 0x5c0 0x5d7 0x5d7 0x5e3 0x5d6 0x5ee 0x5df 0x5d7 0x5ed 0x5f2 0x5e2 0x5e7 0x5cf 0x5cf 0x5aa 0x5d4 0x5c1 0x5d9 0x5da 0x5e9 0x5e0 0x5f7 0x5eb 0x5dd 0x5f0 0x5f2 0x5e2 0x5e8 0x5d3 0x5d1 0x5ac 0x5e7 0x5d4 0x5eb 0x5eb 0x5fb 0x5f2 0x605 0x5f8 0x5e5 0x5f4 0x5f8 0x5ea 0x5f0 0x5d8 0x5d5 0x5af 0x5dd 0x5d1 0x5e8 0x5e8 0x5f7 0x5ea 0x600 0x5ef 0x5e1 0x5ee 0x5f5 0x5e5 0x5eb 0x5d2 0x5d1 0x5a7 0x5ee 0x5e3 0x5fa 0x5fa 0x609 0x5fd 0x612 0x602 0x5ef 0x5fa 0x5ff 0x5f0 0x5f4 0x5df 0x5de 0x5b8 0x5e6 0x5e3 0x5f8 0x5fc 0x607 0x5fc 0x611 0x5fd 0x5f3 0x5fe 0x601 0x5f5 0x5fb 0x5e5 0x5e3 0x5bb 0x5e8 0x5e5 0x5fa 0x5ff 0x609 0x5fb 0x614 0x600 0x5fc 0x606 0x609 0x5fd 0x601 0x5ec 0x5e8 0x5c6 0x5e7 0x5eb 0x603 0x604 0x60f 0x603 0x619 0x601 0x5fe 0x607 0x60d 0x5fe 0x602 0x5ee 0x5e5 0x5c2 0x5e9 0x5ef 0x607 0x608 0x612 0x606 0x618 0x601 0x603 0x609 0x60c 0x5ff 0x604 0x5f1 0x5e8 0x5ca 0x5f0 0x5f7 0x615 0x615 0x61e 0x612 0x627 0x60d 0x607 0x60c 0x611 0x604 0x609 0x5f5 0x5eb 0x5ca 0x5fd 0x604 0x626 0x627 0x62f 0x624 0x63b 0x61f 0x623 0x62a 0x62b 0x61d 0x620 0x60b 0x5fd 0x5df 0x5f7 0x613 0x635 0x637 0x640 0x637 0x64c 0x630 0x627 0x62e 0x62d 0x621 0x624 0x60e 0x5fb 0x5ce 0x542 0x59d 0x5e3 0x63d 0x646 0x63a 0x64f 0x633 0x63f 0x649 0x647 0x63a 0x63d 0x5e0 0x586 0x544 0xfffffe01 0xfffffe01 0xfffffe01>;
					PS_Config_Lmt_FW_Rawdata_P = <0x464 0x464 0x465 0x462 0x46c 0x465 0x464 0x461 0x45b 0x44d 0x456 0x468 0x454 0x46c 0x462 0x457 0x46c 0x446 0x445 0x449 0x43f 0x44b 0x448 0x469 0x46e 0x460 0x462 0x460 0x464 0x460 0x460 0x469 0x45e 0x456 0x45d 0x457 0x45a 0x45e 0x462 0x462 0x457 0x470 0x472 0x46c 0x470 0x472 0x473 0x442 0x452 0x467 0x46c 0x46b 0x457 0x462 0x45d 0x46f 0x470 0x46e 0x46c 0x46f 0x470 0x46e 0x470 0x452 0x464 0x446 0x446 0x445 0x44f 0x450 0x457 0x457 0x446 0x467 0x456 0x452 0x459 0x45b 0x457 0x44f 0x450 0x468 0x46c 0x46c 0x465 0x469 0x465 0x470 0x467 0x45d 0x461 0x462 0x461 0x454 0x45a 0x45e 0x452 0x46e 0x47e 0x483 0x47c 0x47e 0x479 0x47a 0x445 0x454 0x456 0x456 0x444 0x457 0x441 0x460 0x464 0x462 0x468 0x464 0x44f 0x462 0x450 0x475 0x453 0x459 0x45a 0x45e 0x453 0x45a 0x456 0x470 0x45d 0x457 0x456 0x454 0x467 0x44d 0x460 0x44d 0x452 0x454 0x454 0x45a 0x453 0x456 0x452 0x467 0x45a 0x45e 0x460 0x464 0x465 0x45b 0x45d 0x45a 0x462 0x46f 0x479 0x480 0x46f 0x483 0x483 0x459 0x456 0x454 0x44c 0x44b 0x454 0x452 0x453 0x459 0x465 0x461 0x45d 0x461 0x464 0x45e 0x462 0x459 0x464 0x449 0x449 0x449 0x445 0x44d 0x450 0x468 0x454 0x44f 0x454 0x452 0x44f 0x450 0x442 0x465 0x45b 0x467 0x465 0x467 0x467 0x461 0x465 0x45d 0x469 0x468 0x45d 0x45a 0x469 0x457 0x462 0x452 0x453 0x46c 0x45e 0x464 0x467 0x45e 0x46b 0x457 0x45d 0x456 0x450 0x44c 0x45b 0x449 0x44d 0x456 0x46b 0x450 0x450 0x449 0x457 0x44d 0x452 0x456 0x452 0x44f 0x44d 0x457 0x44b 0x454 0x448 0x467 0x456 0x45d 0x456 0x45b 0x457 0x462 0x465 0x45b 0x45d 0x45a 0x45e 0x45d 0x45e 0x45a 0x45d 0x454 0x46b 0x45a 0x460 0x464 0x465 0x465 0x467 0x460 0x453 0x453 0x452 0x46f 0x45b 0x472 0x452 0x459 0x456 0x459 0x457 0x454 0x450 0x456 0x464 0x45d 0x461 0x46e 0x46e 0x464 0x465 0x45e 0x468 0x454 0x442 0x465 0x450 0x44c 0x448 0x45d 0x457 0x448 0x45e 0x46e 0x469 0x465 0x46e 0x468 0x46c 0x457 0x459 0x44f 0x44c 0x456 0x462 0x452 0x44f 0x44d 0x469 0x45a 0x45d 0x457 0x45a 0x459 0x459 0x45d 0x45b 0x462 0x45b 0x464 0x45a 0x45b 0x459 0x459 0x45d 0x462 0x464 0x45e 0x462 0x462 0x460 0x452 0x464 0x468 0x462 0x45e 0x45b 0x45d 0x46b 0x467 0x465 0x468 0x462 0x460 0x468 0x462 0x45e 0x450 0x44f 0x457 0x457 0x453 0x453 0x44b 0x464 0x460 0x464 0x459 0x45a 0x456 0x45b 0x456 0x464 0x45b 0x43f 0x467 0x468 0x462 0x464 0x45e 0x46c 0x46f 0x46f 0x460 0x45a 0x467 0x465 0x461 0x465 0x465 0x469 0x45d 0x45a 0x453 0x454 0x453 0x459 0x45a 0x457 0x470 0x460 0x47d 0x47c 0x479 0x476 0x44d 0x460 0x469 0x45d 0x460 0x461 0x465 0x461 0x45a 0x457 0x457 0x457 0x44f 0x456 0x457 0x459 0x462 0x45d 0x465 0x46c 0x45d 0x460 0x456 0x468 0x464 0x469 0x470 0x46e 0x461 0x46c 0x473 0x470 0x446 0x46e 0x444 0x449 0x446 0x445 0x44d 0x44c 0x44f 0x453 0x467 0x46b 0x461 0x467 0x469 0x468 0x465 0x45d 0x457 0x45d 0x44b 0x454 0x44c 0x450 0x444 0x45d 0x45d 0x45b 0x45d 0x457 0x45b 0x459 0x45e 0x449 0x45a 0x45e 0x456 0x457 0x452 0x45d 0x457 0x475 0x46f 0x46b 0x467 0x46c 0x46f 0x475 0x445 0x449 0x465 0x46b 0x465 0x468 0x45a 0x467 0x45e 0x454 0x45a 0x45d 0x460 0x456 0x453 0x44f 0x450 0x45e 0x454 0x454 0x44d 0x457 0x452 0x459 0x452 0x445 0x462 0x461 0x465 0x460 0x445 0x454 0x45e 0x467 0x45a 0x44f 0x44f 0x44b 0x44d 0x45d 0x456 0x457 0x45b 0x454 0x45b 0x45a 0x464 0x45e 0x448 0x457 0x469 0x450 0x473 0x46c 0x46f 0x46c 0x461 0x476 0x479 0x473 0x476 0x473 0x47c 0x477 0x449 0x459 0x469 0x44d 0x465 0x468 0x460 0x464 0x461 0x45b 0x460 0x457 0x461 0x45e 0x45a 0x468 0x456 0x462 0x45d 0x453 0x459 0x465 0x45d 0x46e 0x465 0x449 0x454 0x469 0x464 0x46f 0x472 0x454 0x461 0xf00 0xf00 0xf00>;
					PS_Config_Lmt_FW_Rawdata_N = <0x1e1 0x1e1 0x1e2 0x1e1 0x1e5 0x1e2 0x1e1 0x1e0 0x1de 0x1d8 0x1db 0x1e3 0x1db 0x1e5 0x1e1 0x1dc 0x1e5 0x1d5 0x1d4 0x1d6 0x1d2 0x1d7 0x1d5 0x1e4 0x1e6 0x1e0 0x1e1 0x1e0 0x1e1 0x1e0 0x1e0 0x1e4 0x1df 0x1db 0x1de 0x1dc 0x1dd 0x1df 0x1e1 0x1e1 0x1dc 0x1e7 0x1e7 0x1e5 0x1e7 0x1e7 0x1e8 0x1d3 0x1da 0x1e3 0x1e5 0x1e4 0x1dc 0x1e1 0x1de 0x1e6 0x1e7 0x1e6 0x1e5 0x1e6 0x1e7 0x1e6 0x1e7 0x1da 0x1e1 0x1d5 0x1d5 0x1d4 0x1d8 0x1d9 0x1dc 0x1dc 0x1d5 0x1e3 0x1db 0x1da 0x1dd 0x1de 0x1dc 0x1d8 0x1d9 0x1e3 0x1e5 0x1e5 0x1e2 0x1e4 0x1e2 0x1e7 0x1e3 0x1de 0x1e0 0x1e1 0x1e0 0x1db 0x1dd 0x1df 0x1da 0x1e6 0x1ed 0x1ef 0x1ec 0x1ed 0x1ea 0x1eb 0x1d4 0x1db 0x1db 0x1db 0x1d4 0x1dc 0x1d2 0x1e0 0x1e1 0x1e1 0x1e3 0x1e1 0x1d8 0x1e1 0x1d9 0x1e9 0x1da 0x1dd 0x1dd 0x1df 0x1da 0x1dd 0x1db 0x1e7 0x1de 0x1dc 0x1db 0x1db 0x1e3 0x1d8 0x1e0 0x1d8 0x1da 0x1db 0x1db 0x1dd 0x1da 0x1db 0x1da 0x1e3 0x1dd 0x1df 0x1e0 0x1e1 0x1e2 0x1de 0x1de 0x1dd 0x1e1 0x1e6 0x1ea 0x1ed 0x1e6 0x1ef 0x1ef 0x1dd 0x1db 0x1db 0x1d7 0x1d7 0x1db 0x1da 0x1da 0x1dd 0x1e2 0x1e0 0x1de 0x1e0 0x1e1 0x1df 0x1e1 0x1dd 0x1e1 0x1d6 0x1d6 0x1d6 0x1d4 0x1d8 0x1d9 0x1e3 0x1db 0x1d8 0x1db 0x1da 0x1d8 0x1d9 0x1d3 0x1e2 0x1de 0x1e3 0x1e2 0x1e3 0x1e3 0x1e0 0x1e2 0x1de 0x1e4 0x1e3 0x1de 0x1dd 0x1e4 0x1dc 0x1e1 0x1da 0x1da 0x1e5 0x1df 0x1e1 0x1e3 0x1df 0x1e4 0x1dc 0x1de 0x1db 0x1d9 0x1d7 0x1de 0x1d6 0x1d8 0x1db 0x1e4 0x1d9 0x1d9 0x1d6 0x1dc 0x1d8 0x1da 0x1db 0x1da 0x1d8 0x1d8 0x1dc 0x1d7 0x1db 0x1d5 0x1e3 0x1db 0x1de 0x1db 0x1de 0x1dc 0x1e1 0x1e2 0x1de 0x1de 0x1dd 0x1df 0x1de 0x1df 0x1dd 0x1de 0x1db 0x1e4 0x1dd 0x1e0 0x1e1 0x1e2 0x1e2 0x1e3 0x1e0 0x1da 0x1da 0x1da 0x1e6 0x1de 0x1e7 0x1da 0x1dd 0x1db 0x1dd 0x1dc 0x1db 0x1d9 0x1db 0x1e1 0x1de 0x1e0 0x1e6 0x1e6 0x1e1 0x1e2 0x1df 0x1e3 0x1db 0x1d3 0x1e2 0x1d9 0x1d7 0x1d5 0x1de 0x1dc 0x1d5 0x1df 0x1e6 0x1e4 0x1e2 0x1e6 0x1e3 0x1e5 0x1dc 0x1dd 0x1d8 0x1d7 0x1db 0x1e1 0x1da 0x1d8 0x1d8 0x1e4 0x1dd 0x1de 0x1dc 0x1dd 0x1dd 0x1dd 0x1de 0x1de 0x1e1 0x1de 0x1e1 0x1dd 0x1de 0x1dd 0x1dd 0x1de 0x1e1 0x1e1 0x1df 0x1e1 0x1e1 0x1e0 0x1da 0x1e1 0x1e3 0x1e1 0x1df 0x1de 0x1de 0x1e4 0x1e3 0x1e2 0x1e3 0x1e1 0x1e0 0x1e3 0x1e1 0x1df 0x1d9 0x1d8 0x1dc 0x1dc 0x1da 0x1da 0x1d7 0x1e1 0x1e0 0x1e1 0x1dd 0x1dd 0x1db 0x1de 0x1db 0x1e1 0x1de 0x1d2 0x1e3 0x1e3 0x1e1 0x1e1 0x1df 0x1e5 0x1e6 0x1e6 0x1e0 0x1dd 0x1e3 0x1e2 0x1e0 0x1e2 0x1e2 0x1e4 0x1de 0x1dd 0x1da 0x1db 0x1da 0x1dd 0x1dd 0x1dc 0x1e7 0x1e0 0x1ec 0x1ec 0x1ea 0x1e9 0x1d8 0x1e0 0x1e4 0x1de 0x1e0 0x1e0 0x1e2 0x1e0 0x1dd 0x1dc 0x1dc 0x1dc 0x1d8 0x1db 0x1dc 0x1dd 0x1e1 0x1de 0x1e2 0x1e5 0x1de 0x1e0 0x1db 0x1e3 0x1e1 0x1e4 0x1e7 0x1e6 0x1e0 0x1e5 0x1e8 0x1e7 0x1d5 0x1e6 0x1d4 0x1d6 0x1d5 0x1d4 0x1d8 0x1d7 0x1d8 0x1da 0x1e3 0x1e4 0x1e0 0x1e3 0x1e4 0x1e3 0x1e2 0x1de 0x1dc 0x1de 0x1d7 0x1db 0x1d7 0x1d9 0x1d4 0x1de 0x1de 0x1de 0x1de 0x1dc 0x1de 0x1dd 0x1df 0x1d6 0x1dd 0x1df 0x1db 0x1dc 0x1da 0x1de 0x1dc 0x1e9 0x1e6 0x1e4 0x1e3 0x1e5 0x1e6 0x1e9 0x1d4 0x1d6 0x1e2 0x1e4 0x1e2 0x1e3 0x1dd 0x1e3 0x1df 0x1db 0x1dd 0x1de 0x1e0 0x1db 0x1da 0x1d8 0x1d9 0x1df 0x1db 0x1db 0x1d8 0x1dc 0x1da 0x1dd 0x1da 0x1d4 0x1e1 0x1e0 0x1e2 0x1e0 0x1d4 0x1db 0x1df 0x1e3 0x1dd 0x1d8 0x1d8 0x1d7 0x1d8 0x1de 0x1db 0x1dc 0x1de 0x1db 0x1de 0x1dd 0x1e1 0x1df 0x1d5 0x1dc 0x1e4 0x1d9 0x1e8 0x1e5 0x1e6 0x1e5 0x1e0 0x1e9 0x1ea 0x1e8 0x1e9 0x1e8 0x1ec 0x1ea 0x1d6 0x1dd 0x1e4 0x1d8 0x1e2 0x1e3 0x1e0 0x1e1 0x1e0 0x1de 0x1e0 0x1dc 0x1e0 0x1df 0x1dd 0x1e3 0x1db 0x1e1 0x1de 0x1da 0x1dd 0x1e2 0x1de 0x1e6 0x1e2 0x1d6 0x1db 0x1e4 0x1e1 0x1e6 0x1e7 0x1db 0x1e0 0xf0 0xf0 0xf0>;
					PS_Config_Lmt_FW_CC_P = <0x28 0x29 0x29 0x29 0x29 0x29 0x29 0x29 0x29 0x29 0x29 0x29 0x29 0x29 0x29 0x29 0x29 0x29 0x29 0x29 0x29 0x29 0x29 0x29 0x29 0x29 0x29 0x29 0x29 0x29 0x29 0x29 0x29 0x29 0x29 0x29 0x29 0x29 0x29 0x29 0x29 0x28 0x28 0x28 0x28 0x28 0x28 0x29 0x29 0x29 0x29 0x29 0x29 0x29 0x29 0x29 0x29 0x29 0x29 0x29 0x29 0x29 0x29 0x29 0x29 0x29 0x29 0x29 0x29 0x29 0x29 0x29 0x29 0x29 0x29 0x29 0x29 0x29 0x29 0x29 0x2a 0x29 0x29 0x29 0x29 0x29 0x29 0x29 0x29 0x29 0x29 0x29 0x29 0x29 0x29 0x29 0x29 0x29 0x28 0x28 0x28 0x28 0x28 0x28 0x29 0x28 0x29 0x28 0x29 0x29 0x29 0x29 0x29 0x29 0x29 0x29 0x29 0x29 0x29 0x29 0x29 0x29 0x29 0x28 0x29 0x29 0x29 0x29 0x29 0x29 0x29 0x29 0x29 0x29 0x29 0x29 0x29 0x29 0x29 0x29 0x29 0x29 0x29 0x29 0x29 0x29 0x29 0x29 0x29 0x29 0x29 0x29 0x29 0x29 0x29 0x29 0x29 0x29 0x29 0x29 0x29 0x29 0x29 0x29 0x29 0x29 0x29 0x29 0x29 0x29 0x29 0x29 0x29 0x29 0x29 0x29 0x29 0x29 0x29 0x29 0x29 0x29 0x29 0x29 0x29 0x29 0x29 0x29 0x29 0x29 0x29 0x29 0x29 0x29 0x29 0x29 0x29 0x29 0x29 0x29 0x29 0x29 0x29 0x29 0x29 0x29 0x29 0x29 0x29 0x29 0x29 0x29 0x29 0x29 0x29 0x29 0x29 0x29 0x29 0x29 0x29 0x29 0x29 0x29 0x29 0x29 0x29 0x29 0x29 0x29 0x29 0x29 0x29 0x29 0x29 0x29 0x29 0x29 0x29 0x29 0x29 0x29 0x29 0x29 0x29 0x29 0x29 0x29 0x29 0x29 0x29 0x29 0x29 0x29 0x29 0x2a 0x29 0x29 0x29 0x29 0x29 0x29 0x29 0x29 0x29 0x29 0x29 0x29 0x29 0x29 0x29 0x29 0x29 0x29 0x29 0x29 0x29 0x29 0x29 0x2a 0x29 0x29 0x29 0x29 0x29 0x29 0x29 0x2a 0x2a 0x29 0x29 0x29 0x29 0x29 0x29 0x29 0x29 0x29 0x29 0x29 0x29 0x29 0x29 0x29 0x2a 0x29 0x29 0x29 0x29 0x29 0x29 0x29 0x29 0x29 0x29 0x29 0x29 0x29 0x29 0x29 0x29 0x29 0x29 0x29 0x29 0x29 0x29 0x29 0x29 0x29 0x29 0x29 0x29 0x29 0x29 0x29 0x2a 0x29 0x29 0x29 0x29 0x29 0x29 0x29 0x29 0x29 0x29 0x29 0x29 0x29 0x29 0x29 0x29 0x29 0x29 0x29 0x29 0x29 0x29 0x29 0x29 0x29 0x29 0x29 0x29 0x29 0x29 0x2a 0x2a 0x29 0x29 0x29 0x29 0x29 0x29 0x29 0x29 0x29 0x29 0x29 0x29 0x29 0x29 0x29 0x29 0x29 0x29 0x29 0x29 0x29 0x29 0x29 0x29 0x29 0x29 0x29 0x29 0x29 0x29 0x2a 0x2a 0x29 0x29 0x29 0x29 0x29 0x29 0x29 0x29 0x29 0x29 0x29 0x29 0x29 0x29 0x29 0x2a 0x29 0x29 0x29 0x29 0x29 0x29 0x29 0x29 0x29 0x29 0x29 0x29 0x29 0x29 0x2a 0x2a 0x29 0x29 0x29 0x29 0x29 0x29 0x29 0x29 0x29 0x29 0x29 0x29 0x29 0x29 0x2a 0x2a 0x29 0x29 0x29 0x29 0x29 0x29 0x29 0x29 0x29 0x29 0x29 0x29 0x29 0x29 0x2a 0x2a 0x29 0x29 0x29 0x29 0x29 0x29 0x29 0x29 0x29 0x29 0x29 0x29 0x29 0x29 0x2a 0x2a 0x29 0x29 0x29 0x29 0x29 0x29 0x29 0x29 0x29 0x29 0x29 0x29 0x29 0x29 0x2a 0x2a 0x29 0x29 0x29 0x29 0x29 0x29 0x29 0x29 0x29 0x29 0x29 0x29 0x29 0x29 0x2a 0x2a 0x29 0x29 0x29 0x29 0x29 0x29 0x29 0x29 0x29 0x29 0x29 0x29 0x29 0x29 0x2a 0x2a 0x29 0x29 0x29 0x29 0x29 0x29 0x29 0x29 0x29 0x29 0x29 0x29 0x29 0x29 0x2a 0x29 0x29 0x29 0x29 0x29 0x29 0x29 0x29 0x29 0x29 0x29 0x29 0x29 0x29 0x29 0x2a 0x29 0x29 0x29 0x29 0x29 0x29 0x29 0x29 0x2a 0x29 0x29 0x29 0x29 0x29 0x29 0x29 0x13a 0x13a 0x13a>;
					PS_Config_Lmt_FW_CC_N = <0x11 0x12 0x12 0x12 0x12 0x12 0x12 0x12 0x12 0x12 0x12 0x12 0x12 0x12 0x12 0x12 0x12 0x12 0x12 0x12 0x12 0x12 0x12 0x12 0x12 0x12 0x12 0x12 0x12 0x12 0x12 0x12 0x12 0x12 0x12 0x12 0x12 0x12 0x12 0x12 0x12 0x11 0x11 0x11 0x11 0x11 0x11 0x12 0x12 0x12 0x12 0x12 0x12 0x12 0x12 0x12 0x12 0x12 0x12 0x12 0x12 0x12 0x12 0x12 0x12 0x12 0x12 0x12 0x12 0x12 0x12 0x12 0x12 0x12 0x12 0x12 0x12 0x12 0x12 0x12 0x13 0x12 0x12 0x12 0x12 0x12 0x12 0x12 0x12 0x12 0x12 0x12 0x12 0x12 0x12 0x12 0x12 0x12 0x11 0x11 0x11 0x11 0x11 0x11 0x12 0x11 0x12 0x11 0x12 0x12 0x12 0x12 0x12 0x12 0x12 0x12 0x12 0x12 0x12 0x12 0x12 0x12 0x12 0x11 0x12 0x12 0x12 0x12 0x12 0x12 0x12 0x12 0x12 0x12 0x12 0x12 0x12 0x12 0x12 0x12 0x12 0x12 0x12 0x12 0x12 0x12 0x12 0x12 0x12 0x12 0x12 0x12 0x12 0x12 0x12 0x12 0x12 0x12 0x12 0x12 0x12 0x12 0x12 0x12 0x12 0x12 0x12 0x12 0x12 0x12 0x12 0x12 0x12 0x12 0x12 0x12 0x12 0x12 0x12 0x12 0x12 0x12 0x12 0x12 0x12 0x12 0x12 0x12 0x12 0x12 0x12 0x12 0x12 0x12 0x12 0x12 0x12 0x12 0x12 0x12 0x12 0x12 0x12 0x12 0x12 0x12 0x12 0x12 0x12 0x12 0x12 0x12 0x12 0x12 0x12 0x12 0x12 0x12 0x12 0x12 0x12 0x12 0x12 0x12 0x12 0x12 0x12 0x12 0x12 0x12 0x12 0x12 0x12 0x12 0x12 0x12 0x12 0x12 0x12 0x12 0x12 0x12 0x12 0x12 0x12 0x12 0x12 0x12 0x12 0x12 0x12 0x12 0x12 0x12 0x12 0x13 0x12 0x12 0x12 0x12 0x12 0x12 0x12 0x12 0x12 0x12 0x12 0x12 0x12 0x12 0x12 0x12 0x12 0x12 0x12 0x12 0x12 0x12 0x12 0x13 0x12 0x12 0x12 0x12 0x12 0x12 0x12 0x13 0x13 0x12 0x12 0x12 0x12 0x12 0x12 0x12 0x12 0x12 0x12 0x12 0x12 0x12 0x12 0x12 0x13 0x12 0x12 0x12 0x12 0x12 0x12 0x12 0x12 0x12 0x12 0x12 0x12 0x12 0x12 0x12 0x12 0x12 0x12 0x12 0x12 0x12 0x12 0x12 0x12 0x12 0x12 0x12 0x12 0x12 0x12 0x12 0x13 0x12 0x12 0x12 0x12 0x12 0x12 0x12 0x12 0x12 0x12 0x12 0x12 0x12 0x12 0x12 0x12 0x12 0x12 0x12 0x12 0x12 0x12 0x12 0x12 0x12 0x12 0x12 0x12 0x12 0x12 0x13 0x13 0x12 0x12 0x12 0x12 0x12 0x12 0x12 0x12 0x12 0x12 0x12 0x12 0x12 0x12 0x12 0x12 0x12 0x12 0x12 0x12 0x12 0x12 0x12 0x12 0x12 0x12 0x12 0x12 0x12 0x12 0x13 0x13 0x12 0x12 0x12 0x12 0x12 0x12 0x12 0x12 0x12 0x12 0x12 0x12 0x12 0x12 0x12 0x13 0x12 0x12 0x12 0x12 0x12 0x12 0x12 0x12 0x12 0x12 0x12 0x12 0x12 0x12 0x13 0x13 0x12 0x12 0x12 0x12 0x12 0x12 0x12 0x12 0x12 0x12 0x12 0x12 0x12 0x12 0x13 0x13 0x12 0x12 0x12 0x12 0x12 0x12 0x12 0x12 0x12 0x12 0x12 0x12 0x12 0x12 0x13 0x13 0x12 0x12 0x12 0x12 0x12 0x12 0x12 0x12 0x12 0x12 0x12 0x12 0x12 0x12 0x13 0x13 0x12 0x12 0x12 0x12 0x12 0x12 0x12 0x12 0x12 0x12 0x12 0x12 0x12 0x12 0x13 0x13 0x12 0x12 0x12 0x12 0x12 0x12 0x12 0x12 0x12 0x12 0x12 0x12 0x12 0x12 0x13 0x13 0x12 0x12 0x12 0x12 0x12 0x12 0x12 0x12 0x12 0x12 0x12 0x12 0x12 0x12 0x13 0x13 0x12 0x12 0x12 0x12 0x12 0x12 0x12 0x12 0x12 0x12 0x12 0x12 0x12 0x12 0x13 0x12 0x12 0x12 0x12 0x12 0x12 0x12 0x12 0x12 0x12 0x12 0x12 0x12 0x12 0x12 0x13 0x12 0x12 0x12 0x12 0x12 0x12 0x12 0x12 0x13 0x12 0x12 0x12 0x12 0x12 0x12 0x12 0x00 0x00 0x00>;
					PS_Config_Lmt_FW_Diff_P = <0x32 0x32 0x32 0x32 0x32 0x32 0x32 0x32 0x32 0x32 0x32 0x32 0x32 0x32 0x32 0x32 0x32 0x32 0x32 0x32 0x32 0x32 0x32 0x32 0x32 0x32 0x32 0x32 0x32 0x32 0x32 0x32 0x32 0x32 0x32 0x32 0x32 0x32 0x32 0x32 0x32 0x32 0x32 0x32 0x32 0x32 0x32 0x32 0x32 0x32 0x32 0x32 0x32 0x32 0x32 0x32 0x32 0x32 0x32 0x32 0x32 0x32 0x32 0x32 0x32 0x32 0x32 0x32 0x32 0x32 0x32 0x32 0x32 0x32 0x32 0x32 0x32 0x32 0x32 0x32 0x32 0x32 0x32 0x32 0x32 0x32 0x32 0x32 0x32 0x32 0x32 0x32 0x32 0x32 0x32 0x32 0x32 0x32 0x32 0x32 0x32 0x32 0x32 0x32 0x32 0x32 0x32 0x32 0x32 0x32 0x32 0x32 0x32 0x32 0x32 0x32 0x32 0x32 0x32 0x32 0x32 0x32 0x32 0x32 0x32 0x32 0x32 0x32 0x32 0x32 0x32 0x32 0x32 0x32 0x32 0x32 0x32 0x32 0x32 0x32 0x32 0x32 0x32 0x32 0x32 0x32 0x32 0x32 0x32 0x32 0x32 0x32 0x32 0x32 0x32 0x32 0x32 0x32 0x32 0x32 0x32 0x32 0x32 0x32 0x32 0x32 0x32 0x32 0x32 0x32 0x32 0x32 0x32 0x32 0x32 0x32 0x32 0x32 0x32 0x32 0x32 0x32 0x32 0x32 0x32 0x32 0x32 0x32 0x32 0x32 0x32 0x32 0x32 0x32 0x32 0x32 0x32 0x32 0x32 0x32 0x32 0x32 0x32 0x32 0x32 0x32 0x32 0x32 0x32 0x32 0x32 0x32 0x32 0x32 0x32 0x32 0x32 0x32 0x32 0x32 0x32 0x32 0x32 0x32 0x32 0x32 0x32 0x32 0x32 0x32 0x32 0x32 0x32 0x32 0x32 0x32 0x32 0x32 0x32 0x32 0x32 0x32 0x32 0x32 0x32 0x32 0x32 0x32 0x32 0x32 0x32 0x32 0x32 0x32 0x32 0x32 0x32 0x32 0x32 0x32 0x32 0x32 0x32 0x32 0x32 0x32 0x32 0x32 0x32 0x32 0x32 0x32 0x32 0x32 0x32 0x32 0x32 0x32 0x32 0x32 0x32 0x32 0x32 0x32 0x32 0x32 0x32 0x32 0x32 0x32 0x32 0x32 0x32 0x32 0x32 0x32 0x32 0x32 0x32 0x32 0x32 0x32 0x32 0x32 0x32 0x32 0x32 0x32 0x32 0x32 0x32 0x32 0x32 0x32 0x32 0x32 0x32 0x32 0x32 0x32 0x32 0x32 0x32 0x32 0x32 0x32 0x32 0x32 0x32 0x32 0x32 0x32 0x32 0x32 0x32 0x32 0x32 0x32 0x32 0x32 0x32 0x32 0x32 0x32 0x32 0x32 0x32 0x32 0x32 0x32 0x32 0x32 0x32 0x32 0x32 0x32 0x32 0x32 0x32 0x32 0x32 0x32 0x32 0x32 0x32 0x32 0x32 0x32 0x32 0x32 0x32 0x32 0x32 0x32 0x32 0x32 0x32 0x32 0x32 0x32 0x32 0x32 0x32 0x32 0x32 0x32 0x32 0x32 0x32 0x32 0x32 0x32 0x32 0x32 0x32 0x32 0x32 0x32 0x32 0x32 0x32 0x32 0x32 0x32 0x32 0x32 0x32 0x32 0x32 0x32 0x32 0x32 0x32 0x32 0x32 0x32 0x32 0x32 0x32 0x32 0x32 0x32 0x32 0x32 0x32 0x32 0x32 0x32 0x32 0x32 0x32 0x32 0x32 0x32 0x32 0x32 0x32 0x32 0x32 0x32 0x32 0x32 0x32 0x32 0x32 0x32 0x32 0x32 0x32 0x32 0x32 0x32 0x32 0x32 0x32 0x32 0x32 0x32 0x32 0x32 0x32 0x32 0x32 0x32 0x32 0x32 0x32 0x32 0x32 0x32 0x32 0x32 0x32 0x32 0x32 0x32 0x32 0x32 0x32 0x32 0x32 0x32 0x32 0x32 0x32 0x32 0x32 0x32 0x32 0x32 0x32 0x32 0x32 0x32 0x32 0x32 0x32 0x32 0x32 0x32 0x32 0x32 0x32 0x32 0x32 0x32 0x32 0x32 0x32 0x32 0x32 0x32 0x32 0x32 0x32 0x32 0x32 0x32 0x32 0x32 0x32 0x32 0x32 0x32 0x32 0x32 0x32 0x32 0x32 0x32 0x32 0x32 0x32 0x32 0x32 0x32 0x32 0x32 0x32 0x32 0x32 0x32 0x32 0x32 0x32 0x32 0x32 0x32 0x32 0x32 0x32 0x32 0x32 0x32 0x32 0x32 0x32 0x32 0x32 0x32 0x32 0x32 0x32 0x32 0x32 0x32 0x32 0x32 0x32 0x32 0x32 0x32 0x32 0x32 0x32 0x32 0x4b 0x4b 0x4b>;
					PS_Config_Lmt_FW_Diff_N = <0xffffffce 0xffffffce 0xffffffce 0xffffffce 0xffffffce 0xffffffce 0xffffffce 0xffffffce 0xffffffce 0xffffffce 0xffffffce 0xffffffce 0xffffffce 0xffffffce 0xffffffce 0xffffffce 0xffffffce 0xffffffce 0xffffffce 0xffffffce 0xffffffce 0xffffffce 0xffffffce 0xffffffce 0xffffffce 0xffffffce 0xffffffce 0xffffffce 0xffffffce 0xffffffce 0xffffffce 0xffffffce 0xffffffce 0xffffffce 0xffffffce 0xffffffce 0xffffffce 0xffffffce 0xffffffce 0xffffffce 0xffffffce 0xffffffce 0xffffffce 0xffffffce 0xffffffce 0xffffffce 0xffffffce 0xffffffce 0xffffffce 0xffffffce 0xffffffce 0xffffffce 0xffffffce 0xffffffce 0xffffffce 0xffffffce 0xffffffce 0xffffffce 0xffffffce 0xffffffce 0xffffffce 0xffffffce 0xffffffce 0xffffffce 0xffffffce 0xffffffce 0xffffffce 0xffffffce 0xffffffce 0xffffffce 0xffffffce 0xffffffce 0xffffffce 0xffffffce 0xffffffce 0xffffffce 0xffffffce 0xffffffce 0xffffffce 0xffffffce 0xffffffce 0xffffffce 0xffffffce 0xffffffce 0xffffffce 0xffffffce 0xffffffce 0xffffffce 0xffffffce 0xffffffce 0xffffffce 0xffffffce 0xffffffce 0xffffffce 0xffffffce 0xffffffce 0xffffffce 0xffffffce 0xffffffce 0xffffffce 0xffffffce 0xffffffce 0xffffffce 0xffffffce 0xffffffce 0xffffffce 0xffffffce 0xffffffce 0xffffffce 0xffffffce 0xffffffce 0xffffffce 0xffffffce 0xffffffce 0xffffffce 0xffffffce 0xffffffce 0xffffffce 0xffffffce 0xffffffce 0xffffffce 0xffffffce 0xffffffce 0xffffffce 0xffffffce 0xffffffce 0xffffffce 0xffffffce 0xffffffce 0xffffffce 0xffffffce 0xffffffce 0xffffffce 0xffffffce 0xffffffce 0xffffffce 0xffffffce 0xffffffce 0xffffffce 0xffffffce 0xffffffce 0xffffffce 0xffffffce 0xffffffce 0xffffffce 0xffffffce 0xffffffce 0xffffffce 0xffffffce 0xffffffce 0xffffffce 0xffffffce 0xffffffce 0xffffffce 0xffffffce 0xffffffce 0xffffffce 0xffffffce 0xffffffce 0xffffffce 0xffffffce 0xffffffce 0xffffffce 0xffffffce 0xffffffce 0xffffffce 0xffffffce 0xffffffce 0xffffffce 0xffffffce 0xffffffce 0xffffffce 0xffffffce 0xffffffce 0xffffffce 0xffffffce 0xffffffce 0xffffffce 0xffffffce 0xffffffce 0xffffffce 0xffffffce 0xffffffce 0xffffffce 0xffffffce 0xffffffce 0xffffffce 0xffffffce 0xffffffce 0xffffffce 0xffffffce 0xffffffce 0xffffffce 0xffffffce 0xffffffce 0xffffffce 0xffffffce 0xffffffce 0xffffffce 0xffffffce 0xffffffce 0xffffffce 0xffffffce 0xffffffce 0xffffffce 0xffffffce 0xffffffce 0xffffffce 0xffffffce 0xffffffce 0xffffffce 0xffffffce 0xffffffce 0xffffffce 0xffffffce 0xffffffce 0xffffffce 0xffffffce 0xffffffce 0xffffffce 0xffffffce 0xffffffce 0xffffffce 0xffffffce 0xffffffce 0xffffffce 0xffffffce 0xffffffce 0xffffffce 0xffffffce 0xffffffce 0xffffffce 0xffffffce 0xffffffce 0xffffffce 0xffffffce 0xffffffce 0xffffffce 0xffffffce 0xffffffce 0xffffffce 0xffffffce 0xffffffce 0xffffffce 0xffffffce 0xffffffce 0xffffffce 0xffffffce 0xffffffce 0xffffffce 0xffffffce 0xffffffce 0xffffffce 0xffffffce 0xffffffce 0xffffffce 0xffffffce 0xffffffce 0xffffffce 0xffffffce 0xffffffce 0xffffffce 0xffffffce 0xffffffce 0xffffffce 0xffffffce 0xffffffce 0xffffffce 0xffffffce 0xffffffce 0xffffffce 0xffffffce 0xffffffce 0xffffffce 0xffffffce 0xffffffce 0xffffffce 0xffffffce 0xffffffce 0xffffffce 0xffffffce 0xffffffce 0xffffffce 0xffffffce 0xffffffce 0xffffffce 0xffffffce 0xffffffce 0xffffffce 0xffffffce 0xffffffce 0xffffffce 0xffffffce 0xffffffce 0xffffffce 0xffffffce 0xffffffce 0xffffffce 0xffffffce 0xffffffce 0xffffffce 0xffffffce 0xffffffce 0xffffffce 0xffffffce 0xffffffce 0xffffffce 0xffffffce 0xffffffce 0xffffffce 0xffffffce 0xffffffce 0xffffffce 0xffffffce 0xffffffce 0xffffffce 0xffffffce 0xffffffce 0xffffffce 0xffffffce 0xffffffce 0xffffffce 0xffffffce 0xffffffce 0xffffffce 0xffffffce 0xffffffce 0xffffffce 0xffffffce 0xffffffce 0xffffffce 0xffffffce 0xffffffce 0xffffffce 0xffffffce 0xffffffce 0xffffffce 0xffffffce 0xffffffce 0xffffffce 0xffffffce 0xffffffce 0xffffffce 0xffffffce 0xffffffce 0xffffffce 0xffffffce 0xffffffce 0xffffffce 0xffffffce 0xffffffce 0xffffffce 0xffffffce 0xffffffce 0xffffffce 0xffffffce 0xffffffce 0xffffffce 0xffffffce 0xffffffce 0xffffffce 0xffffffce 0xffffffce 0xffffffce 0xffffffce 0xffffffce 0xffffffce 0xffffffce 0xffffffce 0xffffffce 0xffffffce 0xffffffce 0xffffffce 0xffffffce 0xffffffce 0xffffffce 0xffffffce 0xffffffce 0xffffffce 0xffffffce 0xffffffce 0xffffffce 0xffffffce 0xffffffce 0xffffffce 0xffffffce 0xffffffce 0xffffffce 0xffffffce 0xffffffce 0xffffffce 0xffffffce 0xffffffce 0xffffffce 0xffffffce 0xffffffce 0xffffffce 0xffffffce 0xffffffce 0xffffffce 0xffffffce 0xffffffce 0xffffffce 0xffffffce 0xffffffce 0xffffffce 0xffffffce 0xffffffce 0xffffffce 0xffffffce 0xffffffce 0xffffffce 0xffffffce 0xffffffce 0xffffffce 0xffffffce 0xffffffce 0xffffffce 0xffffffce 0xffffffce 0xffffffce 0xffffffce 0xffffffce 0xffffffce 0xffffffce 0xffffffce 0xffffffce 0xffffffce 0xffffffce 0xffffffce 0xffffffce 0xffffffce 0xffffffce 0xffffffce 0xffffffce 0xffffffce 0xffffffce 0xffffffce 0xffffffce 0xffffffce 0xffffffce 0xffffffce 0xffffffce 0xffffffce 0xffffffce 0xffffffce 0xffffffce 0xffffffce 0xffffffce 0xffffffce 0xffffffce 0xffffffce 0xffffffce 0xffffffce 0xffffffce 0xffffffce 0xffffffce 0xffffffce 0xffffffce 0xffffffce 0xffffffce 0xffffffce 0xffffffce 0xffffffce 0xffffffce 0xffffffce 0xffffffce 0xffffffce 0xffffffce 0xffffffce 0xffffffce 0xffffffce 0xffffffce 0xffffffce 0xffffffce 0xffffffce 0xffffffce 0xffffffce 0xffffffce 0xffffffce 0xffffffce 0xffffffce 0xffffffce 0xffffffce 0xffffffce 0xffffffce 0xffffffce 0xffffffce 0xffffffce 0xffffffce 0xffffffce 0xffffffce 0xffffffce 0xffffffce 0xffffffce 0xffffffce 0xffffffce 0xffffffce 0xffffffce 0xffffffce 0xffffffce 0xffffffce 0xffffffce 0xffffffce 0xffffffce 0xffffffce 0xffffffce 0xffffffce 0xffffffce 0xffffffce 0xffffffce 0xffffffce 0xffffffce 0xffffffce 0xffffffce 0xffffffce 0xffffffce 0xffffffce 0xffffffce 0xffffffce 0xffffffce 0xffffffce 0xffffffce 0xffffffce 0xffffffce 0xffffffce 0xffffffce 0xffffffce 0xffffffce 0xffffffce 0xffffffce 0xffffffce 0xffffffce 0xffffffce 0xffffffce 0xffffffce 0xffffffce 0xffffffce 0xffffffce 0xffffffce 0xffffffce 0xffffffce 0xffffffce 0xffffffce 0xffffffce 0xffffffce 0xffffffce 0xffffffce 0xffffffce 0xffffffce 0xffffffce 0xffffffce 0xffffffce 0xffffffce 0xffffffce 0xffffffce 0xffffffce 0xffffffce 0xffffffce 0xffffffce 0xffffffce 0xffffffce 0xffffffce 0xffffffce 0xffffffce 0xffffffce 0xffffffce 0xffffffce 0xffffffce 0xffffffce 0xffffffce 0xffffffce 0xffffffce 0xffffffce 0xffffffce 0xffffffce 0xffffffb5 0xffffffb5 0xffffffb5>;
					PS_Config_Diff_Test_Frame = <0x32>;
				};
			};
		};
	};

	fragment@72 {
		target = <0xffffffff>;

		__overlay__ {

			camera0_mclk_2mA@gpio99 {
				phandle = <0x3b>;

				pins_cmd_dat {
					pinmux = <0x6301>;
					drive-strength = <0x02>;
				};
			};

			camera0_mclk_4mA@gpio99 {
				phandle = <0x3c>;

				pins_cmd_dat {
					pinmux = <0x6301>;
					drive-strength = <0x04>;
				};
			};

			camera0_mclk_6mA@gpio99 {
				phandle = <0x3d>;

				pins_cmd_dat {
					pinmux = <0x6301>;
					drive-strength = <0x06>;
				};
			};

			camera0_mclk_8mA@gpio99 {
				phandle = <0x3e>;

				pins_cmd_dat {
					pinmux = <0x6301>;
					drive-strength = <0x07>;
				};
			};

			camera0_mclk_gpio_mode@gpio99 {
				phandle = <0x3a>;

				pins_cmd_dat {
					pinmux = <0x6300>;
					drive-strength = <0x04>;
				};
			};

			camera1_mclk_2mA@gpio111 {
				phandle = <0x40>;

				pins_cmd_dat {
					pinmux = <0x6f01>;
					drive-strength = <0x02>;
				};
			};

			camera1_mclk_4mA@gpio111 {
				phandle = <0x41>;

				pins_cmd_dat {
					pinmux = <0x6f01>;
					drive-strength = <0x04>;
				};
			};

			camera1_mclk_6mA@gpio111 {
				phandle = <0x42>;

				pins_cmd_dat {
					pinmux = <0x6f01>;
					drive-strength = <0x06>;
				};
			};

			camera1_mclk_8mA@gpio111 {
				phandle = <0x43>;

				pins_cmd_dat {
					pinmux = <0x6f01>;
					drive-strength = <0x07>;
				};
			};

			camera1_mclk_gpio_mode@gpio111 {
				phandle = <0x3f>;

				pins_cmd_dat {
					pinmux = <0x6f00>;
					drive-strength = <0x04>;
				};
			};

			camera2_mclk_2mA@gpio108 {
				phandle = <0x45>;

				pins_cmd_dat {
					pinmux = <0x6c01>;
					drive-strength = <0x02>;
				};
			};

			camera2_mclk_4mA@gpio108 {
				phandle = <0x46>;

				pins_cmd_dat {
					pinmux = <0x6c01>;
					drive-strength = <0x04>;
				};
			};

			camera2_mclk_6mA@gpio108 {
				phandle = <0x47>;

				pins_cmd_dat {
					pinmux = <0x6c01>;
					drive-strength = <0x06>;
				};
			};

			camera2_mclk_8mA@gpio108 {
				phandle = <0x48>;

				pins_cmd_dat {
					pinmux = <0x6c01>;
					drive-strength = <0x07>;
				};
			};

			camera2_mclk_gpio_mode@gpio108 {
				phandle = <0x44>;

				pins_cmd_dat {
					pinmux = <0x6c00>;
					drive-strength = <0x04>;
				};
			};

			camera3_mclk_2mA@gpio100 {
				phandle = <0x4a>;

				pins_cmd_dat {
					pinmux = <0x6401>;
					drive-strength = <0x02>;
				};
			};

			camera3_mclk_4mA@gpio100 {
				phandle = <0x4b>;

				pins_cmd_dat {
					pinmux = <0x6401>;
					drive-strength = <0x04>;
				};
			};

			camera3_mclk_6mA@gpio100 {
				phandle = <0x4c>;

				pins_cmd_dat {
					pinmux = <0x6401>;
					drive-strength = <0x06>;
				};
			};

			camera3_mclk_8mA@gpio100 {
				phandle = <0x4d>;

				pins_cmd_dat {
					pinmux = <0x6401>;
					drive-strength = <0x07>;
				};
			};

			camera3_mclk_gpio_mode@gpio100 {
				phandle = <0x49>;

				pins_cmd_dat {
					pinmux = <0x6400>;
					drive-strength = <0x04>;
				};
			};

			camera0_rst_output_low@gpio101 {
				phandle = <0x2e>;

				pins_cmd_dat {
					pinmux = <0x6500>;
					output-low;
				};
			};

			camera0_rst_output_high@gpio101 {
				phandle = <0x2f>;

				pins_cmd_dat {
					pinmux = <0x6500>;
					output-high;
				};
			};

			camera1_rst_output_low@gpio98 {
				phandle = <0x30>;

				pins_cmd_dat {
					pinmux = <0x6200>;
					output-low;
				};
			};

			camera1_rst_output_high@gpio98 {
				phandle = <0x31>;

				pins_cmd_dat {
					pinmux = <0x6200>;
					output-high;
				};
			};

			camera2_rst_output_low@gpio112 {
				phandle = <0x32>;

				pins_cmd_dat {
					pinmux = <0x7000>;
					output-low;
				};
			};

			camera2_rst_output_high@gpio112 {
				phandle = <0x33>;

				pins_cmd_dat {
					pinmux = <0x7000>;
					output-high;
				};
			};

			camera3_rst_output_low@gpio109 {
				phandle = <0x34>;

				pins_cmd_dat {
					pinmux = <0x6d00>;
					output-low;
				};
			};

			camera3_rst_output_high@gpio109 {
				phandle = <0x35>;

				pins_cmd_dat {
					pinmux = <0x6d00>;
					output-high;
				};
			};

			camera1_vcamd_output_low@gpio153 {
				phandle = <0x37>;

				pins_cmd_dat {
					pinmux = <0x9900>;
					output-low;
				};
			};

			camera1_vcamd_output_high@gpio153 {
				phandle = <0x36>;

				pins_cmd_dat {
					pinmux = <0x9900>;
					output-high;
				};
			};

			camera2_vcamd_output_low@gpio153 {
				phandle = <0x39>;

				pins_cmd_dat {
					pinmux = <0x9900>;
					output-low;
				};
			};

			camera2_vcamd_output_high@gpio153 {
				phandle = <0x38>;

				pins_cmd_dat {
					pinmux = <0x9900>;
					output-high;
				};
			};

			camera3_pnd_output_low@gpio179 {
				phandle = <0x4e>;

				pins_cmd_dat {
					pinmux = <0xb300>;
					output-low;
				};
			};

			camera3_pnd_output_high@gpio179 {
				phandle = <0x4f>;

				pins_cmd_dat {
					pinmux = <0xb300>;
					output-high;
				};
			};

			camdefault {
				phandle = <0x2d>;
			};
		};
	};

	fragment@73 {
		target = <0xffffffff>;

		__overlay__ {
			pinctrl-names = "default", "cam0_rst0", "cam0_rst1", "cam1_rst0", "cam1_rst1", "cam2_rst0", "cam2_rst1", "cam3_rst0", "cam3_rst1", "cam1_vcamd_on", "cam1_vcamd_off", "cam2_vcamd_on", "cam2_vcamd_off", "cam0_mclk_off", "cam0_mclk_2mA", "cam0_mclk_4mA", "cam0_mclk_6mA", "cam0_mclk_8mA", "cam1_mclk_off", "cam1_mclk_2mA", "cam1_mclk_4mA", "cam1_mclk_6mA", "cam1_mclk_8mA", "cam2_mclk_off", "cam2_mclk_2mA", "cam2_mclk_4mA", "cam2_mclk_6mA", "cam2_mclk_8mA", "cam3_mclk_off", "cam3_mclk_2mA", "cam3_mclk_4mA", "cam3_mclk_6mA", "cam3_mclk_8mA", "cam3_pnd0", "cam3_pnd1";
			pinctrl-0 = <0x2d>;
			pinctrl-1 = <0x2e>;
			pinctrl-2 = <0x2f>;
			pinctrl-3 = <0x30>;
			pinctrl-4 = <0x31>;
			pinctrl-5 = <0x32>;
			pinctrl-6 = <0x33>;
			pinctrl-7 = <0x34>;
			pinctrl-8 = <0x35>;
			pinctrl-9 = <0x36>;
			pinctrl-10 = <0x37>;
			pinctrl-11 = <0x38>;
			pinctrl-12 = <0x39>;
			pinctrl-13 = <0x3a>;
			pinctrl-14 = <0x3b>;
			pinctrl-15 = <0x3c>;
			pinctrl-16 = <0x3d>;
			pinctrl-17 = <0x3e>;
			pinctrl-18 = <0x3f>;
			pinctrl-19 = <0x40>;
			pinctrl-20 = <0x41>;
			pinctrl-21 = <0x42>;
			pinctrl-22 = <0x43>;
			pinctrl-23 = <0x44>;
			pinctrl-24 = <0x45>;
			pinctrl-25 = <0x46>;
			pinctrl-26 = <0x47>;
			pinctrl-27 = <0x48>;
			pinctrl-28 = <0x49>;
			pinctrl-29 = <0x4a>;
			pinctrl-30 = <0x4b>;
			pinctrl-31 = <0x4c>;
			pinctrl-32 = <0x4d>;
			pinctrl-33 = <0x4e>;
			pinctrl-34 = <0x4f>;
			cam0_vcama-supply = <0xffffffff>;
			cam0_vcamio-supply = <0xffffffff>;
			cam0_vcamd-supply = <0xffffffff>;
			cam1_vcama-supply = <0xffffffff>;
			cam1_vcamio-supply = <0xffffffff>;
			cam2_vcama-supply = <0xffffffff>;
			cam2_vcamio-supply = <0xffffffff>;
			cam3_vcama-supply = <0xffffffff>;
			cam3_vcamio-supply = <0xffffffff>;
			cam0_enable_sensor = "s5kjns_sunny_mipi_raw ov50d40_truly_mipi_raw";
			cam1_enable_sensor = "ov8856_ofilm_mipi_raw ov8856_sunny_mipi_raw";
			cam2_enable_sensor = "sc820cs_truly_mipi_raw imx355_sunny_mipi_raw";
			cam3_enable_sensor = "ov02b10_truly_mipi_raw sc202cs_sunny_mipi_raw";
			status = "okay";
		};
	};

	fragment@74 {
		target = <0xffffffff>;

		__overlay__ {
			pinctrl-names = "default", "hwen_high", "hwen_low";
			pinctrl-0 = <0x50>;
			pinctrl-1 = <0x51>;
			pinctrl-2 = <0x52>;
			status = "okay";
		};
	};

	fragment@75 {
		target = <0xffffffff>;

		__overlay__ {

			flashlightdefault {
				phandle = <0x50>;
			};

			flashlightenoutput1 {
				phandle = <0x51>;

				pins_cmd_dat {
					pinmux = <0x800>;
					slew-rate = <0x01>;
					output-high;
				};
			};

			flashlightenoutput0 {
				phandle = <0x52>;

				pins_cmd_dat {
					pinmux = <0x800>;
					slew-rate = <0x01>;
					output-low;
				};
			};
		};
	};

	fragment@76 {
		target = <0xffffffff>;

		__overlay__ {
			vio28-supply = <0xffffffff>;
			status = "okay";
		};
	};

	fragment@77 {
		target = <0xffffffff>;

		__overlay__ {

			si_pa_L {
				compatible = "si,sia81xx";
				si,si_pa_type = "sia8152x";
				si,si_pa_disable_pin = <0x01>;
				channel_num = <0x00>;
				phandle = <0x53>;
			};
		};
	};

	fragment@78 {
		target = <0xffffffff>;

		__overlay__ {
			si,sia81xx-max-num = <0x01>;
			si,sia81xx-aux-devs = <0x53>;
			si,sia81xx-aux-devs-prefix = "SpkrLeft";
		};
	};

	fragment@79 {
		target = <0xffffffff>;

		__overlay__ {
			#address-cells = <0x01>;
			#size-cells = <0x00>;
			clock-frequency = <0x61a80>;
			mediatek,use-open-drain;

			sipa_i2c@58 {
				compatible = "si,sia81xx-i2c";
				reg = <0x58>;
				dev_index = <0x00>;
				si,sipa-dev = <0x53>;
				status = "okay";
				phandle = <0x6f>;
			};
		};
	};

	__symbols__ {
		nfc_default = "/fragment@1/__overlay__/nfc_default";
		nfc_int_active = "/fragment@1/__overlay__/nfc_int_active";
		nfc_int_suspend = "/fragment@1/__overlay__/nfc_int_suspend";
		nfc_enable_active = "/fragment@1/__overlay__/nfc_enable_active";
		nfc_enable_suspend = "/fragment@1/__overlay__/nfc_enable_suspend";
		nfc_firmwaredownload_active = "/fragment@1/__overlay__/nfc_firmwaredownload_active";
		nfc_firmwaredownload_suspend = "/fragment@1/__overlay__/nfc_firmwaredownload_suspend";
		nfc_clk_req_active = "/fragment@1/__overlay__/nfc_clk_req_active";
		nfc_clk_req_suspend = "/fragment@1/__overlay__/nfc_clk_req_suspend";
		led0 = "/fragment@6/__overlay__/led@0";
		led1 = "/fragment@6/__overlay__/led@1";
		led2 = "/fragment@6/__overlay__/led@2";
		led3 = "/fragment@6/__overlay__/led@3";
		led4 = "/fragment@6/__overlay__/led@4";
		led5 = "/fragment@6/__overlay__/led@5";
		led6 = "/fragment@6/__overlay__/led@6";
		vibrator0 = "/fragment@6/__overlay__/vibrator@0";
		wusb3801x_typec = "/fragment@8/__overlay__/usb_type_c_wusb3801@60";
		kpd_pins_default = "/fragment@11/__overlay__/kpdgpiodefault";
		usbs_cb1_disable_pin = "/fragment@12/__overlay__/sleep_cb1";
		usbs_cb1_enable_pin = "/fragment@12/__overlay__/active_cb1";
		usbs_cb2_disable_pin = "/fragment@12/__overlay__/sleep_cb2";
		usbs_cb2_enable_pin = "/fragment@12/__overlay__/active_cb2";
		syv690_chg = "/fragment@13/__overlay__/syv690@6a";
		consys_pins_default = "/fragment@14/__overlay__/consys_default";
		gpslna_pins_init = "/fragment@14/__overlay__/gpslna@0";
		gpslna_pins_oh = "/fragment@14/__overlay__/gpslna@1";
		gpslna_pins_ol = "/fragment@14/__overlay__/gpslna@2";
		irtx_gpio_led_default = "/fragment@17/__overlay__/irtx_gpio_led_def@gpio9";
		irtx_gpio_led_set = "/fragment@17/__overlay__/irtx_gpio_led_set@gpio9";
		mtkfb_pins_lcm_rst_out1_gpio = "/fragment@18/__overlay__/lcm_rst_out1_gpio";
		mtkfb_pins_lcm_rst_out0_gpio = "/fragment@18/__overlay__/lcm_rst_out0_gpio";
		mtkfb_pins_lcm_dsi_te = "/fragment@18/__overlay__/lcm_dsi_te";
		mtkfb_pins_6382_rst_out1_gpio = "/fragment@18/__overlay__/6382_rst_out1_gpio";
		mtkfb_pins_6382_rst_out0_gpio = "/fragment@18/__overlay__/6382_rst_out0_gpio";
		panel_in1 = "/fragment@21/__overlay__/panel1@0/port/endpoint";
		panel_in2 = "/fragment@21/__overlay__/panel2@1/port/endpoint";
		panel_in3 = "/fragment@21/__overlay__/panel3@2/port/endpoint";
		panel_in4 = "/fragment@21/__overlay__/panel4@3/port/endpoint";
		dsi_out = "/fragment@21/__overlay__/ports/port/endpoint";
		spislv_pins_default = "/fragment@23/__overlay__/spislv_mode_default";
		bdg = "/fragment@24/__overlay__/bridge";
		mt6660 = "/fragment@26/__overlay__/mt6660@34";
		mtee = "/fragment@30/__overlay__/MTEE";
		svp = "/fragment@30/__overlay__/SecureVideoPath";
		fpsensor_fpc_rst_low = "/fragment@31/__overlay__/fpsensor_fpc_rst_low";
		fpsensor_fpc_cs_low = "/fragment@31/__overlay__/fpsensor_fpc_cs_low";
		fpsensor_fpc_rst_high = "/fragment@31/__overlay__/fpsensor_fpc_rst_high";
		fpsensor_fpc_cs_high = "/fragment@31/__overlay__/fpsensor_fpc_cs_high";
		fpsensor_goodix_rst_low = "/fragment@32/__overlay__/fpsensor_goodix_rst_low";
		fpsensor_goodix_rst_high = "/fragment@32/__overlay__/fpsensor_goodix_rst_high";
		fpsensor_goodix_cs_low = "/fragment@32/__overlay__/fpsensor_goodix_cs_low";
		fpsensor_goodix_cs_high = "/fragment@32/__overlay__/fpsensor_goodix_cs_high";
		camera_sub_mtk = "/fragment@38/__overlay__/camera_sub@2d";
		camera_sub_eeprom_mtk = "/fragment@38/__overlay__/camera_sub_eeprom@51";
		camera_sub_two_mtk = "/fragment@38/__overlay__/camera_sub_two@6c";
		camera_sub_two_eeprom_mtk = "/fragment@38/__overlay__/camera_sub_two_eeprom@52";
		camera_main_mtk = "/fragment@40/__overlay__/camera_main@1a";
		camera_main_eeprom_mtk = "/fragment@40/__overlay__/camera_main_eeprom@51";
		camera_main_af_mtk = "/fragment@40/__overlay__/camera_main_af@0c";
		ccu_sensor_i2c_2_hw_mtk = "/fragment@40/__overlay__/ccu_sensor_i2c_2_hw@11";
		camera_main_two_mtk = "/fragment@42/__overlay__/camera_main_two@34";
		camera_main_two_eeprom_mtk = "/fragment@42/__overlay__/camera_main_two_eeprom@50";
		ccu_sensor_i2c_4_hw_mtk = "/fragment@42/__overlay__/ccu_sensor_i2c_4_hw@12";
		slave_charger_mtk = "/fragment@45/__overlay__/slave_charger@4b";
		ctp_pins_default = "/fragment@70/__overlay__/eintdefault";
		ctp_pins_eint_as_int = "/fragment@70/__overlay__/eint1touch";
		ctp_pins_eint_output0 = "/fragment@70/__overlay__/eintoutput0";
		ctp_pins_eint_output1 = "/fragment@70/__overlay__/eintoutput1";
		ctp_pins_rst_output0 = "/fragment@70/__overlay__/rstoutput0";
		ctp_pins_rst_output1 = "/fragment@70/__overlay__/rstoutput1";
		camera0_mclk_2mA = "/fragment@72/__overlay__/camera0_mclk_2mA@gpio99";
		camera0_mclk_4mA = "/fragment@72/__overlay__/camera0_mclk_4mA@gpio99";
		camera0_mclk_6mA = "/fragment@72/__overlay__/camera0_mclk_6mA@gpio99";
		camera0_mclk_8mA = "/fragment@72/__overlay__/camera0_mclk_8mA@gpio99";
		camera0_mclk_off = "/fragment@72/__overlay__/camera0_mclk_gpio_mode@gpio99";
		camera1_mclk_2mA = "/fragment@72/__overlay__/camera1_mclk_2mA@gpio111";
		camera1_mclk_4mA = "/fragment@72/__overlay__/camera1_mclk_4mA@gpio111";
		camera1_mclk_6mA = "/fragment@72/__overlay__/camera1_mclk_6mA@gpio111";
		camera1_mclk_8mA = "/fragment@72/__overlay__/camera1_mclk_8mA@gpio111";
		camera1_mclk_off = "/fragment@72/__overlay__/camera1_mclk_gpio_mode@gpio111";
		camera2_mclk_2mA = "/fragment@72/__overlay__/camera2_mclk_2mA@gpio108";
		camera2_mclk_4mA = "/fragment@72/__overlay__/camera2_mclk_4mA@gpio108";
		camera2_mclk_6mA = "/fragment@72/__overlay__/camera2_mclk_6mA@gpio108";
		camera2_mclk_8mA = "/fragment@72/__overlay__/camera2_mclk_8mA@gpio108";
		camera2_mclk_off = "/fragment@72/__overlay__/camera2_mclk_gpio_mode@gpio108";
		camera3_mclk_2mA = "/fragment@72/__overlay__/camera3_mclk_2mA@gpio100";
		camera3_mclk_4mA = "/fragment@72/__overlay__/camera3_mclk_4mA@gpio100";
		camera3_mclk_6mA = "/fragment@72/__overlay__/camera3_mclk_6mA@gpio100";
		camera3_mclk_8mA = "/fragment@72/__overlay__/camera3_mclk_8mA@gpio100";
		camera3_mclk_off = "/fragment@72/__overlay__/camera3_mclk_gpio_mode@gpio100";
		camera0_rst_low = "/fragment@72/__overlay__/camera0_rst_output_low@gpio101";
		camera0_rst_high = "/fragment@72/__overlay__/camera0_rst_output_high@gpio101";
		camera1_rst_low = "/fragment@72/__overlay__/camera1_rst_output_low@gpio98";
		camera1_rst_high = "/fragment@72/__overlay__/camera1_rst_output_high@gpio98";
		camera2_rst_low = "/fragment@72/__overlay__/camera2_rst_output_low@gpio112";
		camera2_rst_high = "/fragment@72/__overlay__/camera2_rst_output_high@gpio112";
		camera3_rst_low = "/fragment@72/__overlay__/camera3_rst_output_low@gpio109";
		camera3_rst_high = "/fragment@72/__overlay__/camera3_rst_output_high@gpio109";
		camera1_vcamd_off = "/fragment@72/__overlay__/camera1_vcamd_output_low@gpio153";
		camera1_vcamd_on = "/fragment@72/__overlay__/camera1_vcamd_output_high@gpio153";
		camera2_vcamd_off = "/fragment@72/__overlay__/camera2_vcamd_output_low@gpio153";
		camera2_vcamd_on = "/fragment@72/__overlay__/camera2_vcamd_output_high@gpio153";
		camera3_pnd_low = "/fragment@72/__overlay__/camera3_pnd_output_low@gpio179";
		camera3_pnd_high = "/fragment@72/__overlay__/camera3_pnd_output_high@gpio179";
		camera_pins_default = "/fragment@72/__overlay__/camdefault";
		flashlight_pins_default = "/fragment@75/__overlay__/flashlightdefault";
		flashlight_pins_en_output1 = "/fragment@75/__overlay__/flashlightenoutput1";
		flashlight_pins_en_output0 = "/fragment@75/__overlay__/flashlightenoutput0";
		si_pa_L = "/fragment@77/__overlay__/si_pa_L";
		sipa_i2c_L = "/fragment@79/__overlay__/sipa_i2c@58";
	};

	__fixups__ {
		i2c3 = "/fragment@0:target:0", "/fragment@41:target:0", "/fragment@79:target:0";
		pio = "/fragment@0/__overlay__/nxp@28:qcom,nq-irq:0", "/fragment@0/__overlay__/nxp@28:interrupt-parent:0", "/fragment@0/__overlay__/nxp@28:qcom,nq-ven:0", "/fragment@0/__overlay__/nxp@28:qcom,nq-firm:0", "/fragment@0/__overlay__/nxp@28:qcom,nq-clkreq:0", "/fragment@1:target:0", "/fragment@8/__overlay__/usb_type_c_wusb3801@60:wusb3801,irq-gpio:0", "/fragment@8/__overlay__/husb320@21:husb320,int-gpio:0", "/fragment@11:target:0", "/fragment@12:target:0", "/fragment@13/__overlay__/syv690@6a:syv690,intr_gpio:0", "/fragment@13/__overlay__/syv690@6a:usb_switch_cb1_gpio:0", "/fragment@13/__overlay__/syv690@6a:usb_switch_cb2_gpio:0", "/fragment@13/__overlay__/syv690@6a:otg_en_gpio:0", "/fragment@14:target:0", "/fragment@17:target:0", "/fragment@18:target:0", "/fragment@21/__overlay__:bdg-gpios:0", "/fragment@21/__overlay__/panel1@0:reset-gpios:0", "/fragment@21/__overlay__/panel1@0:biasp-gpios:0", "/fragment@21/__overlay__/panel1@0:biasn-gpios:0", "/fragment@21/__overlay__/panel2@1:reset-gpios:0", "/fragment@21/__overlay__/panel2@1:biasp-gpios:0", "/fragment@21/__overlay__/panel2@1:biasn-gpios:0", "/fragment@21/__overlay__/panel3@2:reset-gpios:0", "/fragment@21/__overlay__/panel3@2:biasp-gpios:0", "/fragment@21/__overlay__/panel3@2:biasn-gpios:0", "/fragment@21/__overlay__/panel4@3:reset-gpios:0", "/fragment@21/__overlay__/panel4@3:biasp-gpios:0", "/fragment@21/__overlay__/panel4@3:biasn-gpios:0", "/fragment@23:target:0", "/fragment@25/__overlay__/lm3697@36:enable-gpios:0", "/fragment@25/__overlay__/ktd3136@37:enable-gpios:0", "/fragment@31:target:0", "/fragment@32:target:0", "/fragment@34/__overlay__:interrupt-parent:0", "/fragment@34/__overlay__:int-gpios:0", "/fragment@47/__overlay__:GPIO_FDD_BAND_SUPPORT_DETECT_3RD_PIN:0", "/fragment@47/__overlay__:GPIO_FDD_BAND_SUPPORT_DETECT_4TH_PIN:0", "/fragment@47/__overlay__:GPIO_FDD_BAND_SUPPORT_DETECT_2ND_PIN:0", "/fragment@47/__overlay__:GPIO_FDD_BAND_SUPPORT_DETECT_1ST_PIN:0", "/fragment@47/__overlay__:GPIO_SIM2_HOT_PLUG:0", "/fragment@47/__overlay__:GPIO_SIM1_HOT_PLUG:0", "/fragment@47/__overlay__:GPIO_SIM2_SIO:0", "/fragment@47/__overlay__:GPIO_SIM2_SRST:0", "/fragment@47/__overlay__:GPIO_SIM2_SCLK:0", "/fragment@47/__overlay__:GPIO_SIM1_SCLK:0", "/fragment@47/__overlay__:GPIO_SIM1_SRST:0", "/fragment@47/__overlay__:GPIO_SIM1_SIO:0", "/fragment@49/__overlay__:interrupt-parent:0", "/fragment@50/__overlay__:interrupt-parent:0", "/fragment@51/__overlay__:interrupt-parent:0", "/fragment@52/__overlay__:interrupt-parent:0", "/fragment@53/__overlay__:interrupt-parent:0", "/fragment@54/__overlay__:interrupt-parent:0", "/fragment@55/__overlay__:interrupt-parent:0", "/fragment@56/__overlay__:interrupt-parent:0", "/fragment@57/__overlay__:interrupt-parent:0", "/fragment@58/__overlay__:interrupt-parent:0", "/fragment@58/__overlay__:deb-gpios:0", "/fragment@59/__overlay__:interrupt-parent:0", "/fragment@70:target:0", "/fragment@71/__overlay__/novatek@1:novatek,reset-gpio:0", "/fragment@71/__overlay__/novatek@1:novatek,irq-gpio:0", "/fragment@71/__overlay__/novatek@1:interrupt-parent:0", "/fragment@71/__overlay__/novatek@1:focaltech,reset-gpio:0", "/fragment@71/__overlay__/novatek@1:focaltech,irq-gpio:0", "/fragment@72:target:0", "/fragment@75:target:0";
		reserved_memory = "/fragment@2:target:0";
		chosen = "/fragment@3:target:0", "/fragment@13/__overlay__/syv690@6a:bootmode:0";
		mtk_leds = "/fragment@4:target:0";
		disp_pwm = "/fragment@4/__overlay__/backlight:pwms:0";
		utos = "/fragment@5:target:0";
		odm = "/fragment@6:target:0", "/fragment@77:target:0";
		i2c2 = "/fragment@7:target:0", "/fragment@40:target:0";
		i2c5 = "/fragment@8:target:0", "/fragment@43:target:0";
		accdet = "/fragment@9:target:0";
		keypad = "/fragment@10:target:0", "/fragment@68:target:0";
		i2c6 = "/fragment@13:target:0", "/fragment@25:target:0", "/fragment@44:target:0";
		consys = "/fragment@15:target:0";
		irtx_pwm = "/fragment@16:target:0";
		mtkfb = "/fragment@19:target:0";
		dispsys_config = "/fragment@20:target:0";
		dsi0 = "/fragment@21:target:0";
		spi5 = "/fragment@22:target:0";
		bdg_support = "/fragment@24:target:0";
		i2c7 = "/fragment@26:target:0", "/fragment@45:target:0";
		sound = "/fragment@27:target:0", "/fragment@78:target:0";
		mtkheap_region_svp = "/fragment@28:target:0";
		mtkheap_region_wfd = "/fragment@29:target:0";
		mtee_svp = "/fragment@30:target:0";
		spi0 = "/fragment@33:target:0";
		mt_pmic_vldo28_ldo_reg = "/fragment@33/__overlay__/fpc_spi@0:fp_vldo28-supply:0", "/fragment@34/__overlay__:fp_vldo28-supply:0", "/fragment@65:target:0", "/fragment@66/__overlay__:vcamaf-supply:0", "/fragment@66/__overlay__:vcamaf_sub-supply:0", "/fragment@66/__overlay__:vcamaf_main2-supply:0", "/fragment@67/__overlay__:vtouch-supply:0";
		goodix_fp = "/fragment@34:target:0", "/fragment@51:target:0";
		auxadc = "/fragment@35:target:0", "/fragment@36/__overlay__:io-channels:0";
		md_auxadc = "/fragment@36:target:0";
		pmic_clock_buffer_ctrl = "/fragment@37:target:0";
		i2c0 = "/fragment@38:target:0";
		i2c1 = "/fragment@39:target:0";
		i2c4 = "/fragment@42:target:0";
		i2c8 = "/fragment@46:target:0";
		gpio_usage_mapping = "/fragment@47:target:0";
		gpio = "/fragment@48:target:0";
		touch = "/fragment@49:target:0", "/fragment@67:target:0", "/fragment@69:target:0";
		nfc = "/fragment@50:target:0";
		msdc1_ins = "/fragment@52:target:0";
		subpmic_pmu_eint = "/fragment@53:target:0";
		smart_pa = "/fragment@54:target:0";
		tcpc_pd = "/fragment@55:target:0";
		rt9465_slave_chr = "/fragment@56:target:0";
		dsi_te = "/fragment@57:target:0";
		swtp = "/fragment@58:target:0";
		main_pmic = "/fragment@59:target:0";
		md1_sim1_hot_plug_eint = "/fragment@60:target:0";
		mt_pmic_vcama1_ldo_reg = "/fragment@61:target:0", "/fragment@66/__overlay__:vcama-supply:0", "/fragment@66/__overlay__:vcama_sub-supply:0", "/fragment@73/__overlay__:cam0_vcama-supply:0", "/fragment@73/__overlay__:cam1_vcama-supply:0";
		mt_pmic_vcama2_ldo_reg = "/fragment@62:target:0", "/fragment@66/__overlay__:vcama_main2-supply:0", "/fragment@73/__overlay__:cam2_vcama-supply:0", "/fragment@73/__overlay__:cam3_vcama-supply:0";
		mt_pmic_vcamd_ldo_reg = "/fragment@63:target:0", "/fragment@66/__overlay__:vcamd_main2-supply:0", "/fragment@73/__overlay__:cam0_vcamd-supply:0";
		mt_pmic_vcamio_ldo_reg = "/fragment@64:target:0", "/fragment@66/__overlay__:vcamio-supply:0", "/fragment@66/__overlay__:vcamio_sub-supply:0", "/fragment@66/__overlay__:vcamio_main2-supply:0", "/fragment@66/__overlay__:vcamio_sub2-supply:0", "/fragment@73/__overlay__:cam0_vcamio-supply:0", "/fragment@73/__overlay__:cam1_vcamio-supply:0", "/fragment@73/__overlay__:cam2_vcamio-supply:0", "/fragment@73/__overlay__:cam3_vcamio-supply:0";
		kd_camera_hw1 = "/fragment@66:target:0", "/fragment@73:target:0";
		spi2 = "/fragment@71:target:0";
		flashlights_aw3641e = "/fragment@74:target:0";
		camera_af_hw_node = "/fragment@76:target:0";
		mt_pmic_vio28_ldo_reg = "/fragment@76/__overlay__:vio28-supply:0";
	};

	__local_fixups__ {

		fragment@0 {

			__overlay__ {

				nxp@28 {
					pinctrl-0 = <0x00>;
					pinctrl-1 = <0x00 0x04 0x08 0x0c>;
					pinctrl-2 = <0x00 0x04 0x08 0x0c>;
				};
			};
		};

		fragment@10 {

			__overlay__ {
				pinctrl-0 = <0x00>;
			};
		};

		fragment@13 {

			__overlay__ {

				syv690@6a {
					pinctrl-0 = <0x00>;
					pinctrl-1 = <0x00>;
					pinctrl-2 = <0x00>;
					pinctrl-3 = <0x00>;
					charge = <0x00>;
				};
			};
		};

		fragment@15 {

			__overlay__ {
				pinctrl-0 = <0x00>;
				pinctrl-1 = <0x00>;
				pinctrl-2 = <0x00>;
				pinctrl-3 = <0x00>;
			};
		};

		fragment@16 {

			__overlay__ {
				pinctrl-0 = <0x00>;
				pinctrl-1 = <0x00>;
			};
		};

		fragment@19 {

			__overlay__ {
				pinctrl-0 = <0x00>;
				pinctrl-1 = <0x00>;
				pinctrl-2 = <0x00>;
				pinctrl-3 = <0x00>;
				pinctrl-4 = <0x00>;
			};
		};

		fragment@20 {

			__overlay__ {
				pinctrl-0 = <0x00>;
				pinctrl-1 = <0x00>;
				pinctrl-2 = <0x00>;
				pinctrl-3 = <0x00>;
				pinctrl-4 = <0x00>;
			};
		};

		fragment@21 {

			__overlay__ {

				panel1@0 {

					port {

						endpoint {
							remote-endpoint = <0x00>;
						};
					};
				};

				panel2@1 {

					port {

						endpoint {
							remote-endpoint = <0x00>;
						};
					};
				};

				panel3@2 {

					port {

						endpoint {
							remote-endpoint = <0x00>;
						};
					};
				};

				panel4@3 {

					port {

						endpoint {
							remote-endpoint = <0x00>;
						};
					};
				};

				ports {

					port {

						endpoint {
							remote-endpoint = <0x00>;
						};
					};
				};
			};
		};

		fragment@22 {

			__overlay__ {
				pinctrl-0 = <0x00>;
			};
		};

		fragment@27 {

			__overlay__ {

				mediatek,speaker-codec {
					sound-dai = <0x00>;
				};
			};
		};

		fragment@33 {

			__overlay__ {

				fpc_spi@0 {
					pinctrl-0 = <0x00>;
					pinctrl-1 = <0x00>;
					pinctrl-2 = <0x00>;
					pinctrl-3 = <0x00>;
				};
			};
		};

		fragment@34 {

			__overlay__ {
				pinctrl-0 = <0x00>;
				pinctrl-1 = <0x00>;
				pinctrl-2 = <0x00>;
				pinctrl-3 = <0x00>;
			};
		};

		fragment@69 {

			__overlay__ {
				pinctrl-0 = <0x00>;
				pinctrl-1 = <0x00>;
				pinctrl-2 = <0x00>;
				pinctrl-3 = <0x00>;
				pinctrl-4 = <0x00>;
				pinctrl-5 = <0x00>;
			};
		};

		fragment@73 {

			__overlay__ {
				pinctrl-0 = <0x00>;
				pinctrl-1 = <0x00>;
				pinctrl-2 = <0x00>;
				pinctrl-3 = <0x00>;
				pinctrl-4 = <0x00>;
				pinctrl-5 = <0x00>;
				pinctrl-6 = <0x00>;
				pinctrl-7 = <0x00>;
				pinctrl-8 = <0x00>;
				pinctrl-9 = <0x00>;
				pinctrl-10 = <0x00>;
				pinctrl-11 = <0x00>;
				pinctrl-12 = <0x00>;
				pinctrl-13 = <0x00>;
				pinctrl-14 = <0x00>;
				pinctrl-15 = <0x00>;
				pinctrl-16 = <0x00>;
				pinctrl-17 = <0x00>;
				pinctrl-18 = <0x00>;
				pinctrl-19 = <0x00>;
				pinctrl-20 = <0x00>;
				pinctrl-21 = <0x00>;
				pinctrl-22 = <0x00>;
				pinctrl-23 = <0x00>;
				pinctrl-24 = <0x00>;
				pinctrl-25 = <0x00>;
				pinctrl-26 = <0x00>;
				pinctrl-27 = <0x00>;
				pinctrl-28 = <0x00>;
				pinctrl-29 = <0x00>;
				pinctrl-30 = <0x00>;
				pinctrl-31 = <0x00>;
				pinctrl-32 = <0x00>;
				pinctrl-33 = <0x00>;
				pinctrl-34 = <0x00>;
			};
		};

		fragment@74 {

			__overlay__ {
				pinctrl-0 = <0x00>;
				pinctrl-1 = <0x00>;
				pinctrl-2 = <0x00>;
			};
		};

		fragment@78 {

			__overlay__ {
				si,sia81xx-aux-devs = <0x00>;
			};
		};

		fragment@79 {

			__overlay__ {

				sipa_i2c@58 {
					si,sipa-dev = <0x00>;
				};
			};
		};
	};
};
